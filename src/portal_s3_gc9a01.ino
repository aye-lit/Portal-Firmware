// Vortex Portal for the 1.28″ round GC9A01 colour display (240x240)
// Generated by Display Studio for: ESP32-S3 (DevKitC, Mini, SuperMini)
// Works on ESP32 (all types), Raspberry Pi Pico (RP2040/RP2350) and Teensy 4.
// To use another board, change the pin numbers in the "Board" section below.
// Libraries (Library Manager): "Adafruit GC9A01A" and "Adafruit GFX Library".
// The portal is drawn in the centre of the screen.
//
// Wiring:  VCC->3V3  GND->GND  SCL->GPIO 12  SDA->GPIO 11  DC->GPIO 9  CS->GPIO 10  RST->GPIO 13  BLK->3V3 (if present)
//
// Live tuning: plug in over USB, open Display Studio in Chrome or Edge and click
// "Connect over USB". The board saves the settings.

#if defined(__AVR__) || defined(ESP8266)
  #error "This screen needs a board with more memory: an ESP32, Raspberry Pi Pico or Teensy 4."
#endif

#include <SPI.h>
#include <Adafruit_GFX.h>
#include <Adafruit_GC9A01A.h>
#include <EEPROM.h>
#include <math.h>
#if defined(ESP32)
  #include <freertos/FreeRTOS.h>
  #include <freertos/semphr.h>
#endif
#if defined(ESP32) && __has_include("rom/tjpgd.h")
  #define HAS_PICS 1                      // pictures: stored in flash, unpacked by the chip's built-in JPEG decoder
  #include <esp_partition.h>
  #include "rom/tjpgd.h"
#else
  #define HAS_PICS 0
#endif

// ---------- Board: ESP32-S3 (DevKitC, Mini, SuperMini) ----------
// SPI pins (GPIO numbers). On boards with fixed SPI pins (Uno, Nano, Mega,
// ESP8266, Teensy) CLK and DIN must go to the hardware SPI pins shown in the
// Studio; CS, DC and RST can be any free pins.
#define PIN_SCK   12
#define PIN_MOSI  11
#define PIN_CS    10
#define PIN_DC    9
#define PIN_RST   13

// Declared early so the Arduino IDE's automatic function prototypes compile
struct Spark;
struct Saved;
struct Look;

void beginBus() {
#if defined(ESP32)
  SPI.begin(PIN_SCK, -1, PIN_MOSI, PIN_CS);
#elif defined(ARDUINO_ARCH_RP2040)
  SPI.setSCK(PIN_SCK);
  SPI.setTX(PIN_MOSI);
  SPI.begin();
#else
  SPI.begin();                     // fixed hardware SPI pins
#endif
}
#define SPI_HZ    80000000UL   // turbo: if the picture glitches or stays dark, change to 40000000UL

#define TAP_PIN    -1
#define PX         1            // one drawn pixel per screen pixel
#define TURNS      0
#define SCR_W      240          // drawing width and height (the screen is PX times bigger)
#define SCR_H      240
#define SCR_WMAX   SCR_W
#define QX         120          // centre of the screen
#define QY         120
const bool PORTRAIT = false, wantPortrait = false, wantFlip = false;
#define TQX        (SCR_W - QX)
#define TQY        (SCR_H - QY)
int      STRIP = 9600 / SCR_WMAX;          // rows drawn per chunk (fewer if memory is tight)
#define MAX_SPARKS 30
#define MAX_PICS   8                     // picture slots
#define PORTAL     255                   // scene number for the portal itself
#define RADIUS_MAX 151
#define SP_EXT     120          // space styles: distance from the centre to the edge of the picture area

// ---------- Settings baked in from the Studio ----------
float    RADIUS     = 92.00;   // portal size in pixels
float    OVAL       = 1.00;    // 1.0 = round, higher = wide oval
uint8_t  ARMS       = 4;       // spiral arms
float    TWIST      = 2.40;    // how tightly the arms coil
float    SPEED      = 0.12;    // spin per frame
uint8_t  NUM_SPARKS = 28;      // particles being sucked in
bool     DRIFT      = false;    // Wormhole: true = Reverse, the rings fly out toward you (LCDs don't need burn-in drift)
uint32_t COLOR_CORE = 0x3B1CFF;  // inner colour
uint32_t COLOR_RIM  = 0x38F0FF;  // outer colour
uint32_t RIP_C[4]   = { 0xFFD36B, 0xFF2D8A, 0x8A3DFF, 0x3DE0FF };   // crosses, Gradient ripple: each ring changes through these four colours
uint8_t  BRIGHTNESS = 100;     // 10-100 %: dims the portal's colours
uint8_t  STYLE      = 0;       // 0 Vortex, 1 Toon Spiral, 2 Starburst, 3 Hyperspace, 4 Galaxy (Hubble-style spiral), 5 Black hole, 6 Cartoon Swirl, 7 Cartoon Sticker,
                                // crosses: 8 Latin, 9 Celtic, 10 Budded, 11 Patriarchal, 12 Orthodox, 13 Pattee (ESP32 boards)
                                // more space: 14 Nebula, 15 Wormhole, 16 Meteor Shower
uint8_t  CROSS_RIPPLE = 0;      // crosses: Ripple, rings echoing the outline inside the cross (0 off, 1 outward, 2 inward; +3 Gradient colours); the Wooden cross: its wood (0 classic, 1 pine, 2 rustic oak, 3 walnut, 4 cherry, 5 mahogany, 6 cedar, 7 driftwood, 8 ebony, 9 maple, 10 olive wood)
uint8_t  CROSS_FILL = 0;       // crosses: what's drawn inside (0 Vortex, 1 Toon Spiral, 2 Starburst, 3 Hyperspace, 4 Galaxy, 5 Black hole, 6 Cartoon Swirl, 14 Nebula, 15 Wormhole, 16 Meteor Shower, 11 Solid colour; the Wooden cross: what's behind it, 7 warm glow, 8 blue sky, 9 sunset, 10 heavenly light)
uint32_t SPACE_COLS[4] = { 0x4A2C1A, 0xFF5C9A, 0x6EA8FF, 0xFFF0CF };   // Galaxy, Nebula, Wormhole, Meteor Shower: four colours blended together
uint8_t  CROSS_W    = 46;      // crosses: how far the crossbar reaches, % of the lower arm (25-100)
uint8_t  BEAM       = 14;      // crosses: beam thickness, % of the portal size (5-30)
uint8_t  BAR        = 32;      // crosses: crossbar height (20-50, 50 = all arms the same length)
uint8_t  STARS      = 3;       // space styles: star density (1-6)
bool     FADE_ON    = false;    // fade through the colour sets
uint8_t  FADE_COUNT = 1;       // extra colour sets after the main colours (1-3)
uint32_t FADE_COLS[6] = { 0xFF3D00, 0xFFD36B, 0x000000, 0x000000, 0x000000, 0x000000 };   // core, rim pairs
uint8_t  RIM_SMOOTH = 0;       // 0 = wobbly energy edge, 100 = perfectly smooth ring
uint32_t CROSS_COL  = 0x1000000;   // glowing crosses: the outline colour (0x1000000: the main colours)
uint8_t  CROSS_OUT  = 255;       // glowing crosses: what's drawn outside (255 black, or a portal or space style)
uint8_t  RIM_W      = 100;      // Rim thickness, % (25-200): the glowing edge, or the Cartoon Sticker's outline
float    FADE_SECS  = 8;       // seconds for each fade (0 min 8 sec)
uint8_t  RIPPLES    = 2;       // Starburst: rings expanding at once (0-6)
float    RIP_SPEED  = 0.09;    // Starburst: ripple speed (0.03-0.30)
float    GLOW_SIZE  = 0.55;    // Starburst: centre glow size (0.30-0.90)
uint8_t  SCENE_COUNT = 0;      // scenes shown in turn (0 = just the portal)
uint8_t  SCENES[8]  = { 255, 255, 255, 255, 255, 255, 255, 255 };   // 255 = the portal, 0-7 = pictures, 128-135 = portal around a picture
float    HOLD_SECS  = 10;       // seconds each scene stays on screen
float    SCENE_FADE = 2;       // seconds to fade into the next scene (0 = instant)
uint8_t  FRAME_PCT  = 50;      // "portal around a picture" scenes (128 + picture): how much of the picture the portal covers, 10-95 %
// --------------------------------------------------------

// Changes every time you copy a new sketch, so freshly uploaded settings
// win over ones saved earlier by live tuning.
const uint32_t BUILD_ID = 0xE0B77DE3UL;

Adafruit_GC9A01A tft(PIN_CS, PIN_DC, PIN_RST);

// Lookup tables: distance and angle for one quarter of the screen (mirrored for the rest)
uint8_t  *rT, *aT;                     // TQX x TQY each, allocated in setup()
uint8_t  colMap[SCR_WMAX];
int8_t   sinT[256];
int16_t  twistT[256], twist2T[256], edgeT[256];
uint8_t  depthT[256], coreT[256], haloT[256], rimT[64], centerT[256];
uint8_t  sbGlowT[256], sbRingT[256], sbOuterT[256], ripCrestT[256], ripTroughT[256];
uint8_t  spCoreT[256], bhRingT[256], bhDiskT[256], bhStarT[256];
uint16_t galFadeT[256];
uint8_t  warpOn[768];                   // Hyperspace stars (kept, small: a big memory request could fail once memory is broken up, and Hyperspace fell back to the Vortex)
float    warpRR[768];                   // where each streak's head is (its length and brightness follow from that)
int      bhHole = 20, twinkle = 0;
int16_t  linT[256];
uint16_t pal[256];
uint32_t palRGB[256];                   // the same colours before rounding (smooth glows)
uint16_t *stripBuf[2];                 // two strips: one is drawn while the other is sent (allocated in setup)
uint16_t *picBuf = NULL;               // a third strip, for fading between scenes
uint16_t *picBuf2 = NULL;              // core 1's own, so both cores can draw during a fade
#if defined(ESP32) && !CONFIG_FREERTOS_UNICORE
  #define CORE_ID() (xPortGetCoreID() & 1)
#else
  #define CORE_ID() 0
#endif
struct SceneLook { uint8_t look; bool cross, wood; int spCY; float spU, spExt; };
SceneLook lk[2];                        // what each core is drawing right now (both cores can draw different styles at once)
int      crossYC = QY;                 // crosses: row of the crossing (the cross is centred, so this sits above the middle)
bool     crossOn = false;               // a cross is being drawn (its outline is ready)
int      spCY = QY;                     // centre row for the space styles (the crossing when inside a cross)

// Dual-core chips (ESP32, ESP32-S3) draw on core 0 while core 1 feeds the screen.
#if defined(ESP32) && !CONFIG_FREERTOS_UNICORE
  #define DUAL_CORE 1
#else
  #define DUAL_CORE 0
#endif
#if defined(LCD_DMA) && LCD_DMA && DUAL_CORE && PX == 1 && defined(CONFIG_IDF_TARGET_ESP32)
  #define USE_DMA 1                     // pixels go out by DMA while both cores draw
  #include "driver/spi_master.h"
  #include "esp_timer.h"
  #include "esp_heap_caps.h"
#else
  #define USE_DMA 0
#endif

// New settings from live tuning are applied between frames
volatile bool havePending = false;

struct Spark { float a, r; };
Spark sparks[MAX_SPARKS];
int16_t sparkX[MAX_SPARKS], sparkY[MAX_SPARKS];
float t = 0;

struct Saved { uint32_t id; float radius, oval, twist, speed; uint8_t arms, sparks, drift; uint32_t core, rim; uint8_t bright, style, ripples; float ripSpeed, glow; uint8_t stars, fadeOn, fadeCount; uint32_t fadeCols[6]; float fadeSecs; uint8_t rimSmooth; uint8_t sceneCount, scenes[8]; float holdSecs, sceneFade; uint8_t framePct, crossW, beam, bar; uint32_t spaceCols[4]; uint8_t crossFill, crossRipple, portrait, tone, warm, tapOff, fdLen, fdStars, fdClouds, fdGlow; };
static_assert(sizeof(Saved) <= 128, "settings must fit the 128 bytes of EEPROM");

// Scenes with their own settings: each "another style" scene can keep its own size, colours, speed...
struct Look { float radius, oval, twist, speed, ripSpeed, glow; uint32_t core, rim, spaceCols[4]; uint8_t arms, sparks, drift, bright, ripples, stars, rimSmooth, fadeOn, style, crossFill, crossRipple, beam, crossW, bar; uint32_t ripC[4]; uint8_t rimW, crossOut; uint32_t crossCol; };
struct Extra { uint32_t id; uint32_t ripC[4]; uint8_t rimW, crossOut; uint32_t crossCol; };   // settings that don't fit the first 128 bytes
struct SceneSaved { uint32_t id; uint8_t has[8]; Look look[8]; };
#define EE_SIZE (128 + sizeof(SceneSaved) + sizeof(Extra))   // main settings, the scenes' own settings, then the extras
#define EXTRA_AT (128 + sizeof(SceneSaved))
uint32_t pendRipC[4]; bool pendRip = false;
uint8_t  pendRimW = 100; bool pendRim = false;
uint8_t  pendOut = 255; bool pendXout = false;
uint32_t pendCol = 0x1000000; bool pendXcol = false;
uint8_t  SCENE_HAS[8] = { 0, 0, 0, 0, 0, 0, 0, 0 };   // 1 = that scene has its own settings
Look     SCENE_LOOKS[8] = {
  { 6, 1, 0, 0, 0.09f, 0.55f, 0, 0, { 0, 0, 0, 0 }, 1, 0, 0, 100, 0, 1, 0, 0, 0, 0, 0, 14, 46, 32, { 0xFFD36B, 0xFF2D8A, 0x8A3DFF, 0x3DE0FF }, 100, 255, 0x1000000 },
  { 6, 1, 0, 0, 0.09f, 0.55f, 0, 0, { 0, 0, 0, 0 }, 1, 0, 0, 100, 0, 1, 0, 0, 0, 0, 0, 14, 46, 32, { 0xFFD36B, 0xFF2D8A, 0x8A3DFF, 0x3DE0FF }, 100, 255, 0x1000000 },
  { 6, 1, 0, 0, 0.09f, 0.55f, 0, 0, { 0, 0, 0, 0 }, 1, 0, 0, 100, 0, 1, 0, 0, 0, 0, 0, 14, 46, 32, { 0xFFD36B, 0xFF2D8A, 0x8A3DFF, 0x3DE0FF }, 100, 255, 0x1000000 },
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  { 6, 1, 0, 0, 0.09f, 0.55f, 0, 0, { 0, 0, 0, 0 }, 1, 0, 0, 100, 0, 1, 0, 0, 0, 0, 0, 14, 46, 32, { 0xFFD36B, 0xFF2D8A, 0x8A3DFF, 0x3DE0FF }, 100, 255, 0x1000000 }
};
Look mainLook;                           // your main settings (the scenes without their own use these)
Look pendLook[8]; uint8_t pendHas[8];    // scene settings from live tuning, applied between frames
volatile bool scenePending = false;
int8_t curLook = -1;                     // whose settings are loaded now (-1 = main)
int8_t idxA = -1, idxB = -1;             // scene positions showing (-1 = not from the scene list)
int    dipK = 256;                       // scenes with different settings fade through black: 256 = full brightness

// ---------- tables ----------
// Cartoon styles: smooth looping noise tables
uint8_t nzA[32], nzB[64], nzC[256];
uint32_t nzSeed = 12345;
uint8_t nzRnd() { nzSeed = (nzSeed * 1103515245UL + 12345UL) & 0x7fffffffUL; return (nzSeed >> 16) & 255; }

void nzTable(uint8_t *t, int len, int passes) {
  int tmp[256], n[256];
  for (int i = 0; i < len; i++) n[i] = nzRnd();
  for (int p = 0; p < passes; p++) {
    for (int i = 0; i < len; i++) tmp[i] = (n[(i + len - 1) % len] + 2 * n[i] + n[(i + 1) % len]) >> 2;
    for (int i = 0; i < len; i++) n[i] = tmp[i];
  }
  int lo = 255, hi = 0;
  for (int i = 0; i < len; i++) { if (n[i] < lo) lo = n[i]; if (n[i] > hi) hi = n[i]; }
  for (int i = 0; i < len; i++) t[i] = (uint8_t)lroundf((n[i] - lo) * 255.0f / (hi - lo));
}

inline int nz(const uint8_t *t, int mask, int x) {
  int i = x >> 4, f = x & 15;
  return (t[i & mask] * (16 - f) + t[(i + 1) & mask] * f) >> 4;
}

void buildGeometry() {
  nzTable(nzA, 32, 1);
  nzTable(nzB, 64, 1);
  nzTable(nzC, 256, 2);
  for (int qy = 0; qy < TQY; qy++) {
    for (int qx = 0; qx < TQX; qx++) {
      float fx = qx + 0.5f, fy = qy + 0.5f;
      rT[qy * TQX + qx] = (uint8_t)min(255L, lroundf(sqrtf(fx * fx + fy * fy)));
      aT[qy * TQX + qx] = (uint8_t)lroundf(atan2f(fy, fx) / (PI / 2) * 64);
    }
  }
  for (int i = 0; i < 256; i++) sinT[i] = (int8_t)lroundf(127 * sinf(i * TWO_PI / 256));
}

void buildParams() {
  float R = RADIUS;
  for (int r = 0; r < 256; r++) {
    float rn = max((float)r, 0.5f) / R, lr = logf(rn), x = min(rn, 1.0f);
    twistT[r]  = (int16_t)(TWIST * 3.0f * lr * 40.74f);
    twist2T[r] = (int16_t)(TWIST * 1.6f * lr * 40.74f);
    depthT[r]  = (uint8_t)(255 * x * x * (3 - 2 * x));
    coreT[r]   = (uint8_t)(210 * expf(-rn * rn * 18));
    haloT[r]   = (uint8_t)(115 * expf(-r / R * 3.2f));   // outer glow
    linT[r]    = (int16_t)(r * TWIST * 1.2f * 256 / R);
    centerT[r] = (uint8_t)(55 * expf(-powf(rn * 2.2f, 2)));
    // Starburst: glowing centre, soft rings near the centre, rays toward the rim
    float sr = r / R, f1 = min(1.0f, sr / GLOW_SIZE), f2 = min(1.0f, max(0.0f, (sr - 0.15f) / 0.55f));
    int inner = (int)(256 * (1 - f1 * f1 * (3 - 2 * f1)));
    sbOuterT[r] = (uint8_t)min(255, (int)(256 * f2 * f2 * (3 - 2 * f2)));
    sbRingT[r]  = (uint8_t)min(255, (inner * inner * inner) >> 16);
    sbGlowT[r]  = (uint8_t)(105 * expf(-powf(sr / GLOW_SIZE * 1.4f, 2)));
    // Space: bright core, galaxy arm fade, black hole ring and disk
    spCoreT[r]  = (uint8_t)(230 * expf(-powf(rn / 0.16f, 2)));
    galFadeT[r] = (uint16_t)max(0, (int)(256 * (1 - sr * 0.7f)));
    float hr = 0.22f * R, dn = (sr - 0.22f) / 0.45f;
    bhRingT[r]  = (uint8_t)(255 * expf(-powf((r - hr - 1.5f) / 1.8f, 2)));
    bhDiskT[r]  = (dn >= 0 && dn < 1) ? (uint8_t)(235 - dn * 200) : 0;
    bhStarT[r]  = dn > 0.85f ? 1 : 0;
  }
  for (int d = 0; d < 64; d++) rimT[d] = (uint8_t)(255 * expf(-powf(d * 9.0f / (R * RIM_W / 100.0f), 2)));   // Rim thickness
  for (int x = 0; x < SCR_W; x++) {
    int dx = x < QX ? QX - 1 - x : x - QX;
    colMap[x] = (uint8_t)min((long)(TQX - 1), lroundf(dx / OVAL));
  }
}

uint8_t  TONE = 0;             // Colour depth: darker mid-tones for screens that look washed out (0 = as drawn)
uint8_t  FD_LEN = 8, FD_STARCNT = 60, FD_CLOUDS = 50, FD_GLOW = 100;   // Full day: day length (minutes), star count, cloud amount, sun and moon brightness (%)
uint8_t  TAP_OFF = 0;             // 1: tapping the screen does nothing
uint8_t  WARM = 0;             // Warmth: less blue (and a little less green) for screens that lean blue
uint16_t toneS[256];                    // how much to scale a colour by, from its brightest channel (keeps the hue)
uint16_t warmG = 256, warmB = 256;
void buildTone() {
  float g = 1 + TONE / 100.0f;           // 0 -> straight line, 100 -> gamma 2 (on the colour's brightness, so pinks stay pink)
  toneS[0] = 256;
  for (int i = 1; i < 256; i++) toneS[i] = (uint16_t)lroundf(256 * powf(i / 255.0f, g) * 255 / i);
  warmB = (uint16_t)(256 - WARM * 0.65f * 2.56f); warmG = (uint16_t)(256 - WARM * 0.18f * 2.56f);   // 100%: blue x0.35, green x0.82
}
uint32_t toneRGB(uint8_t r, uint8_t g, uint8_t b) {   // the colour curve, before rounding to the screen's colours
  uint8_t m = r > g ? (r > b ? r : b) : (g > b ? g : b);
  uint32_t k = toneS[m];
  r = (r * k) >> 8; g = (g * k * warmG) >> 16; b = (b * k * warmB) >> 16;
  return ((uint32_t)r << 16) | ((uint32_t)g << 8) | b;
}
uint16_t to565(uint8_t r, uint8_t g, uint8_t b) {
  uint32_t c = toneRGB(r, g, b);
  return ((c >> 8) & 0xF800) | ((c >> 5) & 0x07E0) | ((c & 0xFF) >> 3);
}
uint16_t to565raw(uint8_t r, uint8_t g, uint8_t b) { return ((r & 0xF8) << 8) | ((g & 0xFC) << 3) | (b >> 3); }   // without the colour curve (the wood: dark browns would lose their grain)

uint32_t mixColor(uint32_t x, uint32_t y, float f) {   // blend two 0xRRGGBB colours
  uint32_t out = 0;
  for (int i = 0; i < 3; i++) {
    int cx = (x >> (16 - 8 * i)) & 0xFF, cy = (y >> (16 - 8 * i)) & 0xFF;
    out |= (uint32_t)(int)(cx + (cy - cx) * f) << (16 - 8 * i);
  }
  return out;
}

void buildPaletteFrom(uint32_t core, uint32_t rim) {   // black -> core -> rim -> near-white
  uint8_t a[3], b[3];
  for (int i = 0; i < 3; i++) { a[i] = (core >> (16 - 8 * i)) & 0xFF; b[i] = (rim >> (16 - 8 * i)) & 0xFF; }
  for (int i = 0; i < 256; i++) {
    uint8_t c[3];
    for (int k = 0; k < 3; k++) {
      float v;
      if (i < 110)      v = a[k] * (i / 110.0f);
      else if (i < 200) v = a[k] + (b[k] - a[k]) * ((i - 110) / 90.0f);
      else              v = b[k] + (255 - b[k]) * ((i - 200) / 55.0f * 0.6f);
      c[k] = (uint8_t)(v * BRIGHTNESS / 100.0f);
    }
    pal[i] = to565(c[0], c[1], c[2]);
    palRGB[i] = toneRGB(c[0], c[1], c[2]);
  }
}

// Space colour table: 64 hues blended around the four space colours x 64 brightness levels
uint16_t *spaceLUT = NULL;             // allocated the first time a space style is shown
void buildSpaceLUT() {
  if (!spaceLUT) return;
  for (int h = 0; h < 64; h++) {
    float p = h / 16.0f; int i = (int)p; float f = p - i; f = f * f * (3 - 2 * f);
    uint32_t A = SPACE_COLS[i & 3], B = SPACE_COLS[(i + 1) & 3];
    float base[3];
    for (int k = 0; k < 3; k++) { int ca = (A >> (16 - 8 * k)) & 0xFF, cb = (B >> (16 - 8 * k)) & 0xFF; base[k] = ca + (cb - ca) * f; }
    for (int b = 0; b < 64; b++) {
      float v = b / 63.0f; uint8_t c[3];
      for (int k = 0; k < 3; k++) {
        float x = base[k] * min(1.0f, v / 0.75f);
        if (v > 0.75f) x += (255 - x) * (v - 0.75f) / 0.25f * 0.8f;   // the brightest parts glow toward white
        if (x > 255) x = 255;
        c[k] = (uint8_t)(x * BRIGHTNESS / 100.0f);
      }
      spaceLUT[h * 64 + b] = to565(c[0], c[1], c[2]);
    }
  }
}

uint16_t xPalOwn[256];                    // the cross outline in its own colour
uint16_t *xpal = pal;                     // what the cross outline is drawn with
bool xOwn = false;
void buildCrossPal() {                    // black -> the cross colour -> a lighter one -> near-white
  xOwn = CROSS_COL <= 0xFFFFFF; xpal = xOwn ? xPalOwn : pal;
  if (!xOwn) return;
  uint8_t a[3], b[3];
  for (int i = 0; i < 3; i++) { a[i] = (CROSS_COL >> (16 - 8 * i)) & 0xFF; b[i] = a[i] + (255 - a[i]) * 35 / 100; }
  for (int i = 0; i < 256; i++) {
    uint8_t c[3];
    for (int k = 0; k < 3; k++) {
      float v;
      if (i < 110)      v = a[k] * (i / 110.0f);
      else if (i < 200) v = a[k] + (b[k] - a[k]) * ((i - 110) / 90.0f);
      else              v = b[k] + (255 - b[k]) * ((i - 200) / 55.0f * 0.6f);
      c[k] = (uint8_t)(v * BRIGHTNESS / 100.0f);
    }
    xPalOwn[i] = to565(c[0], c[1], c[2]);
  }
}
void buildPalette() { buildPaletteFrom(COLOR_CORE, COLOR_RIM); buildCrossPal(); buildSpaceLUT(); }

void updateColourFade() {             // fade through the colour sets in order, FADE_SECS per fade
  if (!FADE_ON || FADE_COUNT < 1) return;
  int n = 1 + FADE_COUNT;              // main colours + extra sets
  float pos = fmodf(millis() / 1000.0f / FADE_SECS, (float)n);
  int i = (int)pos, j = (i + 1) % n;
  float f = pos - i;
  f = f * f * (3 - 2 * f);
  uint32_t coreA = i == 0 ? COLOR_CORE : FADE_COLS[(i - 1) * 2], rimA = i == 0 ? COLOR_RIM : FADE_COLS[(i - 1) * 2 + 1];
  uint32_t coreB = j == 0 ? COLOR_CORE : FADE_COLS[(j - 1) * 2], rimB = j == 0 ? COLOR_RIM : FADE_COLS[(j - 1) * 2 + 1];
  buildPaletteFrom(mixColor(coreA, coreB, f), mixColor(rimA, rimB, f));
}

// ---------- space helpers ----------
#if defined(ESP32)
  #define HOT IRAM_ATTR                  // the drawing loops run from the chip's own fast memory, not through the flash cache
#else
  #define HOT
#endif
static inline __attribute__((always_inline)) uint32_t hash32(uint32_t n) {   // (inline: it runs for every pixel of the space styles)
  n = (n ^ 61) ^ (n >> 16);
  n *= 9;
  n ^= n >> 4;
  n *= 0x27d4eb2dUL;
  n ^= n >> 15;
  return n;
}

int starAt(int a, int r) {             // one twinkling star per small patch of sky
  uint32_t h = hash32((uint32_t)((a >> 1) * 977 + (r >> 2) * 131));
  if ((int)(h & 63) >= STARS * 2) return 0;
  if ((a & 1) != (int)((h >> 8) & 1) || (r & 3) != (int)((h >> 10) & 3)) return 0;
  return 120 + ((sinT[((h >> 12) + (uint32_t)twinkle) & 255] + 127) >> 1);
}

// ---------- sparks ----------
void respawn(Spark &s) {
  s.a = random(0, 628) / 100.0;
  s.r = RADIUS * 1.05 + random(0, (int)(RADIUS / 5) + 1);
}

void resetSparks() {
  for (uint8_t i = 0; i < NUM_SPARKS; i++) {
    respawn(sparks[i]);
    sparks[i].r = random(4, (int)RADIUS + 10);
  }
}

float frameK = 1;                                        // how many Studio frames (1/28 s) the last frame took
void updateSparks() {
  float fall = powf(0.95f, frameK);
  for (uint8_t i = 0; i < NUM_SPARKS; i++) {
    Spark &s = sparks[i];
    s.r *= fall;                                         // fall inward
    s.a += SPEED * 2.0 * (RADIUS / (s.r + RADIUS * 0.22)) * frameK;  // faster near the centre
    if (s.r < 3) respawn(s);
    sparkX[i] = (int16_t)floorf(QX + cosf(s.a) * s.r * OVAL);
    sparkY[i] = (int16_t)floorf((crossOn ? crossYC : QY) + sinf(s.a) * s.r);
  }
}

// ---------- saved settings (EEPROM) ----------
bool validOut(uint8_t f) { return f == 255 || f <= 4 || f == 6 || f == 11 || (f >= 14 && f <= 16); }   // what can go outside a glowing cross
bool validFill(uint8_t f) { return f <= 11 || (f >= 14 && f <= 16) || f == 18; }   // styles that can go inside a cross (Wooden cross only: 7 warm glow, 8 blue sky, 9 sunset, 10 heavenly light, 18 full day)

inline bool isStyleScene(uint8_t c) { return c >= 200 && c <= 217; }   // 200 + style: another style to fade into (crosses too)
inline bool isCrossSt(uint8_t st) { return (st >= 8 && st <= 13) || st == 17; }
inline bool validScene(uint8_t c) { return c == PORTAL || c < MAX_PICS || (c >= 128 && c < 128 + MAX_PICS) || isStyleScene(c); }

bool validScenes(const Saved &s) {
  if (s.sceneCount > 8 || !(s.holdSecs >= 1 && s.holdSecs <= 3600) || !(s.sceneFade >= 0 && s.sceneFade <= 600)) return false;
  if (s.framePct < 10 || s.framePct > 95) return false;
  if (s.crossW < 25 || s.crossW > 100 || s.beam < 5 || s.beam > 30 || s.bar < 20 || s.bar > 50) return false;
  for (int k = 0; k < 4; k++) if (s.spaceCols[k] > 0xFFFFFF) return false;
  if (!validFill(s.crossFill)) return false;
  if (s.crossRipple > 10) return false;   // (crosses: ripple 0-2; the Wooden cross: wood style 0-10)
  for (uint8_t i = 0; i < s.sceneCount; i++) {
    if (!validScene(s.scenes[i])) return false;
  }
  return true;
}

// ---------- tapping the screen ----------
volatile uint8_t tapCount = 0;           // taps seen (core 1 counts them, the frame code acts on them)
bool    tapMode = false;                 // showing a style picked by tapping
int8_t  tapIdx = -1;                     // which one (-1 = your own style or scene)
uint8_t tapFrom = 255, tapTo = 255;      // fading from / to
uint32_t tapAt = 0, sceneShiftMs = 0;    // when the tap fade began; how far taps have moved the scene clock
#if TAP_PIN >= 0
uint8_t  tapCur = 0, tapNext = 0;        // tap for next scene: the scene showing, and the one it's fading into
uint32_t tapSceneAt = 0;                 // when the last tap started that fade
#endif
#if TAP_PIN >= 0
void pollTap() {                         // the touch chip pulls its pin low while the screen is pressed
  static uint32_t lowSince = 0, highSince = 0;
  static bool down = false;
  if (TAP_OFF) return;                   // turned off in the Studio
  uint32_t now = millis() | 1;
  if (digitalRead(TAP_PIN) == LOW) {
    highSince = 0;
    if (!lowSince) lowSince = now;
    if (!down && now - lowSince >= 15) { down = true; tapCount++; }   // held a moment: a real press, not a blip
  } else {
    lowSince = 0;
    if (!highSince) highSince = now;
    if (down && now - highSince >= 150) down = false;                   // let go
  }
}
void beginTap() {                        // put the touch chip in its waiting mode, where its pin shows presses
  pinMode(TAP_CS, OUTPUT); digitalWrite(TAP_CS, HIGH);
  pinMode(PIN_CS, OUTPUT); digitalWrite(PIN_CS, HIGH);
  SPI.beginTransaction(SPISettings(1000000, MSBFIRST, SPI_MODE0));
  digitalWrite(TAP_CS, LOW); SPI.transfer(0x80); SPI.transfer(0); SPI.transfer(0); digitalWrite(TAP_CS, HIGH);
  SPI.endTransaction();
  pinMode(TAP_PIN, INPUT);
}
#else
inline void pollTap() {}
inline void beginTap() {}
#endif

bool valid(const Saved &s) {
  return s.radius >= 6 && s.radius <= RADIUS_MAX && s.oval >= 1 && s.oval <= 2 &&
         s.arms >= 1 && s.arms <= 8 && s.twist >= 0 && s.twist <= 6 &&
         s.speed >= 0 && s.speed <= 0.4f && s.sparks <= MAX_SPARKS &&
         s.core <= 0xFFFFFF && s.rim <= 0xFFFFFF && s.bright >= 10 && s.bright <= 100 && s.style <= 17 && s.stars >= 1 && s.stars <= 6 && s.fadeCount >= 1 && s.fadeCount <= 3 && s.fadeSecs >= 1 && s.fadeSecs <= 3600 && s.rimSmooth <= 100 &&
         s.ripples <= 6 && s.ripSpeed >= 0.03f && s.ripSpeed <= 0.3f && s.glow >= 0.3f && s.glow <= 0.9f &&
         validScenes(s);
}

void apply(const Saved &s) {
  tapMode = false; tapIdx = -1;          // new settings: show them (not a style picked by tapping)
#if TAP_PIN >= 0
  tapCur = tapNext = 0;                  // tap for next scene: start again from the first scene
#endif
  RADIUS = s.radius; OVAL = s.oval; TWIST = s.twist; SPEED = s.speed;
  ARMS = s.arms; NUM_SPARKS = s.sparks; DRIFT = s.drift;
  COLOR_CORE = s.core; COLOR_RIM = s.rim; BRIGHTNESS = s.bright; STYLE = s.style;
  RIPPLES = s.ripples; RIP_SPEED = s.ripSpeed; GLOW_SIZE = s.glow; STARS = s.stars;
  FADE_ON = s.fadeOn; FADE_COUNT = s.fadeCount; FADE_SECS = s.fadeSecs; RIM_SMOOTH = s.rimSmooth;
  for (int k = 0; k < 6; k++) FADE_COLS[k] = s.fadeCols[k] & 0xFFFFFF;
  SCENE_COUNT = s.sceneCount; HOLD_SECS = s.holdSecs; SCENE_FADE = s.sceneFade; FRAME_PCT = s.framePct;
  CROSS_W = s.crossW; BEAM = s.beam; BAR = s.bar;
  for (int k = 0; k < 8; k++) SCENES[k] = s.scenes[k];
  for (int k = 0; k < 4; k++) SPACE_COLS[k] = s.spaceCols[k];
  CROSS_FILL = s.crossFill;
  CROSS_RIPPLE = s.crossRipple;
#if TURNS
  wantPortrait = (s.portrait & 1) != 0;  // turned at the start of the next frame
  wantFlip = (s.portrait & 2) != 0;       // (and the other way round)
#endif
  TONE = s.tone <= 100 ? s.tone : 0;
  WARM = s.warm <= 100 ? s.warm : 0;
  TAP_OFF = s.tapOff == 1;               // (older saved settings: tapping stays on)
  if (s.fdLen >= 2 && s.fdLen <= 30 && s.fdStars <= 100 && s.fdClouds <= 100 && s.fdGlow >= 20 && s.fdGlow <= 150) {   // (older saved settings: Full day keeps its defaults)
    FD_LEN = s.fdLen; FD_STARCNT = s.fdStars; FD_CLOUDS = s.fdClouds; FD_GLOW = s.fdGlow;
  }
}

void loadSettings() {
#if defined(ESP32) || defined(ESP8266) || defined(ARDUINO_ARCH_RP2040)
  EEPROM.begin(EE_SIZE);
#endif
  Saved s;
  EEPROM.get(0, s);
  if (s.id == BUILD_ID && valid(s)) apply(s);
}

void saveSettings() {
  Saved s = { BUILD_ID, RADIUS, OVAL, TWIST, SPEED, ARMS, NUM_SPARKS, (uint8_t)DRIFT, COLOR_CORE, COLOR_RIM, BRIGHTNESS, STYLE, RIPPLES, RIP_SPEED, GLOW_SIZE, STARS, (uint8_t)FADE_ON, FADE_COUNT };
  for (int k = 0; k < 6; k++) s.fadeCols[k] = FADE_COLS[k];
  s.fadeSecs = FADE_SECS;
  s.rimSmooth = RIM_SMOOTH;
  s.sceneCount = SCENE_COUNT; s.holdSecs = HOLD_SECS; s.sceneFade = SCENE_FADE; s.framePct = FRAME_PCT;
  s.crossW = CROSS_W; s.beam = BEAM; s.bar = BAR;
  for (int k = 0; k < 8; k++) s.scenes[k] = SCENES[k];
  for (int k = 0; k < 4; k++) s.spaceCols[k] = SPACE_COLS[k];
  s.crossFill = CROSS_FILL;
  s.crossRipple = CROSS_RIPPLE;
  s.portrait = (wantPortrait ? 1 : 0) | (wantFlip ? 2 : 0);
  s.tone = TONE;
  s.warm = WARM;
  s.tapOff = TAP_OFF;
  s.fdLen = FD_LEN; s.fdStars = FD_STARCNT; s.fdClouds = FD_CLOUDS; s.fdGlow = FD_GLOW;
  EEPROM.put(0, s);
#if defined(ESP32) || defined(ESP8266) || defined(ARDUINO_ARCH_RP2040)
  EEPROM.commit();
#endif
}

Saved pendingSettings;

float clampf(float v, float lo, float hi) { return v < lo ? lo : v > hi ? hi : v; }
uint8_t clampb(uint8_t v, uint8_t lo, uint8_t hi) { return v < lo ? lo : v > hi ? hi : v; }
void clampSettings(Saved &s) {
  s.radius = clampf(s.radius, 6, RADIUS_MAX); s.oval = clampf(s.oval, 1, 2); s.arms = clampb(s.arms, 1, 8);
  s.twist = clampf(s.twist, 0, 6); s.speed = clampf(s.speed, 0, 0.4f); if (s.sparks > MAX_SPARKS) s.sparks = MAX_SPARKS;
  s.core &= 0xFFFFFF; s.rim &= 0xFFFFFF; s.bright = clampb(s.bright, 10, 100); if (s.style > 17) s.style = 0;
  s.stars = clampb(s.stars, 1, 6); s.fadeCount = clampb(s.fadeCount, 1, 3); s.fadeSecs = clampf(s.fadeSecs, 1, 3600);
  if (s.rimSmooth > 100) s.rimSmooth = 100; if (s.ripples > 6) s.ripples = 6;
  s.ripSpeed = clampf(s.ripSpeed, 0.03f, 0.3f); s.glow = clampf(s.glow, 0.3f, 0.9f);
  for (int k = 0; k < 6; k++) s.fadeCols[k] &= 0xFFFFFF;
  for (int k = 0; k < 4; k++) s.spaceCols[k] &= 0xFFFFFF;
  if (s.sceneCount > 8) s.sceneCount = 8;
  s.holdSecs = clampf(s.holdSecs, 1, 3600); s.sceneFade = clampf(s.sceneFade, 0, 600); s.framePct = clampb(s.framePct, 10, 95);
  s.crossW = clampb(s.crossW, 25, 100); s.beam = clampb(s.beam, 5, 30); s.bar = clampb(s.bar, 20, 50);
  for (int k = 0; k < 8; k++) if (!validScene(s.scenes[k])) s.scenes[k] = PORTAL;
  if (!validFill(s.crossFill)) s.crossFill = 0;
  if (s.crossRipple > 10) s.crossRipple = 0;
  if (s.portrait > 3) s.portrait = 0;
  if (s.tone > 100) s.tone = 100;
  if (s.warm > 100) s.warm = 0;
}

// ---------- pictures (ESP32 boards: kept in the flash "spiffs" partition) ----------
// The Studio crops each picture to this screen, sends it as a small JPEG and the
// board unpacks it into flash. Tools -> Partition Scheme -> "No OTA (2MB APP/2MB SPIFFS)"
// gives the most room. Commands: INFO, IMG slot bytes id, D base64..., END.
// (HAS_PICS and the JPEG decoder are set up with the other #includes at the top)
bool    crossReady = false;               // cross outline ready to read (styles 8-13)
extern uint32_t woodPlaneKey, galFlashKey;
int8_t *edgeBuf = NULL;                   // one strip of the cross outline
uint8_t crossRimT[128], crossHaloT[128];  // rim and outer glow, sized to the beam

#if HAS_PICS
struct PicHead { uint32_t magic; uint16_t w, h; uint32_t id, check; };
const uint32_t PIC_MAGIC = 0x43495056UL;   // "VPIC"
const uint32_t STAGE_SIZE = 0x30000;       // room for one arriving JPEG (192 KB, enough for high quality on big screens)
const esp_partition_t *picPart = NULL;
uint32_t slotSize = 0, stageOff = 0;      // stageOff: where an arriving JPEG waits (last 64 KB)
uint32_t crossOff = 0, crossSize = 0, crossPlane = 0, woodOff = 0;   // the cross outline (distance to the edge for every pixel) and the wood in use
uint8_t  picSlots = 0;
#define MAX_PLANES 10                     // cross outlines and wood kept side by side, so scenes can switch crosses without rebuilding them
uint8_t  nPlanes = 0;
uint32_t planesOff = 0;                   // the first one (they sit just before the staging area)
uint32_t planeMagic[MAX_PLANES], planeKeyOf[MAX_PLANES], planeUse[MAX_PLANES], planeTick = 0;
int8_t   crossSlot = -1, woodSlot = -1;   // the ones in use now
int8_t   nebHSlot = -1, nebVSlot = -1;   // the Nebula's colour and brightness planes
volatile uint32_t picId[MAX_PICS];        // 0 = empty slot
uint16_t picW[MAX_PICS];                  // the width each picture was made for (the screen may have been turned since)
volatile bool uploading = false;
uint32_t upLen = 0, upPos = 0, upId = 0, upLast = 0, jpgPos = 0;
uint8_t  upSlot = 0;
uint16_t *band = NULL;
int      bandTop = 0;

void mapPlanes();
void beginPictures() {
  picPart = esp_partition_find_first(ESP_PARTITION_TYPE_DATA, ESP_PARTITION_SUBTYPE_DATA_SPIFFS, NULL);
  if (!picPart) picPart = esp_partition_find_first(ESP_PARTITION_TYPE_DATA, ESP_PARTITION_SUBTYPE_DATA_FAT, NULL);
  if (!picPart || picPart->size < 0x80000) { picPart = NULL; return; }
  slotSize = (sizeof(PicHead) + (uint32_t)SCR_W * SCR_H * 2 + 4095) & ~4095UL;
  stageOff = (picPart->size - STAGE_SIZE) & ~4095UL;
  crossPlane = (16 + (uint32_t)SCR_W * SCR_H + 4095) & ~4095UL;
  crossSize = crossPlane;
  {                                        // room for several cross outlines (and wood), keeping at least 5 pictures where possible
    uint32_t room = stageOff, keepPics = min((uint32_t)5, room / slotSize);
    uint32_t n = (room - keepPics * slotSize) / crossPlane;
    if (n < 1) { n = 1; }
    nPlanes = min((uint32_t)MAX_PLANES, n);
  }
  planesOff = stageOff - nPlanes * crossPlane;
  crossOff = woodOff = planesOff;
  picSlots = min((uint32_t)MAX_PICS, planesOff / slotSize);
  for (uint8_t i = 0; i < nPlanes; i++) {   // what each one holds
    uint32_t h[4]; esp_partition_read(picPart, planesOff + (uint32_t)i * crossPlane, h, 16);
    planeMagic[i] = h[0]; planeKeyOf[i] = h[1]; planeUse[i] = 0;
  }
  for (uint8_t i = 0; i < picSlots; i++) {
    PicHead h;
    esp_partition_read(picPart, i * slotSize, &h, sizeof(h));
    bool ok = h.magic == PIC_MAGIC && (uint32_t)h.w * h.h == (uint32_t)SCR_W * SCR_H && h.id && h.check == (h.id ^ 0xA5A5A5A5UL);
    picId[i] = ok ? h.id : 0;
    picW[i] = h.w;
  }
  mapPlanes();                             // the cross and wood strips are read through the flash cache
}

int  picturesAvailable() { return picSlots; }
bool isPicture(uint8_t s) { return s < picSlots && picId[s] != 0 && picW[s] == SCR_W; }

void readPicture(uint8_t s, int y0, int rows, uint16_t *dst) {
  esp_partition_read(picPart, s * slotSize + sizeof(PicHead) + (uint32_t)y0 * SCR_W * 2, dst, (uint32_t)rows * SCR_W * 2);
}

bool pausedForUpload() {
  if (uploading && millis() - upLast > 10000) uploading = false;   // the Studio went away mid-picture
  if (uploading) delay(1);
  return uploading;
}

int b64(char c) {
  if (c >= 'A' && c <= 'Z') return c - 'A';
  if (c >= 'a' && c <= 'z') return c - 'a' + 26;
  if (c >= '0' && c <= '9') return c - '0' + 52;
  if (c == '+') return 62;
  if (c == '/') return 63;
  return -1;
}

int unbase64(const char *in, uint8_t *out) {   // returns bytes written, -1 on bad data
  int n = 0, bits = 0;
  uint32_t acc = 0;
  for (; *in && *in != '='; in++) {
    int v = b64(*in);
    if (v < 0) return -1;
    acc = (acc << 6) | v; bits += 6;
    if (bits >= 8) { bits -= 8; out[n++] = (acc >> bits) & 0xFF; }
  }
  return n;
}

UINT jpgIn(JDEC *jd, BYTE *buf, UINT n) {        // JPEG bytes come from the staging area
  if (n > upLen - jpgPos) n = upLen - jpgPos;
  if (buf) esp_partition_read(picPart, stageOff + jpgPos, buf, n);
  jpgPos += n;
  return n;
}

UINT jpgOut(JDEC *jd, void *bmp, JRECT *r) {     // one block of pixels: collect a band, then store it
  BYTE *c = (BYTE *)bmp;
  for (int y = r->top; y <= r->bottom; y++)
    for (int x = r->left; x <= r->right; x++, c += 3)
      band[(y - bandTop) * SCR_W + x] = to565(c[0], c[1], c[2]);
  if (r->right == SCR_W - 1) {
    esp_partition_write(picPart, upSlot * slotSize + sizeof(PicHead) + (uint32_t)bandTop * SCR_W * 2,
                        band, (uint32_t)(r->bottom - bandTop + 1) * SCR_W * 2);
    bandTop = r->bottom + 1;
  }
  return 1;
}

const char *finishPicture() {
  uploading = false;
  if (upPos != upLen) return "ERR incomplete";
  static uint8_t pool[3100];               // the JPEG decoder's work area
  JDEC jd;
  jpgPos = 0;
  if (jd_prepare(&jd, jpgIn, pool, sizeof(pool), NULL) != JDR_OK) return "ERR jpeg";
  if (jd.width != SCR_W || jd.height != SCR_H) return "ERR size";
  band = (uint16_t *)malloc(SCR_W * 16 * 2);
  if (!band) return "ERR memory";
  esp_partition_erase_range(picPart, upSlot * slotSize, slotSize);
  bandTop = 0;
  JRESULT r = jd_decomp(&jd, jpgOut, 0);
  free(band); band = NULL;
  if (r != JDR_OK) return "ERR jpeg";
  PicHead h = { PIC_MAGIC, SCR_W, SCR_H, upId, upId ^ 0xA5A5A5A5UL };
  esp_partition_write(picPart, upSlot * slotSize, &h, sizeof(h));
  picId[upSlot] = upId;
  picW[upSlot] = SCR_W;
  return "OK";
}

// ---------- cross shapes (styles 8-13), from the Cross Portal Tuner ----------
// Each cross is a union of simple shapes around its junction (the screen centre). The board works out
// the distance to the cross edge for every pixel once, stores it in flash, and reads it back per strip.
struct XShape { uint8_t t, dir; float cx, cy, hw, hh, r, w, a, b, len; };   // t: 0 box, 1 circle, 2 ring, 3 tilted box, 4 flared arm
XShape xs[6];
uint8_t nxs = 0;
const uint32_t CROSS_MAGIC = 0x52435856UL;   // "VXCR"
uint32_t crossKey = 0;

void addX(uint8_t t, float cx, float cy, float hw, float hh, float r = 0, float w = 0, float a = 0, float b = 0, float len = 0, uint8_t dir = 0) {
  XShape &o = xs[nxs++];
  o.t = t; o.cx = cx; o.cy = cy; o.hw = hw; o.hh = hh; o.r = r; o.w = w; o.a = a; o.b = b; o.len = len; o.dir = dir;
}

void crossShapes() {
  float R = min(RADIUS, (SCR_H - 8) * (100.0f - BAR) / 100);   // never taller than the screen (the cross is centred)
  float bot = R, top = bot * BAR / (100.0f - BAR);
  float AW = max(2.0f, R * BEAM / 100.0f), HHL = max(AW + 1, min(R * CROSS_W / 100.0f, SCR_W / 2.0f - 2));
  nxs = 0;
  switch (STYLE - 8) {
    case 1:                                        // Celtic: ring around the junction
      addX(0, 0, (bot - top) / 2, AW, (bot + top) / 2); addX(0, 0, 0, HHL, AW);
      addX(2, 0, 0, 0, 0, max(AW * 1.9f, 0.62f * min(HHL, top)), max(2.0f, AW * 0.42f));
      break;
    case 2: {                                      // Budded: round ends
      float br = AW * 1.45f;
      addX(0, 0, (bot - top) / 2, AW, (bot - br - (-top + br)) / 2); addX(0, 0, 0, HHL - br, AW);
      addX(1, 0, -top + br, 0, 0, br); addX(1, 0, bot - br, 0, 0, br);
      addX(1, -(HHL - br), 0, 0, 0, br); addX(1, HHL - br, 0, 0, 0, br);
      break;
    }
    case 3: case 4: {                              // Patriarchal / Orthodox: extra bars
      float th = AW * 0.85f, gap = min(AW * 3.4f, top - th - 2);
      addX(0, 0, (bot - top) / 2, AW, (bot + top) / 2); addX(0, 0, 0, HHL, AW);
      addX(0, 0, -gap, HHL * 0.6f, th);
      if (STYLE == 12) addX(3, 0, bot * 0.62f, HHL * 0.55f, th, 0, 0, -0.35f);
      break;
    }
    case 5: {                                      // Pattee: flared arms
      float a = AW * 0.55f, b = AW * 1.75f;
      addX(0, 0, 0, a, a);
      addX(4, 0, 0, 0, 0, 0, 0, a, b, top, 0); addX(4, 0, 0, 0, 0, 0, 0, a, b, bot, 1);
      addX(4, 0, 0, 0, 0, 0, 0, a, b, HHL, 2); addX(4, 0, 0, 0, 0, 0, 0, a, b, HHL, 3);
      break;
    }
    default:                                       // Latin
      addX(0, 0, (bot - top) / 2, AW, (bot + top) / 2); addX(0, 0, 0, HHL, AW);
  }
}

float sdBox(float x, float y, float cx, float cy, float hw, float hh) {
  float dx = fabsf(x - cx) - hw, dy = fabsf(y - cy) - hh;
  return hypotf(fmaxf(dx, 0), fmaxf(dy, 0)) + fminf(fmaxf(dx, dy), 0);
}

float crossSD(float x, float y) {               // signed distance: negative inside the cross
  float d = 1e9f;
  for (uint8_t i = 0; i < nxs; i++) {
    const XShape &o = xs[i];
    float e;
    switch (o.t) {
      case 0: e = sdBox(x, y, o.cx, o.cy, o.hw, o.hh); break;
      case 1: e = hypotf(x - o.cx, y - o.cy) - o.r; break;
      case 2: e = fabsf(hypotf(x, y) - o.r) - o.w; break;
      case 3: { float c = cosf(o.a), s = sinf(o.a), dx = x - o.cx, dy = y - o.cy; e = sdBox(c * dx + s * dy, -s * dx + c * dy, 0, 0, o.hw, o.hh); break; }
      default: {
        float u = o.dir == 0 ? -y : o.dir == 1 ? y : o.dir == 2 ? -x : x, v = o.dir < 2 ? x : y, k = (o.b - o.a) / o.len;
        float side = (fabsf(v) - (o.a + k * constrain(u, 0.0f, o.len))) / sqrtf(1 + k * k);
        e = fmaxf(side, fmaxf(-u, u - o.len));
      }
    }
    d = fminf(d, e);
  }
  return d;
}

bool crossAvailable() { return picPart != NULL; }

int crossShift() {                              // move the crossing up so the whole cross is centred on the screen
  float bot = min(RADIUS, (SCR_H - 8) * (100.0f - BAR) / 100), top = bot * BAR / (100.0f - BAR);
  return (int)lroundf((bot - top) / 2);
}

int findPlane(uint32_t magic, uint32_t key) {
  for (int i = 0; i < nPlanes; i++) if (planeMagic[i] == magic && planeKeyOf[i] == key) return i;
  return -1;
}
int freePlane() {                               // one to (re)build: never the cross or wood in use, otherwise the longest unused
  int best = -1;
  for (int i = 0; i < nPlanes; i++) {
    if (i == crossSlot || i == woodSlot || i == nebHSlot || i == nebVSlot) continue;
    if (best < 0 || planeUse[i] < planeUse[best]) best = i;
  }
  return best >= 0 ? best : (crossSlot == 0 && nPlanes > 1 ? 1 : 0);
}
void prepareCross() {                           // (re)build the outline when the cross settings change
  int shift = crossShift();
  crossYC = QY - shift;
  uint32_t key = 2166136261UL;
  uint32_t parts[] = { STYLE, (uint32_t)(RADIUS * 16), CROSS_W, BEAM, BAR, SCR_W, SCR_H, 2 };
  for (uint32_t v : parts) key = (key ^ v) * 16777619UL;
  if (key == crossKey && crossReady) return;
  crossReady = false;
  int slot = findPlane(CROSS_MAGIC, key);       // made before (another scene's cross): use it as it is
  bool build = slot < 0;
  if (build) { slot = freePlane(); if (slot == woodSlot) { woodSlot = -1; woodPlaneKey = 0; } }
  crossOff = planesOff + (uint32_t)slot * crossPlane; crossSlot = slot; planeUse[slot] = ++planeTick;
  float rw = max(1.5f, max(2.0f, min(RADIUS, (SCR_H - 8) * (100.0f - BAR) / 100) * BEAM / 100.0f) * 0.18f);
  for (int k = 0; k < 128; k++) { crossRimT[k] = (uint8_t)(255 * expf(-(k / rw) * (k / rw))); crossHaloT[k] = (uint8_t)(115 * expf(-k / 12.0f)); }
  if (build) {
    planeMagic[slot] = 0;
    crossShapes();
    esp_partition_erase_range(picPart, crossOff, crossSize);
    static int8_t row[SCR_WMAX];
    for (int y = 0; y < SCR_H; y++) {
      float fy = y + 0.5f - crossYC;            // relative to the crossing
      for (int x = 0; x < SCR_W; x++) {
        float e = -crossSD(x + 0.5f - SCR_W / 2.0f, fy);
        if (e > 0 && e < 1) e = 1;
        if (e <= 0 && e > -1) e = -1;
        row[x] = (int8_t)constrain((int)e, -127, 127);
      }
      esp_partition_write(picPart, crossOff + 16 + (uint32_t)y * SCR_W, row, SCR_W);
      if ((y & 7) == 7) delay(1);
    }
    uint32_t h2[4] = { CROSS_MAGIC, key, 0, 0 };
    esp_partition_write(picPart, crossOff, h2, 16);
    planeMagic[slot] = CROSS_MAGIC; planeKeyOf[slot] = key;
  }
  crossKey = key;
  crossReady = true;
}

const uint8_t *planeMap = NULL;           // the cross outline and the wood, mapped into memory: read through the fast flash cache
esp_partition_mmap_handle_t planeH;
void mapPlanes() {
  const void *ptr;
  if (!planeMap && esp_partition_mmap(picPart, planesOff, stageOff + STAGE_SIZE - planesOff, ESP_PARTITION_MMAP_DATA, &ptr, &planeH) == ESP_OK) planeMap = (const uint8_t *)ptr;   // (the staging area too: the galaxy picture sits at its end)
}
void readCrossRows(int y0, int rows) {   // (mapped: nothing to copy, edgeRows() points straight at it)
  if (!planeMap) esp_partition_read(picPart, crossOff + 16 + (uint32_t)y0 * SCR_W, edgeBuf, (uint32_t)rows * SCR_W);
}
const int8_t *edgeRows(int y0) { return planeMap ? (const int8_t *)(planeMap + (crossOff - planesOff) + 16 + (uint32_t)y0 * SCR_W) : edgeBuf; }   // a strip of the cross outline (either core)
void readEdgeRow(int y, int8_t *dst) { esp_partition_read(picPart, crossOff + 16 + (uint32_t)y * SCR_W, dst, SCR_W); }
const uint32_t WOOD_MAGIC = 0x444F4F57UL;  // "WOOD"
bool woodPlaneReady(uint32_t key) {             // made before? then use it (otherwise pick a place to make it)
  int s = findPlane(WOOD_MAGIC, key), had = s >= 0;
  if (!had) { s = freePlane(); planeMagic[s] = 0; }
  woodSlot = s; woodOff = planesOff + (uint32_t)s * crossPlane; planeUse[s] = ++planeTick;
  return had;
}
void woodPlaneBegin() { esp_partition_erase_range(picPart, woodOff, crossPlane); }
void woodPlaneRow(int y, const uint8_t *row) { esp_partition_write(picPart, woodOff + 16 + (uint32_t)y * SCR_W, row, SCR_W); }
void woodPlaneEnd(uint32_t key) { uint32_t h[4] = { WOOD_MAGIC, key, 0, 0 }; esp_partition_write(picPart, woodOff, h, 16); planeMagic[woodSlot] = WOOD_MAGIC; planeKeyOf[woodSlot] = key; }
void readWoodRows(int y0, int rows, uint8_t *dst) {
  if (!planeMap) esp_partition_read(picPart, woodOff + 16 + (uint32_t)y0 * SCR_W, dst, (uint32_t)rows * SCR_W);
}
extern uint8_t *woodBuf;
const uint8_t *woodRows(int y0) { return planeMap ? planeMap + (woodOff - planesOff) + 16 + (uint32_t)y0 * SCR_W : woodBuf; }   // a strip of the wood (either core)

const char *pictureCommand(char *line) {
  if (strcasecmp(line, "INFO") == 0) {           // PICS slots width height id1 id2 ...
    static char info[128];
    int n = snprintf(info, sizeof(info), "PICS %u %u %u", picSlots, SCR_W, SCR_H);
    for (uint8_t i = 0; i < picSlots; i++) n += snprintf(info + n, sizeof(info) - n, " %lx", (unsigned long)(picW[i] == SCR_W ? picId[i] : 0));   // made the other way round: send again
    return info;
  }
  if (strncasecmp(line, "IMG ", 4) == 0) {       // start a picture: slot, JPEG size, picture id
    unsigned slot; unsigned long len, id;
    if (!picPart || sscanf(line + 4, "%u %lu %lx", &slot, &len, &id) != 3 || slot >= picSlots || !len || len > STAGE_SIZE || !id) return "ERR";
    picId[slot] = 0;                             // stop showing the old picture
    upSlot = slot; upLen = len; upId = id; upPos = 0;
    esp_partition_erase_range(picPart, stageOff, (len + 4095) & ~4095UL);   // only what this picture needs
    uploading = true; upLast = millis();
    galFlashKey = 0;                             // the galaxy picture shares this space: work it out again afterwards
    return "READY";
  }
  if (line[0] == 'D' && line[1] == ' ' && uploading) {   // a piece of the JPEG, in base64
    uint8_t data[200];
    int n = strlen(line + 2) <= 264 ? unbase64(line + 2, data) : -1;
    if (n < 0 || upPos + n > upLen) { uploading = false; return "ERR data"; }
    esp_partition_write(picPart, stageOff + upPos, data, n);
    upPos += n; upLast = millis();
    return "K";
  }
  if (strcasecmp(line, "END") == 0 && uploading) return finishPicture();
  return NULL;
}
#else
void beginPictures() {}
bool crossAvailable() { return false; }
void prepareCross() {}
void readCrossRows(int y0, int rows) {}
const uint8_t *planeMap = NULL;
const int8_t *edgeRows(int y0) { return edgeBuf; }
extern uint8_t *woodBuf;
const uint8_t *woodRows(int y0) { return woodBuf; }
void readEdgeRow(int y, int8_t *dst) {}
bool woodPlaneReady(uint32_t key) { return true; }
void woodPlaneBegin() {}
void woodPlaneRow(int y, const uint8_t *row) {}
void woodPlaneEnd(uint32_t key) {}
void readWoodRows(int y0, int rows, uint8_t *dst) {}
int  picturesAvailable() { return 0; }
bool isPicture(uint8_t s) { return false; }
void readPicture(uint8_t s, int y0, int rows, uint16_t *dst) {}
bool pausedForUpload() { return false; }
const char *pictureCommand(char *line) { return strcasecmp(line, "INFO") == 0 ? "PICS 0" : NULL; }
#endif

// ---------- live tuning over USB serial (and Bluetooth below) ----------
// Command: SET radius oval arms twist speed sparks drift core rim brightness style ripples ripspeed glow stars fade count core2 rim2 core3 rim3 core4 rim4 fadesecs rimsmooth
//              [scenecount scene1..scene8 holdsecs scenefade [framepct [crossw beam bar [space1..space4 [crossfill [ripple [portrait [tone [warm]]]]]]]]]   (reply: OK or ERR)
//          scenes: 255 the portal, 0-7 pictures, 128-135 portal around a picture, 200-216 another style (200 + style number)
// Pictures: INFO, then IMG slot bytes id / D base64... / END   (see "pictures" above)
char cmd[384];
uint16_t cmdLen = 0;

uint32_t rebootAt = 0;                   // set by the REBOOT command

const char* handleCommand(char *line) {   // returns the reply to send back
  if (strcasecmp(line, "TAP") == 0) { tapCount++; return "OK"; }   // same as tapping the screen: the next style (or scene)
  if (strncasecmp(line, "SET ", 4) == 0) {
    float v[58];
    uint8_t n = 0;
    char *p = strtok(line + 4, " ");
    while (p && n < 58) { v[n++] = atof(p); p = strtok(NULL, " "); }
    if (n == 25 || n == 36 || n == 37 || n == 40 || n == 44 || n == 45 || n == 46 || n == 47 || n == 48 || n == 49 || n == 50 || n == 54 || n == 58) {
      Saved s = { BUILD_ID, v[0], v[1], v[3], v[4], (uint8_t)v[2], (uint8_t)v[5], (uint8_t)v[6], (uint32_t)v[7], (uint32_t)v[8], (uint8_t)v[9], (uint8_t)v[10], (uint8_t)v[11], v[12], v[13], (uint8_t)v[14], (uint8_t)v[15], (uint8_t)v[16] };
      for (int k = 0; k < 6; k++) s.fadeCols[k] = (uint32_t)v[17 + k];
      s.fadeSecs = v[23];
      s.rimSmooth = (uint8_t)v[24];
      s.sceneCount = SCENE_COUNT; s.holdSecs = HOLD_SECS; s.sceneFade = SCENE_FADE; s.framePct = FRAME_PCT;
      s.crossW = CROSS_W; s.beam = BEAM; s.bar = BAR;
      for (int k = 0; k < 8; k++) s.scenes[k] = SCENES[k];
      for (int k = 0; k < 4; k++) s.spaceCols[k] = n >= 44 ? (uint32_t)v[40 + k] : SPACE_COLS[k];
      s.crossFill = n >= 45 ? (uint8_t)v[44] : CROSS_FILL;
      s.crossRipple = n >= 46 ? (uint8_t)v[45] : CROSS_RIPPLE;
      s.portrait = n >= 47 ? (uint8_t)v[46] : (uint8_t)((wantPortrait ? 1 : 0) | (wantFlip ? 2 : 0));   // portrait / landscape (screens that can turn)
      s.tone = n >= 48 ? (uint8_t)v[47] : TONE;                          // colour depth
      s.warm = n >= 49 ? (uint8_t)v[48] : WARM;                          // warmth
      s.tapOff = n >= 50 ? (v[49] ? 0 : 1) : TAP_OFF;                    // tap for next scene (touchscreens)
      s.fdLen = n >= 54 ? (uint8_t)v[50] : FD_LEN; s.fdStars = n >= 54 ? (uint8_t)v[51] : FD_STARCNT;   // Full day settings
      s.fdClouds = n >= 54 ? (uint8_t)v[52] : FD_CLOUDS; s.fdGlow = n >= 54 ? (uint8_t)v[53] : FD_GLOW;
      if (n >= 36) {
        s.sceneCount = (uint8_t)v[25];
        for (int k = 0; k < 8; k++) s.scenes[k] = (uint8_t)v[26 + k];
        s.holdSecs = v[34]; s.sceneFade = v[35];
      }
      if (n >= 37) s.framePct = (uint8_t)v[36];
      if (n >= 40) { s.crossW = (uint8_t)v[37]; s.beam = (uint8_t)v[38]; s.bar = (uint8_t)v[39]; }
      clampSettings(s);                  // anything out of range is brought back inside instead of refusing the update
      if (valid(s)) {
        if (n == 58) { for (int j = 0; j < 4; j++) pendRipC[j] = (uint32_t)v[54 + j] & 0xFFFFFF; pendRip = true; }   // Gradient ripple colours
        pendingSettings = s;
        havePending = true;              // the drawing loop picks it up before the next frame
        return "OK";
      }
    }
    return "ERR";
  }
  if (strncasecmp(line, "SCN ", 4) == 0) {   // SCN k radius oval arms twist speed sparks drift core rim bright ripples ripspeed glow stars rimsmooth space1..4 style crossfill ripple beam crossw bar  (or SCN k OFF)
    float v[34];                         // no reply: older boards ignore it the same way
    uint8_t n = 0; bool off = false;
    char *p = strtok(line + 4, " ");
    while (p && n < 34) { if (strcasecmp(p, "OFF") == 0) off = true; v[n++] = atof(p); p = strtok(NULL, " "); }
    int k = n ? (int)v[0] : -1;
    if (k < 0 || k > 7) return NULL;
    if (off || (n < 26 || n > 33) || v[20] > 17 || !validFill((uint8_t)v[21])) { pendHas[k] = 0; scenePending = true; return NULL; }
    Look &L = pendLook[k];
    L.radius = clampf(v[1], 6, RADIUS_MAX); L.oval = clampf(v[2], 1, 2); L.arms = clampb((uint8_t)v[3], 1, 8);
    L.twist = clampf(v[4], 0, 6); L.speed = clampf(v[5], 0, 0.4f); L.sparks = min((int)v[6], MAX_SPARKS); L.drift = v[7] ? 1 : 0;
    L.core = (uint32_t)v[8] & 0xFFFFFF; L.rim = (uint32_t)v[9] & 0xFFFFFF; L.bright = clampb((uint8_t)v[10], 10, 100);
    L.ripples = min((int)v[11], 6); L.ripSpeed = clampf(v[12], 0.03f, 0.3f); L.glow = clampf(v[13], 0.3f, 0.9f);
    L.stars = clampb((uint8_t)v[14], 1, 6); L.rimSmooth = min((int)v[15], 100);
    for (int j = 0; j < 4; j++) L.spaceCols[j] = (uint32_t)v[16 + j] & 0xFFFFFF;
    L.fadeOn = 0;                        // a scene's own colours don't fade through the colour sets
    L.style = (uint8_t)v[20]; L.crossFill = (uint8_t)v[21]; L.crossRipple = min((int)v[22], 10);
    L.beam = clampb((uint8_t)v[23], 5, 30); L.crossW = clampb((uint8_t)v[24], 25, 100); L.bar = clampb((uint8_t)v[25], 20, 50);
    for (int j = 0; j < 4; j++) L.ripC[j] = n >= 30 ? (uint32_t)v[26 + j] & 0xFFFFFF : RIP_C[j];   // Gradient ripple colours
    int base = n >= 30 ? 30 : 26, tail = n - base;   // ... [rimw [crossout [crosscol]]]
    L.rimW = tail >= 1 ? (uint8_t)constrain((int)v[base], 25, 200) : RIM_W;   // Rim thickness
    L.crossOut = tail >= 2 && validOut((uint8_t)v[base + 1]) ? (uint8_t)v[base + 1] : CROSS_OUT;   // Background
    L.crossCol = tail >= 3 ? ((uint32_t)v[base + 2] > 0xFFFFFF ? 0x1000000 : (uint32_t)v[base + 2]) : CROSS_COL;   // Cross colour
    pendHas[k] = 1; scenePending = true;
    return NULL;
  }
  if (strncasecmp(line, "RIM ", 4) == 0) {   // RIM percent: Rim thickness (no reply; it's applied with the SET that follows)
    pendRimW = (uint8_t)constrain(atoi(line + 4), 25, 200); pendRim = true; return NULL;
  }
  if (strncasecmp(line, "XOUT ", 5) == 0) {   // XOUT style: what's outside a glowing cross (no reply; applied with the SET that follows)
    int o = atoi(line + 5); if (o >= 0 && o <= 255 && validOut((uint8_t)o)) { pendOut = (uint8_t)o; pendXout = true; }
    return NULL;
  }
  if (strncasecmp(line, "XCOL ", 5) == 0) {   // XCOL rgb: the cross outline colour (16777216: the main colours; no reply, applied with the SET that follows)
    long c = atol(line + 5); pendCol = (c < 0 || c > 0xFFFFFF) ? 0x1000000 : (uint32_t)c; pendXcol = true;
    return NULL;
  }
  if (strcasecmp(line, "PING") == 0) return "PORTAL";
#if defined(ESP32)
  if (strcasecmp(line, "REBOOT") == 0) { rebootAt = millis() + 300; return "OK"; }   // restart shortly, after the reply goes out
#endif
  return pictureCommand(line);
}

void serialPoll(bool quick) {            // quick: between strips, answer settings at once (pictures wait for the end of the frame)
  while (Serial.available()) {
    if (quick) {
      char f = cmdLen ? cmd[0] : (char)Serial.peek();
      if (pausedForUpload() || !(f == 'S' || f == 's' || f == 'P' || f == 'p' || f == '\n' || f == '\r')) return;
    }
    char c = Serial.read();
    if (c == '\n' || c == '\r') {
      if (cmdLen) {
        cmd[cmdLen] = 0;
        const char *reply = handleCommand(cmd);
        if (reply) Serial.println(reply);
        cmdLen = 0;
        if (quick) return;
      }
    } else if (cmdLen < sizeof(cmd) - 1) {
      cmd[cmdLen++] = c;
    }
  }
}
void readSerial() { serialPoll(false); }
void readSerialQuick() { serialPoll(true); }

// ---------- Bluetooth tuning (ESP32 boards with Bluetooth) ----------
// The board shows up as "Vortex Portal". In the Studio (Chrome on Android or a
// computer), tap "Connect over Bluetooth". Same commands as USB.
#if 0                                    // Bluetooth is switched off: it needed too much memory (USB only)
  #define HAS_BLE 1
#else
  #define HAS_BLE 0
#endif

#if HAS_BLE
#include <BLEDevice.h>
#include <BLEServer.h>
#include <BLE2902.h>

#define BLE_SERVICE "6e400001-b5a3-f393-e0a9-e50e24dcca9e"
#define BLE_RX_CHAR "6e400002-b5a3-f393-e0a9-e50e24dcca9e"   // phone writes commands here
#define BLE_TX_CHAR "6e400003-b5a3-f393-e0a9-e50e24dcca9e"   // board replies here (notify)

BLECharacteristic *bleTx = NULL;
char bleBuf[384], bleLine[384];
uint16_t bleLen = 0;
volatile bool bleHave = false;

class PortalRx : public BLECharacteristicCallbacks {
  void onWrite(BLECharacteristic *c) {     // runs in the Bluetooth task: just collect the line
    String v = c->getValue().c_str();
    for (unsigned i = 0; i < v.length(); i++) {
      char ch = v[i];
      if (ch == '\n' || ch == '\r') {
        if (bleLen && !bleHave) { bleBuf[bleLen] = 0; memcpy(bleLine, bleBuf, bleLen + 1); bleHave = true; }
        bleLen = 0;
      } else if (bleLen < sizeof(bleBuf) - 1) {
        bleBuf[bleLen++] = ch;
      }
    }
  }
};

class PortalServer : public BLEServerCallbacks {
  void onDisconnect(BLEServer *s) { BLEDevice::startAdvertising(); }   // let the phone reconnect
};

void beginBluetooth() {
  BLEDevice::init("Vortex Portal");
  BLEServer *srv = BLEDevice::createServer();
  srv->setCallbacks(new PortalServer());
  BLEService *svc = srv->createService(BLE_SERVICE);
  bleTx = svc->createCharacteristic(BLE_TX_CHAR, BLECharacteristic::PROPERTY_NOTIFY);
  bleTx->addDescriptor(new BLE2902());
  BLECharacteristic *rx = svc->createCharacteristic(BLE_RX_CHAR, BLECharacteristic::PROPERTY_WRITE | BLECharacteristic::PROPERTY_WRITE_NR);
  rx->setCallbacks(new PortalRx());
  svc->start();
  BLEAdvertising *adv = BLEDevice::getAdvertising();
  adv->addServiceUUID(BLE_SERVICE);
  adv->setScanResponse(true);
  BLEDevice::startAdvertising();
}

void readBluetooth() {                    // handle a received line in the main loop
  if (!bleHave) return;
  const char *reply = handleCommand(bleLine);
  bleHave = false;
  if (reply && bleTx) {                   // sent in 20-byte pieces (the smallest Bluetooth packet), ending with a newline
    char out[136];
    int len = snprintf(out, sizeof(out), "%s\n", reply);
    for (int i = 0; i < len; i += 20) {
      bleTx->setValue((uint8_t *)out + i, min(20, len - i));
      bleTx->notify();
      delay(3);
    }
  }
}
#endif

// ---------- scenes: the portal and pictures shown in turn, with fades ----------
uint8_t sceneA = PORTAL, sceneB = PORTAL;
int     sceneMix = 0;                    // 0 = all scene A, 256 = all scene B
float   ageA = 0, ageB = 0;              // seconds since each scene started to appear

// ---------- each scene's own settings ----------
void grabLook(Look &L) {                 // the settings in use now
  L.radius = RADIUS; L.oval = OVAL; L.twist = TWIST; L.speed = SPEED; L.ripSpeed = RIP_SPEED; L.glow = GLOW_SIZE;
  L.core = COLOR_CORE; L.rim = COLOR_RIM; for (int k = 0; k < 4; k++) L.spaceCols[k] = SPACE_COLS[k];
  L.arms = ARMS; L.sparks = NUM_SPARKS; L.drift = DRIFT; L.bright = BRIGHTNESS; L.ripples = RIPPLES; L.stars = STARS; L.rimSmooth = RIM_SMOOTH; L.fadeOn = FADE_ON;
  L.style = STYLE; L.crossFill = CROSS_FILL; L.crossRipple = CROSS_RIPPLE; L.beam = BEAM; L.crossW = CROSS_W; L.bar = BAR;
  for (int j = 0; j < 4; j++) L.ripC[j] = RIP_C[j];
  L.rimW = RIM_W; L.crossOut = CROSS_OUT; L.crossCol = CROSS_COL;
}
void putLook(const Look &L) {
  RADIUS = L.radius; OVAL = L.oval; TWIST = L.twist; SPEED = L.speed; RIP_SPEED = L.ripSpeed; GLOW_SIZE = L.glow;
  COLOR_CORE = L.core; COLOR_RIM = L.rim; for (int k = 0; k < 4; k++) SPACE_COLS[k] = L.spaceCols[k];
  ARMS = L.arms; NUM_SPARKS = L.sparks; DRIFT = L.drift; BRIGHTNESS = L.bright; RIPPLES = L.ripples; STARS = L.stars; RIM_SMOOTH = L.rimSmooth; FADE_ON = L.fadeOn;
  STYLE = L.style; CROSS_FILL = L.crossFill; CROSS_RIPPLE = L.crossRipple; BEAM = L.beam; CROSS_W = L.crossW; BAR = L.bar;
  for (int j = 0; j < 4; j++) RIP_C[j] = L.ripC[j];
  RIM_W = L.rimW >= 25 && L.rimW <= 200 ? L.rimW : 100;   // (a cross scene: its cross is drawn as the main style)
  CROSS_OUT = validOut(L.crossOut) ? L.crossOut : 255;
  CROSS_COL = L.crossCol > 0xFFFFFF ? 0x1000000 : L.crossCol;
}
void useSceneLook(int id) {              // load a scene's settings (or the main ones) and rebuild what depends on them
  if (id == curLook) return;
  putLook(id < 0 ? mainLook : SCENE_LOOKS[id]);
  if (id == -3) { float pr = min(SCR_W, SCR_H) / 2 - 1; if (RADIUS > pr) RADIUS = pr; }   // the cross size would be too big for a portal
  if (spaceLUT) buildSpaceLUT();
  buildParams();
  buildPalette();
  resetSparks();
  curLook = id;
}
void saveScenes() {
  SceneSaved z; z.id = BUILD_ID ^ 0x5CE20007UL;   // (^: this layout of scene settings)
  for (int k = 0; k < 8; k++) { z.has[k] = SCENE_HAS[k]; z.look[k] = SCENE_LOOKS[k]; }
  EEPROM.put(128, z);
#if defined(ESP32) || defined(ESP8266) || defined(ARDUINO_ARCH_RP2040)
  EEPROM.commit();
#endif
}
void saveExtra() {
  Extra x; x.id = BUILD_ID ^ 0xE7A00005UL; for (int j = 0; j < 4; j++) x.ripC[j] = RIP_C[j]; x.rimW = RIM_W; x.crossOut = CROSS_OUT; x.crossCol = CROSS_COL;
  EEPROM.put(EXTRA_AT, x);
#if defined(ESP32) || defined(ESP8266) || defined(ARDUINO_ARCH_RP2040)
  EEPROM.commit();
#endif
}
void loadScenes() {                      // after loadSettings()
  { Extra x; EEPROM.get(EXTRA_AT, x); if (x.id == (BUILD_ID ^ 0xE7A00005UL)) { for (int j = 0; j < 4; j++) RIP_C[j] = x.ripC[j] & 0xFFFFFF; if (x.rimW >= 25 && x.rimW <= 200) RIM_W = x.rimW; if (validOut(x.crossOut)) CROSS_OUT = x.crossOut; CROSS_COL = x.crossCol > 0xFFFFFF ? 0x1000000 : x.crossCol; } }
  grabLook(mainLook); curLook = -1;
  SceneSaved z; EEPROM.get(128, z);
  if (z.id == (BUILD_ID ^ 0x5CE20007UL)) for (int k = 0; k < 8; k++) {
    const Look &L = z.look[k];
    bool ok = z.has[k] == 1 && L.radius >= 6 && L.radius <= RADIUS_MAX && L.oval >= 1 && L.oval <= 2 && L.arms >= 1 && L.arms <= 8 && L.twist >= 0 && L.twist <= 6 &&
              L.speed >= 0 && L.speed <= 0.4f && L.sparks <= MAX_SPARKS && L.bright >= 10 && L.bright <= 100 && L.stars >= 1 && L.stars <= 6 && L.ripples <= 6 &&
              L.ripSpeed >= 0.03f && L.ripSpeed <= 0.3f && L.glow >= 0.3f && L.glow <= 0.9f && L.rimSmooth <= 100 &&
              L.style <= 17 && validFill(L.crossFill) && L.crossRipple <= 10 && L.beam >= 5 && L.beam <= 30 && L.crossW >= 25 && L.crossW <= 100 && L.bar >= 20 && L.bar <= 50;
    SCENE_HAS[k] = ok; if (ok) SCENE_LOOKS[k] = L;
  }
  for (int k = 0; k < 8; k++) { pendHas[k] = SCENE_HAS[k]; pendLook[k] = SCENE_LOOKS[k]; }
}
inline int lookOf(int idx, uint8_t code) {
  if (idx >= 0 && idx < 8 && SCENE_HAS[idx] && isStyleScene(code)) return idx;   // its own settings
  if (isStyleScene(code) && !isCrossSt(code - 200) && isCrossSt(mainLook.style)) return -3;   // another style while the main one is a cross: portal-sized
  return -1;
}
void pickSceneLook() {                   // load the settings of the scene showing; scenes with different settings fade through black
  int ia = lookOf(idxA, sceneA), ib = lookOf(idxB, sceneB);
  dipK = 256;
  if (sceneMix > 0 && ia != ib) {
    if (sceneMix >= 128) { sceneA = sceneB; ageA = ageB; ia = ib; dipK = (sceneMix - 128) * 2; }
    else dipK = (128 - sceneMix) * 2;
    sceneB = sceneA; ageB = ageA; sceneMix = 0;
  } else if (sceneMix >= 128 && sceneA == sceneB) ia = ib;
  useSceneLook(ia);
  if (isStyleScene(sceneA) && isCrossSt(sceneA - 200)) sceneA = PORTAL;   // a cross scene: its cross is now the main style, so draw it as that
  if (isStyleScene(sceneB) && isCrossSt(sceneB - 200)) sceneB = PORTAL;   // (one with no settings of its own shows the main style)
}


const uint8_t TAP_STYLES[] = { 0, 1, 2, 3, 4, 6, 14, 15, 16 };   // styles a tap steps through (after your own)
const int TAP_N = sizeof(TAP_STYLES);

void onTap() {
#if TAP_PIN >= 0
  if (SCENE_COUNT >= 2 && !TAP_OFF) {    // tap for next scene: only a tap moves on
    if (tapCur != tapNext) tapCur = tapNext;                         // (still fading: finish that one first)
    tapNext = (tapCur + 1) % SCENE_COUNT; tapSceneAt = millis();
    return;
  }
#endif
  if (SCENE_COUNT >= 2) {                // scenes: go on to the next one now
    float per = HOLD_SECS + SCENE_FADE;
    float pos = fmodf((millis() + sceneShiftMs) / 1000.0f, per * SCENE_COUNT);
    float w = pos - min((int)(pos / per), SCENE_COUNT - 1) * per;
    sceneShiftMs += (uint32_t)(((w < HOLD_SECS && SCENE_FADE > 0 ? HOLD_SECS : per) - w) * 1000) + 1;   // holding: start the fade; fading: finish it
    return;
  }
  uint8_t own = SCENE_COUNT == 1 ? SCENES[0] : PORTAL;   // your own style (or your one scene)
  uint8_t shown = tapMode ? tapTo : own;
  int k = tapIdx;
  do { k = k + 1 >= TAP_N ? -1 : k + 1; } while (k >= 0 && TAP_STYLES[k] == STYLE && own == PORTAL);   // (skip the style already yours)
  tapIdx = k;
  tapFrom = shown; tapTo = k < 0 ? own : 200 + TAP_STYLES[k];
  tapAt = millis(); tapMode = true;
}

void updateScene() {
  static uint8_t tapSeen = 0;
  if (tapCount != tapSeen) { tapSeen = tapCount; onTap(); }
  if (tapMode && SCENE_COUNT < 2) {      // a style picked by tapping: a quick fade into it
    uint32_t el = millis() - tapAt;
    idxA = idxB = (SCENE_COUNT == 1 && tapTo == SCENES[0]) ? 0 : -1;
    if (tapFrom != tapTo) idxA = (SCENE_COUNT == 1 && tapFrom == SCENES[0]) ? 0 : -1;
    if (el >= 800) { sceneA = sceneB = tapTo; sceneMix = 0; idxA = idxB; ageA = ageB = el / 1000.0f + 1; if (tapIdx < 0) tapMode = false; }
    else { float f = el / 800.0f; f = f * f * (3 - 2 * f); sceneA = tapFrom; sceneB = tapTo; sceneMix = (int)(f * 256); ageA = el / 1000.0f + 1; ageB = el / 1000.0f; }
    return;
  }
  tapMode = false;
  if (SCENE_COUNT == 0) { sceneA = sceneB = PORTAL; sceneMix = 0; idxA = idxB = -1; return; }
  if (SCENE_COUNT == 1) { sceneA = sceneB = SCENES[0]; sceneMix = 0; ageA = millis() / 1000.0f; idxA = idxB = 0; return; }
#if TAP_PIN >= 0
  if (!TAP_OFF) {                        // tap for next scene: each scene stays until the screen is tapped
    if (tapCur >= SCENE_COUNT || tapNext >= SCENE_COUNT) tapCur = tapNext = 0;
    float el = (millis() - tapSceneAt) / 1000.0f;
    if (tapCur != tapNext && el >= 1) tapCur = tapNext;              // a one-second fade into the next scene
    sceneA = SCENES[tapCur]; sceneB = SCENES[tapNext]; idxA = tapCur; idxB = tapNext;
    ageA = el + 1; ageB = el;
    if (tapCur == tapNext) sceneMix = 0;
    else { float f = el * el * (3 - 2 * el); sceneMix = (int)(f * 256); }
    return;
  }
#endif
  float per = HOLD_SECS + SCENE_FADE;
  float pos = fmodf((millis() + sceneShiftMs) / 1000.0f, per * SCENE_COUNT);
  int i = min((int)(pos / per), SCENE_COUNT - 1);
  float w = pos - i * per;
  sceneA = SCENES[i];
  sceneB = SCENES[(i + 1) % SCENE_COUNT];
  idxA = i; idxB = (i + 1) % SCENE_COUNT;
  ageA = w + SCENE_FADE;                 // it began fading in during the previous scene
  ageB = max(0.0f, w - HOLD_SECS);
  if (w < HOLD_SECS || SCENE_FADE <= 0) sceneMix = 0;
  else { float f = (w - HOLD_SECS) / SCENE_FADE; f = f * f * (3 - 2 * f); sceneMix = (int)(f * 256); }
}

// "Portal around a picture": the picture shows through the portal's centre. When the scene
// starts, the portal forms at its outer edge and closes in until it covers FRAME_PCT.
inline bool isFramed(uint8_t s) { return s >= 128 && isPicture(s - 128); }

inline uint16_t mix565(uint16_t x, uint16_t y, int m) {
  int r  = ((x >> 11) * (256 - m) + (y >> 11) * m) >> 8;
  int g  = (((x >> 5) & 63) * (256 - m) + ((y >> 5) & 63) * m) >> 8;
  int bl = ((x & 31) * (256 - m) + (y & 31) * m) >> 8;
  return (r << 11) | (g << 5) | bl;
}

void framePicture(uint8_t pic, float age, int y0, int rows, uint16_t *dst) {
  static uint16_t line[SCR_WMAX];
  float close = SCENE_FADE + 1.5f;                            // seconds to close in (keeps going after the fade)
  float k = min(1.0f, age / close); k = k * k * (3 - 2 * k);
  float hole = RADIUS * (1.0f - FRAME_PCT / 100.0f * k);      // radius where the picture shows
  int16_t alpha[256];                                          // soft 8-pixel edge
  for (int r = 0; r < 256; r++) { float a = (hole + 4 - r) / 8.0f; alpha[r] = a <= 0 ? 0 : a >= 1 ? 256 : (int16_t)(a * 256); }
  for (int y = y0; y < y0 + rows; y++) {
    int qy = y < QY ? QY - 1 - y : y - QY;
    if (qy > hole + 4) continue;                                // this row is all portal
    readPicture(pic, y, 1, line);
    uint16_t *d = dst + (y - y0) * SCR_W;
    for (int x = 0; x < SCR_W; x++) {
      int m = alpha[rT[qy * TQX + colMap[x]]];
      if (m) d[x] = m == 256 ? line[x] : mix565(d[x], line[x], m);
    }
  }
}

HOT void dimStrip(uint16_t *a, int n, int k) {   // a = a * k / 256
  for (int i = 0; i < n; i++) { uint16_t x = a[i]; a[i] = ((((x >> 11) * k) >> 8) << 11) | (((((x >> 5) & 63) * k) >> 8) << 5) | (((x & 31) * k) >> 8); }
}
HOT void blendStrip(uint16_t *a, const uint16_t *b, int n, int m) {   // a = a + (b - a) * m / 256
  for (int i = 0; i < n; i++) a[i] = mix565(a[i], b[i], m);
}

void renderStrip(int y0, int rows, uint16_t *strip);
void useLook(int L, bool cross);
int  lookA = 0, lookB = 0;               // the style each scene draws (another style, or the main one)
bool crossA = false, crossB = false;     // and whether it's the main cross
uint8_t outLook = 255;                   // this frame: what's drawn outside a glowing cross (255: black)
inline bool isGridSpace(int L) { return L == 4 || (L >= 14 && L <= 16); }

HOT void drawScene(uint8_t s, float age, int y0, int rows, uint16_t *dst, int L, bool cross) {
  if (isPicture(s)) { readPicture(s, y0, rows, dst); return; }
  useLook(L, cross);
  renderStrip(y0, rows, dst);
  if (isFramed(s)) framePicture(s - 128, age, y0, rows, dst);
}

HOT void composeStrip(int y0, int rows, uint16_t *dst) {
  bool fading = sceneMix > 0 && sceneA != sceneB;
  if (!fading || !picBuf) {
    if (sceneMix >= 128) drawScene(sceneB, ageB, y0, rows, dst, lookB, crossB); else drawScene(sceneA, ageA, y0, rows, dst, lookA, crossA);
    if (dipK < 256) dimStrip(dst, rows * SCR_W, dipK);   // fading through black between scenes with their own settings
    return;
  }
  drawScene(sceneA, ageA, y0, rows, dst, lookA, crossA);
  uint16_t *fb = CORE_ID() && picBuf2 ? picBuf2 : picBuf;   // each core fades in its own buffer
  drawScene(sceneB, ageB, y0, rows, fb, lookB, crossB);
  blendStrip(dst, fb, rows * SCR_W, sceneMix);
}

// ---------- one frame ----------
uint8_t look = 0;                        // the style being drawn (crosses fall back to Vortex without flash storage)
extern bool woodOn; extern int woodPulse; void prepareWood();   // Wooden cross (below)
extern float cloudDrift; bool cloudMemory(); void prepareClouds(int kind, int amount); void prepareFullDay();
extern float ripplePh; extern uint8_t crossRipT[128]; void buildCrossRipple();

inline void polarAt(int x, int y, int cyc, int &r, int &a) {   // distance and angle (0-255) from (centre column, row cyc)
  int cy = y < cyc ? cyc - 1 - y : y - cyc, a0;
  bool low = y >= cyc;
  if (cy < TQY) { int ci = cy * TQX + colMap[x]; r = rT[ci]; a0 = aT[ci]; }
  else {                                // below the tables: work it out
    float fx = colMap[x] + 0.5f, fy = cy + 0.5f;
    r = min(255, (int)lroundf(sqrtf(fx * fx + fy * fy)));
    a0 = (int)lroundf(atan2f(fy, fx) / (PI / 2) * 64);
  }
  a = (x >= QX ? (low ? a0 : 256 - a0) : (low ? 128 - a0 : 128 + a0)) & 255;
}

// ---------- Nebula, Wormhole, Meteor Shower ----------
uint8_t  *noise8 = NULL;                // smooth value noise for the gas clouds (allocated when first needed)
double   spaceT = 0;                    // space clock (runs on its own so it never jumps)
float    spU = 1, spExt = 118;          // space units per pixel, edge of the picture in space units
float    nbCa = 1, nbSa = 0, nbO1 = 0, nbO2 = 0, nbO3 = 0;
int      spTw = 0, whPh = 0;
#define SP_GRID ((SCR_WMAX / 2 + 2) * (STRIP / 2 + 3))   // gas worked out every 2 or 4 pixels, smoothed in between (one strip at a time)
uint8_t  *spH = NULL, *spV = NULL, *spX = NULL;
uint8_t  *spH1 = NULL, *spV1 = NULL, *spX1 = NULL;   // a second gas grid, so core 1 can draw space styles at the same time
// Both cores share the gas grid rows they work out (each row once per frame instead of once per piece of a strip)
#define  SP_RING_W (SCR_WMAX / 3 + 3)
uint8_t  *ringH = NULL, *ringV = NULL, *ringX = NULL;
int      ringN = 0;
bool     ringTried = false;
volatile uint32_t ringTag[48];
uint32_t spFrame = 1;
// Galaxy: a Hubble-style spiral (like M51, M100, NGC 4414)
#define GAL_TILT 0.86f                   // how tilted toward you (1 = face on)
#define GAL_PA   -0.55f                  // which way it points
#define GAL_ZOOM 0.7f                    // size (smaller = bigger galaxy)
float    gax = 1, gbx = 0, gay = 0, gby = 1, galK = 9;   // galK: how tightly the arms wind (the Spiral setting)
// The galaxy is one picture turning in its own plane: worked out once on a polar grid (per Spiral setting), then looked up
#define  GT_R  64
#define  GT_DR 1.65f
uint8_t  *gtH = NULL, *gtV = NULL, *gtX = NULL;
uint32_t galFlashKey = 0;                // the galaxy picture kept in flash (when there's no room for it in memory)
bool     gtInFlash = false;
int      gtA = 0, gtS = 1;                // gtS: 1 = three separate pictures (memory), 3 = side by side per point (flash: one read instead of three)
float    gtK = -1, gpx = 1, gqx = 0, gpy = 0, gqy = 1, gRot = 0;
bool     gtReady = false;
uint8_t  powT[256], whRingT[256], whNearT[256];
int16_t  whOffT[256], whCoreT[256];
int32_t  whHueT[256];
uint16_t whRing133T[256], spokeVT[256];  // Wormhole, ready-multiplied for the per-pixel loop
uint8_t  spokeHT[256], whHue8T[256];
int      whCoreR = 0;                    // rows nearer the centre than this show the glowing far end
struct Meteor { float x, y, len; uint8_t hue; };
Meteor   meteors[30];
int      meteorCount = 7;

void buildNoise() {
  uint32_t sd = 11;
  for (int i = 0; i < 64 * 64; i++) { sd = (sd * 1103515245UL + 12345UL) & 0x7fffffffUL; noise8[i] = sd >> 23; }
  for (int i = 0; i < 256; i++) powT[i] = (uint8_t)(255 * powf(i / 255.0f, 1.6f));
}

void ringMemory() {                     // optional: the shared grid rows (only while Galaxy, Nebula or Meteor Shower is showing)
  if (ringTried) return;
  ringTried = true;
  int n = 2 * STRIP / 3 + 8; if (n > 48) n = 48;
  ringH = (uint8_t *)malloc(n * SP_RING_W); ringV = (uint8_t *)malloc(n * SP_RING_W); ringX = (uint8_t *)malloc(n * SP_RING_W);
  if (ringH && ringV && ringX) { ringN = n; for (int i = 0; i < 48; i++) ringTag[i] = 0xFFFFFFFFUL; }
  else { free(ringH); free(ringV); free(ringX); ringH = ringV = ringX = NULL; ringN = 0; }
}
void freeRing() {                       // give the room back to the other styles
  ringN = 0; free(ringH); free(ringV); free(ringX); ringH = ringV = ringX = NULL; ringTried = false;
}

bool spaceMemory() {                    // reserved at startup (allocBuffers), so every space style always has room
  if (spaceLUT && noise8 && spX) return true;
  if (!spH) spH = (uint8_t *)malloc(SP_GRID);
  if (!spV) spV = (uint8_t *)malloc(SP_GRID);
  if (!spX) spX = (uint8_t *)malloc(SP_GRID);
  if (!spH || !spV || !spX) return false;
#if defined(ESP32) && !CONFIG_FREERTOS_UNICORE
  if (!spH1) spH1 = (uint8_t *)malloc(SP_GRID);   // optional: without it, core 0 draws these styles alone
  if (!spV1) spV1 = (uint8_t *)malloc(SP_GRID);
  if (!spX1) spX1 = (uint8_t *)malloc(SP_GRID);
#endif
  if (!spaceLUT) { spaceLUT = (uint16_t *)malloc(64 * 64 * 2); if (spaceLUT) buildSpaceLUT(); }
  if (!noise8) { noise8 = (uint8_t *)malloc(64 * 64); if (noise8) buildNoise(); }
  return spaceLUT && noise8;
}

inline float smf(float x) { x = x < 0 ? 0 : x > 1 ? 1 : x; return x * x * (3 - 2 * x); }

HOT float vn(float x, float y) {            // smooth noise, 0..1, repeats every 64 units
  float xf = floorf(x), yf = floorf(y);
  int xi = (int)xf, yi = (int)yf;
  float fx = x - xf, fy = y - yf;
  fx = fx * fx * (3 - 2 * fx); fy = fy * fy * (3 - 2 * fy);
  int x0 = xi & 63, x1 = (xi + 1) & 63, y0 = (yi & 63) << 6, y1 = ((yi + 1) & 63) << 6;
  float a = noise8[y0 | x0], b = noise8[y0 | x1], c = noise8[y1 | x0], d = noise8[y1 | x1];
  return (a + (b - a) * fx + (c - a) * fy + (a - b - c + d) * fx * fy) * (1 / 255.0f);
}

inline uint8_t to8(float v) { return v <= 0 ? 0 : v >= 1 ? 255 : (uint8_t)(v * 255); }

void galaxyNode(float xr, float yr, uint8_t &h, uint8_t &v, uint8_t &a8) {   // light, colour and "arm" at one point of the galaxy's plane
  float gr = sqrtf(xr * xr + yr * yr), ga = atan2f(yr, xr), lr = logf(gr / 5 + 1);
  float wob = (vn(xr / 16 + 50, yr / 16) - 0.5f) * 1.3f;              // arms wander and break up
  float ph = 2 * ga - galK * lr + wob;
  float c = 0.5f + 0.5f * cosf(ph), c2 = c * c, c4 = c2 * c2, c8 = c4 * c4;
  float b = 0.5f + 0.5f * cosf(2 * ga - galK * 1.12f * lr + 2.3f + wob * 1.5f), b2 = b * b, b6 = b2 * b2 * b2;   // fainter branch arms
  float e = 0.5f + 0.5f * cosf(5 * ga - galK * 1.5f * lr + wob * 2.2f), e2 = e * e, e4 = e2 * e2, e10 = e4 * e4 * e2;   // feathery spurs
  float arm = min(1.0f, 0.7f * c2 + 0.3f * c8 + 0.5f * b6 * smf((gr - 8) / 20) + 0.28f * e10 * smf((gr - 14) / 16));
  float clump = vn(xr / 3.2f, yr / 3.2f) * 0.55f + vn(xr / 8 + 7, yr / 8) * 0.45f;   // star clouds along the arms
  float l = 0.5f + 0.5f * cosf(ph - 0.6f), l2 = l * l, l4 = l2 * l2, l8 = l4 * l4, l16 = l8 * l8;   // dust on the inner edge of each arm
  float lane = l16 * l8 * l4 * l2 * (0.35f + 0.9f * vn(xr / 2.6f + 20, yr / 2.6f));
  float f = 0.5f + 0.5f * cosf(4 * ga - galK * 1.05f * lr + vn(xr / 7 + 31, yr / 7) * 5), f2 = f * f, f8 = f2 * f2 * f2 * f2, f16 = f8 * f8;   // thin dust filaments
  float wisp = f16 * f8 * f2 * 0.8f * smf((gr - 6) / 14) + max(0.0f, vn(xr / 4.5f + 3, yr / 4.5f - 9) - 0.64f) * 1.4f * c;
  float edge = smf((104 - gr) / 44);
  float dust = min(1.0f, lane + wisp) * smf(gr / 14) * edge;
  float q = gr / 6.5f, bulge = expf(-q * q) + expf(-gr / 11) * 0.5f;
  float disk = expf(-gr / 48) * edge, halo = expf(-gr / 22) * 0.32f;
  float cl = clump * clump * 1.6f;
  float lv = bulge + halo + disk * (0.3f + 0.12f * cl + 1.6f * arm * (0.25f + cl));
  lv *= 1 - 0.55f * dust * (1 - min(1.0f, bulge));
  float hue = 0.75f - 0.23f * smf((gr - 14) / 34) + 0.16f * dust;   // yellow-cream core, blue outer arms, brown dust
  h = to8(hue / 2); v = to8(lv); a8 = to8(arm * edge * (1 - dust));
}

HOT float fastAtan2(float y, float x) {     // quick angle, good to about 0.1 degree
  float ax = fabsf(x), ay = fabsf(y), mx = max(ax, ay), mn = min(ax, ay);
  if (mx == 0) return 0;
  float a = mn / mx, q = a * a;
  float r = ((-0.0464964749f * q + 0.15931422f) * q - 0.327622764f) * q * a + a;
  if (ay > ax) r = 1.57079637f - r;
  if (x < 0) r = 3.14159274f - r;
  return y < 0 ? -r : r;
}

bool galaxyTexFlash();
bool galaxyTex() {                      // build the galaxy picture once per Spiral setting
  if (gtInFlash) return galaxyTexFlash();
  if (!gtH) {
    for (int a = 256; a >= 128 && !gtH; a /= 2) {
      gtH = (uint8_t *)malloc(GT_R * a); gtV = (uint8_t *)malloc(GT_R * a); gtX = (uint8_t *)malloc(GT_R * a);
      if (gtH && gtV && gtX) { gtA = a; gtS = 1; }
      else { free(gtH); free(gtV); free(gtX); gtH = gtV = gtX = NULL; }
    }
    if (!gtH) { gtInFlash = true; return galaxyTexFlash(); }   // no room in memory: keep it in flash (read through the cache)
    gtK = -1;
  }
  if (gtK == galK) return true;
  gtK = galK;
  for (int ri = 0; ri < GT_R; ri++)
    for (int ai = 0; ai < gtA; ai++) {
      float gr = ri * GT_DR, an = ai * TWO_PI / gtA;
      int i = ri * gtA + ai;
      galaxyNode(gr * cosf(an), gr * sinf(an), gtH[i], gtV[i], gtX[i]);
    }
  return true;
}

#if HAS_PICS
bool galaxyTexFlash() {                 // the galaxy picture in the end of the staging area, mapped like the cross and the wood
  if (!planeMap) return false;
  const uint32_t GAL_MAGIC = 0x4C414756UL;   // "VGAL"
  uint32_t off = stageOff + crossPlane, room = STAGE_SIZE - crossPlane - 16;
  int a = 3UL * GT_R * 256 <= room ? 256 : 128;
  if (3UL * GT_R * a > room) return false;
  uint32_t key = (uint32_t)lroundf(galK * 1000) * 1024 + a + 2;   // (+2: the points' three values side by side)
  const uint8_t *base = planeMap + (off - planesOff);
  if (galFlashKey != key) {
    const uint32_t *h = (const uint32_t *)base;
    if (!(h[0] == GAL_MAGIC && h[1] == key)) {   // not there yet (or the Spiral setting changed): work it out once and store it
      esp_partition_erase_range(picPart, off, (16 + 3UL * GT_R * a + 4095) & ~4095UL);
      static uint8_t row[3 * 256];
      for (int ri = 0; ri < GT_R; ri++) {
        for (int ai = 0; ai < a; ai++) {
          float gr = ri * GT_DR, an = ai * TWO_PI / a;
          galaxyNode(gr * cosf(an), gr * sinf(an), row[ai * 3], row[ai * 3 + 1], row[ai * 3 + 2]);
        }
        esp_partition_write(picPart, off + 16 + (uint32_t)ri * a * 3, row, a * 3);
        if ((ri & 7) == 7) delay(1);
      }
      uint32_t hd[4] = { GAL_MAGIC, key, 0, 0 };
      esp_partition_write(picPart, off, hd, 16);
    }
    galFlashKey = key;
  }
  gtA = a; gtS = 3;
  gtH = (uint8_t *)(base + 16); gtV = gtH + 1; gtX = gtH + 2;   // (read only)
  return true;
}
// ---------- Nebula (14): worked out once in detail (wisps, haze, dust lanes) and kept in flash; it stays still while its colours cycle ----------
const uint32_t NEBH_MAGIC = 0x4842454EUL, NEBV_MAGIC = 0x5642454EUL;   // "NEBH", "NEBV"
bool     nebReady = false;
uint32_t nebKey = 0, nebHOff = 0, nebVOff = 0;
int      nebHue = 0;                     // how far the colours have moved round
#define NEB_BIG 12
int16_t  nbBX[NEB_BIG], nbBY[NEB_BIG]; float nbBR[NEB_BIG], nbBP[NEB_BIG]; uint8_t nbBW[NEB_BIG], nbBN = 0;   // the bright stars
inline float nbSS(float a, float b, float x) { float t = (x - a) / (b - a); t = t < 0 ? 0 : t > 1 ? 1 : t; return t * t * (3 - 2 * t); }
float nbFbm(float x, float y, int o) { float s = 0, a = 0.5f, n = 0; for (int i = 0; i < o; i++) { s += vn(x, y) * a; n += a; x = x * 2.03f + 17.1f; y = y * 2.03f - 9.7f; a *= 0.5f; } return s / n; }
void nebulaPixel(int x, int y, uint8_t &h, uint8_t &v) {   // same maths as the Studio
  const float Sc = min(SCR_W, SCR_H) / 2.2f, seed = 3.1f;
  float px = (x - SCR_W / 2.0f) / Sc + seed, py = (y - SCR_H / 2.0f) / Sc + seed * 0.7f;
  float qx = nbFbm(px, py, 4), qy = nbFbm(px + 5.2f, py + 1.3f, 4);
  float rx = nbFbm(px + 2.4f * qx + 1.7f, py + 2.4f * qy + 9.2f, 4), ry = nbFbm(px + 2.4f * qx + 8.3f, py + 2.4f * qy + 2.8f, 4);
  float f = nbFbm(px + 2.4f * rx, py + 2.4f * ry, 5);
  float haze = nbSS(0.3f, 0.85f, nbFbm(px * 0.55f + 30, py * 0.55f - 12, 3)) * 0.5f;
  float n2 = nbFbm(px * 2.2f + 2 * rx + 3, py * 2.2f + 2 * ry - 4, 4), rg = 1 - fabsf(2 * n2 - 1), ridge = rg * rg * rg * rg * rg;
  float d = powf(nbSS(0.4f, 0.85f, f), 1.4f) * 1.1f + ridge * 0.5f * nbSS(0.3f, 0.6f, f);   // gas, with thin glowing filaments
  d = max(d, haze * (0.6f + 0.8f * f));
  d *= 1 - 0.8f * nbSS(0.52f, 0.72f, nbFbm(px * 1.4f + 3 * qx + 11, py * 1.4f + 3 * qy - 5, 5));   // dark dust lanes
  float ex = (x - SCR_W / 2.0f) / (SCR_W / 2.0f), ey = (y - SCR_H / 2.0f) / (SCR_H / 2.0f);
  d *= 0.35f + 0.65f * nbSS(1.0f, 0.15f, sqrtf(ex * ex + ey * ey));
  float hue = min(1.0f, max(0.0f, (qx * 0.6f + rx * 0.6f - 0.32f) * 2.4f)) * 32;
  if (d > 0.75f) hue += (d - 0.75f) * 4 * (48 - hue) * 0.6f;   // the brightest knots toward the highlight colour
  h = (uint8_t)constrain((int)lroundf(hue), 0, 63);
  v = (uint8_t)constrain((int)lroundf(powf(min(1.0f, d), 1.15f) * 63), 0, 63);
}
bool prepareNebula() {                  // once per frame while the Nebula shows (the slow part only the first time)
  nebHue = (int)(spaceT * 0.0198) & 63;  // colours move round the four space colours (about 2 minutes at the usual speed)
  if (!picPart || !planeMap || nPlanes < 4) return false;   // no room: the simpler Nebula
  uint32_t key = 2166136261UL;
  uint32_t parts[] = { (uint32_t)SCR_W, (uint32_t)SCR_H, 1 };
  for (uint32_t v : parts) key = (key ^ v) * 16777619UL;
  if (nebReady && key == nebKey) return true;
  nebReady = false;
  int sh = findPlane(NEBH_MAGIC, key), sv = findPlane(NEBV_MAGIC, key);
  if (sh < 0 || sv < 0) {
    if (sh < 0) { sh = freePlane(); } nebHSlot = sh;
    if (sv < 0 || sv == sh) { sv = freePlane(); } nebVSlot = sv;
    if (sv == sh) return false;
    planeMagic[sh] = planeMagic[sv] = 0;
    uint32_t ho = planesOff + (uint32_t)sh * crossPlane, vo = planesOff + (uint32_t)sv * crossPlane;
    esp_partition_erase_range(picPart, ho, crossPlane); esp_partition_erase_range(picPart, vo, crossPlane);
    static uint8_t rh[SCR_WMAX], rv[SCR_WMAX];
    for (int y = 0; y < SCR_H; y++) {
      for (int x = 0; x < SCR_W; x++) nebulaPixel(x, y, rh[x], rv[x]);
      esp_partition_write(picPart, ho + 16 + (uint32_t)y * SCR_W, rh, SCR_W);
      esp_partition_write(picPart, vo + 16 + (uint32_t)y * SCR_W, rv, SCR_W);
      if (y & 1) delay(1);
    }
    uint32_t h1[4] = { NEBH_MAGIC, key, 0, 0 }, h2[4] = { NEBV_MAGIC, key, 0, 0 };
    esp_partition_write(picPart, ho, h1, 16); esp_partition_write(picPart, vo, h2, 16);
    planeMagic[sh] = NEBH_MAGIC; planeKeyOf[sh] = key; planeMagic[sv] = NEBV_MAGIC; planeKeyOf[sv] = key;
  }
  nebHSlot = sh; nebVSlot = sv; planeUse[sh] = ++planeTick; planeUse[sv] = ++planeTick;
  nebHOff = planesOff + (uint32_t)sh * crossPlane; nebVOff = planesOff + (uint32_t)sv * crossPlane;
  nbBN = max(4, min(NEB_BIG, (int)lroundf(9.0f * SCR_W * SCR_H / 153600)));   // a few bright stars, same places as the Studio
  float k = min(SCR_W, SCR_H) / 320.0f;
  for (int i = 0; i < nbBN; i++) {
    uint32_t h = hash32((uint32_t)(i + 1) * 7919u), h2 = hash32(h ^ 0x9e3779b9u);
    nbBX[i] = h % SCR_W; nbBY[i] = h2 % SCR_H; nbBR[i] = (2 + ((h >> 12) & 255) / 85.0f) * k; nbBW[i] = (h2 >> 9) & 1; nbBP[i] = ((h2 >> 12) & 255) / 40.0f;
  }
  nebKey = key; nebReady = true;
  return true;
}
HOT void nebulaStrip(int y0, int rows, uint16_t *strip) {
  const uint8_t *H0 = planeMap + (nebHOff - planesOff) + 16, *V0 = planeMap + (nebVOff - planesOff) + 16;
  const int hs = nebHue, dens = 7 * STARS / 3, gapMax = dens > 0 ? max(2, 2048 / dens) : 0;
  uint16_t *p = strip;
  for (int y = y0; y < y0 + rows; y++) {
    const uint8_t *hr = H0 + (uint32_t)y * SCR_W, *vr = V0 + (uint32_t)y * SCR_W;
    uint32_t rs = hash32((uint32_t)y * 2654435761UL + 0x5bd1e995UL);
    int sx = gapMax ? (int)(rs % (uint32_t)gapMax) : SCR_W;
    for (int x = 0; x < SCR_W; x++) {
      int hi = (hr[x] + hs) & 63, vi = vr[x];
      if (x == sx) {                    // a twinkling star here
        uint32_t h = hash32((uint32_t)(y * SCR_W + x) * 2654435761UL);
        int svi = 47 + sinT[(spTw + (h >> 10)) & 255] / 10;
        if (svi > vi) { hi = (h >> 20) & 63; vi = min(63, svi + 13); }
        rs = rs * 1664525UL + 1013904223UL; sx += 1 + (int)((rs >> 16) % (uint32_t)(gapMax - 1));
      }
      *p++ = spaceLUT[hi * 64 + vi];
    }
  }
  for (int i = 0; i < nbBN; i++) {      // the bright stars: soft glow and small spikes
    float R = nbBR[i] * (0.9f + 0.15f * sinf(spTw / 40.74f * 5.2f + nbBP[i]));
    int E = (int)ceilf(R * 4), cx = nbBX[i], cy = nbBY[i];
    if (cy + E < y0 || cy - E >= y0 + rows) continue;
    const float tr = nbBW[i] ? 255 : 200, tg = nbBW[i] ? 235 : 220, tb = nbBW[i] ? 200 : 255, b = BRIGHTNESS / 100.0f;
    for (int y = max(y0, cy - E); y <= min(y0 + rows - 1, cy + E); y++) for (int x = max(0, cx - E); x <= min(SCR_W - 1, cx + E); x++) {
      float dx = x - cx, dy = y - cy, r2 = dx * dx + dy * dy, spike = (dx == 0 || dy == 0) ? expf(-sqrtf(r2) / (R * 1.6f)) * 0.6f : 0, a = min(1.0f, expf(-r2 / (R * R * 0.35f)) + spike) * b;
      if (a < 0.02f) continue;
      uint16_t &c = strip[(y - y0) * SCR_W + x], s = to565((uint8_t)(tr * a), (uint8_t)(tg * a), (uint8_t)(tb * a));
      int rr = (c >> 11) + (s >> 11), gg = ((c >> 5) & 63) + ((s >> 5) & 63), bb = (c & 31) + (s & 31);
      c = (min(rr, 31) << 11) | (min(gg, 63) << 5) | min(bb, 31);
    }
  }
}
#else
bool galaxyTexFlash() { return false; }
const bool nebReady = false;
bool prepareNebula() { return false; }
void nebulaStrip(int, int, uint16_t *) {}
#endif

HOT void spaceNode(float X, float Y, uint8_t &h, uint8_t &v, uint8_t &x8) {   // gas and dust at one point
  const SceneLook &L = lk[CORE_ID()]; const uint8_t look = L.look; const float spExt = L.spExt;   // this core's style
  if (look == 4) {
    if (!gtReady) { galaxyNode(gax * X + gbx * Y, gay * X + gby * Y, h, v, x8); return; }
    float px = gpx * X + gqx * Y, py = gpy * X + gqy * Y;                 // look the galaxy up, turned
    float r2 = px * px + py * py, fr = 0;
    if (r2 > 0) { union { float f; uint32_t i; } u; u.f = r2; u.i = 0x5f3759dfUL - (u.i >> 1); float q = u.f; q *= 1.5f - 0.5f * r2 * q * q; fr = r2 * q * (1 / GT_DR); }   // quick square root (to 0.2%)
    if (fr > GT_R - 1.001f) fr = GT_R - 1.001f;
    float fa = (fastAtan2(py, px) - gRot) * (gtA * (1 / TWO_PI));
    while (fa < 0) fa += gtA;
    while (fa >= gtA) fa -= gtA;
    int ri = (int)fr; float wr = fr - ri; int ai = (int)fa; float wa = fa - ai; if (ai >= gtA) ai -= gtA;
    const int S = gtS, a1 = ai + 1 == gtA ? 0 : ai + 1, i00 = (ri * gtA + ai) * S, i01 = (ri * gtA + a1) * S, i10 = i00 + gtA * S, i11 = i01 + gtA * S;
    const int ua = (int)(wa * 256), ur = (int)(wr * 256), va = 256 - ua, vr = 256 - ur;   // in whole numbers
    h  = (uint8_t)(((gtH[i00] * va + gtH[i01] * ua) * vr + (gtH[i10] * va + gtH[i11] * ua) * ur) >> 16);
    v  = (uint8_t)(((gtV[i00] * va + gtV[i01] * ua) * vr + (gtV[i10] * va + gtV[i11] * ua) * ur) >> 16);
    x8 = (uint8_t)(((gtX[i00] * va + gtX[i01] * ua) * vr + (gtX[i10] * va + gtX[i11] * ua) * ur) >> 16);
    return;
  }
  if (look == 14) {                                                       // Nebula
    float x = (X * nbCa - Y * nbSa) / 36, y = (X * nbSa + Y * nbCa) / 36;
    float w = vn(x + nbO1, y) * 2.2f;                                     // warp so the clouds fold
    float d = vn(x + w, y - w + nbO2) * 0.6f + vn(x * 2.2f - w, y * 2.2f + nbO1) * 0.28f + vn(x * 4.6f, y * 4.6f) * 0.12f;
    float dust = max(0.0f, vn(x * 1.7f + 9, y * 1.7f - w) * 1.9f - 1.05f);   // dark dust lanes
    d = max(0.0f, d * 1.7f - 0.5f - dust);
    float hue = vn(x * 0.7f + 20 + nbO3, y * 0.7f) * 1.6f + w * 0.15f;    // big patches of different colour
    float rr = sqrtf(X * X + Y * Y) / spExt;
    h = to8(hue / 2); v = to8(d * (1 - rr * rr * rr) * 0.95f); x8 = 0;
  } else {                                                                // Meteor Shower: faint Milky Way
    float q = (X * 0.5f + Y * 0.87f) / 30, band = expf(-q * q);
    float cloud = vn(X / 14 + 3, Y / 14) * vn(X / 6, Y / 6 + 8);
    h = to8((0.05f + vn(X / 40, Y / 40 + 2) * 0.8f) / 2); v = to8(band * (0.12f + cloud * 0.35f)); x8 = band > 0.3f;
  }
}

inline bool spaceStar(uint32_t i, int density, int &hi, int &vi) {   // a twinkling star with its own colour
  uint32_t h = hash32(i * 2654435761UL);
  if ((int)(h & 1023) >= density) return false;
  vi = 47 + sinT[(spTw + (h >> 10)) & 255] / 10;
  hi = (h >> 20) & 63;
  return true;
}

void prepareSpace() {                   // once per frame
  spFrame++;                            // (the shared grid rows from the last frame are out of date)
  spU = look == 15 ? 118.0f / SP_EXT : 236.0f / min(SCR_W, SCR_H);   // scaled to the screen
  spExt = SP_EXT * spU;
  double T = spaceT;
  float ang = (float)fmod(T * 0.004, TWO_PI);
  nbCa = cosf(ang); nbSa = sinf(ang);
  nbO1 = (float)fmod(T * 0.004, 64.0); nbO2 = (float)fmod(T * 0.003, 64.0); nbO3 = (float)fmod(T * 0.002, 64.0);
  spTw = (int)(fmod(T * 0.25, TWO_PI) * 40.74f);
  if (look == 4) {                      // Galaxy: screen -> the galaxy's own slowly turning plane
    float rot = (float)fmod(T * 0.007, TWO_PI), cr = cosf(rot), sr = sinf(rot), cp = cosf(GAL_PA), sp = sinf(GAL_PA);
    gax = (cp * cr + sp * sr / GAL_TILT) * GAL_ZOOM; gbx = (-sp * cr + cp * sr / GAL_TILT) * GAL_ZOOM;
    gay = (-cp * sr + sp * cr / GAL_TILT) * GAL_ZOOM; gby = (sp * sr + cp * cr / GAL_TILT) * GAL_ZOOM;
    galK = 3 + TWIST * 2.5f;            // Spiral setting (TWIST 0-6)
    gpx = cp * GAL_ZOOM; gqx = -sp * GAL_ZOOM; gpy = sp / GAL_TILT * GAL_ZOOM; gqy = cp / GAL_TILT * GAL_ZOOM;   // before turning
    gRot = rot;
    gtReady = galaxyTex();
  }
  if (look == 14) prepareNebula();       // Nebula: the detailed picture (made once)
  if (look == 15) {                     // Wormhole: rings falling away, worked out per distance
    whCoreR = 0;
    float rev = DRIFT ? -1 : 1;          // Reverse: rings fly out toward you
    whPh = (int)(rev * fmod(T * 0.06, TWO_PI) * 40.74f);
    float off = rev * (float)fmod(T * 0.09, 100.0);
    for (int r = 0; r < 256; r++) {
      float ru = max(r * spU, 1.0f), depth = 90 / ru, ringPos = depth * 2.6f - off, fl = floorf(ringPos);
      whRingT[r] = (uint8_t)(255 * (0.5f + 0.5f * cosf((ringPos - fl) * TWO_PI)));
      float near = min(1.0f, ru / 95);
      whNearT[r] = (uint8_t)(255 * (0.25f + 0.75f * near * near));
      whOffT[r] = (int16_t)((int)(TWIST * (depth * 0.667f + 3 * logf(ru / 20)) * 40.74f) & 255);   // Twist: how much the walls spiral
      whHueT[r] = (int32_t)floorf(fl * 0.27f * 256) & 255;               // each ring its own colour
      whCoreT[r] = ru < 18 ? (int16_t)min(63.0f, expf(-(ru / 9) * (ru / 9)) * 1.05f * 63) : -1;
      whRing133T[r] = whRingT[r] * 133;
      whHue8T[r] = (uint8_t)whHueT[r];
      if (whCoreT[r] >= 0) whCoreR = r + 1;
    }
    for (int i = 0; i < 256; i++) { int sp = sinT[i] + 127; spokeVT[i] = sp * 123; spokeHT[i] = sp * 20 / 254; }
  }
  if (look == 16) {                     // Meteor Shower: where each shooting star is
    float P = sqrtf((float)SCR_W * SCR_W + (float)SCR_H * SCR_H) / 340;
    int N = NUM_SPARKS < 2 ? 2 : NUM_SPARKS > 30 ? 30 : NUM_SPARKS;   // Meteors setting
    meteorCount = N;
    for (int m = 0; m < N; m++) {
      float ph = (float)fmod(T * 0.006 * (1 + (m % 4) * 0.12) + (double)m / N + (m % 3) * 0.13, 1.0), lane = (m * 37 % 100) / 100.0f;
      float side = ((m * 61 % 100) / 100.0f - 0.5f) * 160;   // spread across the sky
      meteors[m].x = QX + (110 - ph * 320 + lane * 110 + side * 0.6f) * P;
      meteors[m].y = QY + (-170 + ph * 240 + lane * 70 + side * 0.8f) * P;
      meteors[m].len = (38 + lane * 30) * P;
      meteors[m].hue = m * 64 / N;
    }
  }
}

HOT void renderSpaceStrip(int y0, int rows, uint16_t *strip) {
  const SceneLook &L = lk[CORE_ID()]; const uint8_t look = L.look; const int spCY = L.spCY; const float spU = L.spU;   // this core's style
  uint16_t *p = strip;
  if (look == 15) {                     // Wormhole
    for (int y = y0; y < y0 + rows; y++) {
      int cy = y < spCY ? spCY - 1 - y : y - spCY;
      if (cy < TQY) {                    // the usual case: distance and angle straight from the tables, one half at a time
        const bool low = y >= spCY;
        const uint8_t *rr = rT + cy * TQX, *aa = aT + cy * TQX;
        for (int half = 0; half < 2; half++) {
          const int xa = half ? QX : 0, xb = half ? SCR_W : QX;
          const int base = (half ? (low ? 0 : 256) : 128) * 6 + whPh, sg6 = (half ? low : !low) ? 6 : -6;
          for (int x = xa; x < xb; x++) {
            const int ci = colMap[x], r = rr[ci], i = (base + sg6 * aa[ci] + whOffT[r]) & 255;
            int vi = (powT[(whRing133T[r] + spokeVT[i]) >> 8] * whNearT[r]) >> 10;
            if (r < whCoreR) { if (whCoreT[r] > vi) vi = whCoreT[r]; *p++ = spaceLUT[48 * 64 + vi]; continue; }   // glowing far end
            *p++ = spaceLUT[(((whHue8T[r] + spokeHT[i]) >> 2) & 63) * 64 + vi];
          }
        }
        continue;
      }
      for (int x = 0; x < SCR_W; x++) {
        int r, a; polarAt(x, y, spCY, r, a);
        int s = sinT[(a * 6 + whOffT[r] + whPh) & 255] + 127;          // spokes, 0..254
        int vi = (powT[(whRingT[r] * 133 + s * 123) >> 8] * whNearT[r]) >> 10;
        if (whCoreT[r] >= 0) { if (whCoreT[r] > vi) vi = whCoreT[r]; *p++ = spaceLUT[48 * 64 + vi]; continue; }   // glowing far end
        *p++ = spaceLUT[(((whHueT[r] + s * 20 / 254) >> 2) & 63) * 64 + vi];
      }
    }
    return;
  }
  if (look == 14 && nebReady) { nebulaStrip(y0, rows, strip); return; }   // Nebula: the stored picture
  // Galaxy, Nebula and Meteor Shower: gas worked out on a coarse grid, smoothed in between
  uint8_t *gH = spH, *gV = spV, *gX = spX;
#if defined(ESP32) && !CONFIG_FREERTOS_UNICORE
  if (xPortGetCoreID() == 1 && spX1) { gH = spH1; gV = spV1; gX = spX1; }   // core 1 has its own grid
#endif
  const int C = look == 4 ? (min(SCR_W, SCR_H) < 300 ? 3 : 4) : 8, WM = C == 3 ? 7282 : 65536 / (C * C), GC = SCR_W / C + 2;   // Nebula and Meteor Shower: softer gas, coarser grid (4x less work); WM: 1 / (C * C) in 1/65536ths
  int gy0 = y0 / C, gy1 = (y0 + rows - 1) / C + 1;
  const bool ring = ringN && !(sceneMix > 0 && sceneA != sceneB);   // (not while two styles fade: each core then draws both)
  const uint32_t tagBase = (spFrame << 16) | ((uint32_t)look << 8);
  const uint8_t *pH[24], *pV[24], *pX[24];
  for (int gy = gy0; gy <= gy1; gy++) {
    const int k = gy - gy0;
    uint8_t *h, *v, *xx; int s = 0; bool need = true;
    if (ring) {
      s = gy % ringN; h = ringH + s * SP_RING_W; v = ringV + s * SP_RING_W; xx = ringX + s * SP_RING_W;
      need = ringTag[s] != (tagBase | gy);           // the other core may have worked this row out already
    } else { h = gH + k * GC; v = gV + k * GC; xx = gX + k * GC; }
    if (need) {
      for (int gx = 0; gx < GC; gx++) spaceNode((gx * C + 0.5f - QX) * spU, (gy * C + 0.5f - spCY) * spU, h[gx], v[gx], xx[gx]);
      if (ring) { __sync_synchronize(); ringTag[s] = tagBase | gy; }
    }
    pH[k] = h; pV[k] = v; pX[k] = xx;
  }
  int dens = (look == 14 ? 7 : look == 4 ? 4 : 10) * STARS / 3, densBand = 22 * STARS / 3;
  const int genD = look == 16 ? densBand : dens, gapMax = genD > 0 ? max(2, 2048 / genD) : 0;   // stars: jump straight from one to the next instead of testing every pixel
  static int16_t colHc[2][SCR_WMAX / 3 + 3], colVc[2][SCR_WMAX / 3 + 3], colXc[2][SCR_WMAX / 3 + 3];   // one row of the grid, blended down to this pixel row (one set per core)
  const int core = CORE_ID();
  int16_t *colH = colHc[core], *colV = colVc[core], *colX = colXc[core];
  const int CW = C * WM;
  for (int y = y0; y < y0 + rows; y++) {
    int gy = y / C - gy0, fy = y % C;
    float Y = (y + 0.5f - spCY) * spU;
    const int cy = C - fy;
    const uint8_t *tH = pH[gy], *tV = pV[gy], *tX = pX[gy], *bH = pH[gy + 1], *bV = pV[gy + 1], *bX = pX[gy + 1];
    for (int g = 0; g < GC; g++) {                   // blend between the grid rows once per row, then only across
      colH[g] = tH[g] * cy + bH[g] * fy; colV[g] = tV[g] * cy + bV[g] * fy;
      colX[g] = tX[g] * cy + bX[g] * fy;
    }
    int lkx = 1 << 30, lky = 0; uint32_t lkh = 0;   // Galaxy: the knot patch the last pixel was in
    const float X0 = (0.5f - QX) * spU, xr0 = gax * X0 + gbx * Y, yr0 = gay * X0 + gby * Y, dxr = gax * spU, dyr = gay * spU;   // Galaxy: where this row is in the galaxy's plane
    uint32_t rs = hash32((uint32_t)y * 2654435761UL + 0x5bd1e995UL);
    int sx = gapMax ? (int)(rs % (uint32_t)gapMax) : SCR_W;
    for (int x = 0, g = 0; x < SCR_W; g++) {
      int hA = colH[g] * CW, dH = (colH[g + 1] - colH[g]) * WM;   // across one grid cell the gas only needs adding up
      int vA = colV[g] * CW, dV = (colV[g + 1] - colV[g]) * WM;
      int aA = colX[g] * CW, dA = (colX[g + 1] - colX[g]) * WM;
      const int xe = x + C < SCR_W ? x + C : SCR_W;
      for (; x < xe; x++, hA += dH, vA += dV, aA += dA) {
        int hi = (hA >> 17) & 63, vi = vA >> 18;
        if (look == 4 && (aA >> 16) > 90) {             // knots on the arms: pink star nurseries, blue clusters
          int am = aA >> 16;
          float xr = xr0 + x * dxr, yr = yr0 + x * dyr;
          int kx = (int)(xr * 0.25f + 4096) - 4096, ky = (int)(yr * 0.25f + 4096) - 4096;   // (floor, without the library call)
          if (kx != lkx || ky != lky) { lkx = kx; lky = ky; lkh = hash32((uint32_t)(kx + 4096) * 7919u + (uint32_t)(ky + 4096) * 104729u); }   // same patch as the last pixel: same knot
          uint32_t kh = lkh;
          int kind = kh & 15;
          if (kind < 3) {
            float dx = xr - (kx * 4 + 1 + (int)((kh >> 8) & 1) * 2), dy = yr - (ky * 4 + 1 + (int)((kh >> 9) & 1) * 2), d2 = dx * dx + dy * dy, size = kind == 0 ? 1.6f : 0.9f;
            if (d2 < size) { int kv = (int)((0.62f + am / 700.0f) * 63 * (1 - d2 / size * 0.4f)); if (kv > vi) { hi = kind == 0 ? 17 : 33; vi = min(63, kv); } }
          }
        }
        if (x == sx) {                                  // a star here
          uint32_t h = hash32((uint32_t)(y * SCR_W + x) * 2654435761UL);
          int svi = 47 + sinT[(spTw + (h >> 10)) & 255] / 10, shi = (h >> 20) & 63;
          if (look == 4) { if (svi > vi + 8) { hi = 42; vi = svi; } }
          else if (look == 14) { if (svi > vi) { hi = shi; vi = min(63, svi + 13); } }
          else if (tX[g] || (int)(h >> 26) * densBand < dens * 64) { hi = shi; vi = svi; }   // fewer away from the Milky Way
          rs = rs * 1664525UL + 1013904223UL;
          sx += 1 + (int)((rs >> 16) % (uint32_t)(gapMax - 1));
        }
        *p++ = spaceLUT[hi * 64 + vi];
      }
    }
  }
  if (look == 16) for (int m = 0; m < meteorCount; m++) {           // shooting stars with coloured tails
    const Meteor &M = meteors[m];
    int k0 = (int)((M.y + 0.5f - (y0 + rows)) / 0.6f) - 1, k1 = (int)((M.y + 0.5f - y0 + 1) / 0.6f) + 2;   // only the part of the tail that crosses this strip
    if (k0 < 0) k0 = 0;
    if (k1 > (int)M.len + 1) k1 = (int)M.len + 1;
    for (int k = k0; k < k1 && k < M.len; k++) {
      float f = 1 - k / M.len;
      int x = (int)floorf(M.x + 0.8f * k + 0.5f), y = (int)floorf(M.y - 0.6f * k + 0.5f);
      int vi = k < 3 ? 63 : (int)((0.9f * f * f + 0.05f) * 63);
      for (int yy = y; yy < y + 2; yy++)
        if (x >= 0 && x < SCR_W && yy >= y0 && yy < y0 + rows) strip[(yy - y0) * SCR_W + x] = spaceLUT[M.hue * 64 + vi];
    }
  }
}

#if TURNS
void buildGeometry(); void buildParams(); void resetSparks();
#if DUAL_CORE
extern SemaphoreHandle_t freeSem[2];
#endif
void setSize(bool p) {                   // portrait: the short side across
  PORTRAIT = p;
  SCR_W = p ? SCR_SHORT : SCR_WMAX; SCR_H = p ? SCR_WMAX : SCR_SHORT;
  QX = SCR_W >> 1; QY = SCR_H >> 1;
}
void turnScreen(bool p) {                // between frames, on the drawing core
#if DUAL_CORE
  for (int i = 0; i < 2; i++) xSemaphoreTake(freeSem[i], portMAX_DELAY);   // wait until the last frame has gone out
  for (int i = 0; i < 2; i++) xSemaphoreGive(freeSem[i]);
#endif
  setSize(p);
  buildGeometry();
  buildParams();
  resetSparks();
  turnPending = true;                    // the screen gets the new direction before the next frame is sent
}
#endif

void frameStart() {
  updateScene();
  if (havePending) {
    apply(pendingSettings);
    saveSettings();
    if (pendRip) { pendRip = false; for (int j = 0; j < 4; j++) RIP_C[j] = pendRipC[j]; saveExtra(); }
    if (pendRim) { pendRim = false; if (pendRimW != RIM_W) { RIM_W = pendRimW; saveExtra(); buildParams(); } }
    if (pendXout) { pendXout = false; if (pendOut != CROSS_OUT) { CROSS_OUT = pendOut; saveExtra(); } }
    if (pendXcol) { pendXcol = false; if (pendCol != CROSS_COL) { CROSS_COL = pendCol; saveExtra(); } }
    grabLook(mainLook); curLook = -1;      // the main settings are loaded now
    buildTone();
    if (spaceLUT) buildSpaceLUT();       // space colours go through the colour curve too
    buildParams();
    buildPalette();
    resetSparks();
    havePending = false;
  }
  if (scenePending) {                    // a scene's own settings changed
    scenePending = false;
    for (int k = 0; k < 8; k++) { SCENE_HAS[k] = pendHas[k]; SCENE_LOOKS[k] = pendLook[k]; }
    saveScenes();
    if (curLook >= 0) { int c = curLook; curLook = -2; useSceneLook(c); }   // showing one now: load its new settings
  }
  pickSceneLook();
#if TURNS
  if (wantPortrait != PORTRAIT) turnScreen(wantPortrait);
  if (wantFlip != FLIP) { FLIP = wantFlip; turnPending = true; }   // a half turn: the same size, the panel just faces the other way
#endif
  bool isCross = ((STYLE >= 8 && STYLE <= 13) || STYLE == 17) && curLook != -3;   // 17: Wooden cross (-3: another style is showing, sized as a portal: no cross needed)
  if (isCross && crossAvailable() && edgeBuf) prepareCross();
  crossOn = isCross && crossReady;
  woodOn = crossOn && STYLE == 17;
  look = crossOn ? CROSS_FILL : isCross ? 0 : STYLE;   // crosses: the chosen style is drawn inside (the Wooden cross: behind)
  if (crossOn && ((look >= 7 && look <= 10) || look == 18) && !woodOn) look = 0;   // the warm glow and the skies are only for the Wooden cross
  if (woodOn && look == 11) look = 7;                            // solid colour is for the glowing crosses
  if (woodOn) { prepareWood(); woodPulse = (int)(256 * (0.75f + 0.25f * sinf(millis() / 1000.0f * 1.3f))); }
  if (crossOn && !woodOn) buildCrossRipple(); else memset(crossRipT, 0, sizeof(crossRipT));
  if (woodOn && ((look >= 8 && look <= 10) || look == 18)) {           // a cloud sky (no room: the warm glow)
    if (cloudMemory()) { prepareClouds(look == 18 ? 1 : look - 8, look == 18 ? FD_CLOUDS : -1); if (look == 18) prepareFullDay(); } else look = 7;
  }
  bool baseCross = crossOn;
  int baseLook = look;
  lookA = isStyleScene(sceneA) ? sceneA - 200 : baseLook; crossA = !isStyleScene(sceneA) && baseCross;
  lookB = isStyleScene(sceneB) ? sceneB - 200 : baseLook; crossB = !isStyleScene(sceneB) && baseCross;
  bool needB = sceneMix > 0 && sceneA != sceneB;
  for (int k = 0; k < 2; k++) {                       // space styles: worked out per frame (no room: show the Vortex)
    int &L = k ? lookB : lookA;
    if (k && !needB && sceneMix < 128) break;
    if (L == 4 || (L >= 14 && L <= 16)) { look = L; if (spaceMemory()) prepareSpace(); else L = 0; }
  }
  if (!needB && sceneMix < 128) lookB = lookA;
  outLook = baseCross && !woodOn && validOut(CROSS_OUT) ? CROSS_OUT : 255;   // outside the glowing cross
  if (isGridSpace(outLook)) {                         // a space picture outside: only one space picture at a time
    bool other = (isGridSpace(lookA) && lookA != outLook) || (isGridSpace(lookB) && lookB != outLook);
    if (other) outLook = 255;
    else if (!isGridSpace(lookA) && !isGridSpace(lookB)) { look = outLook; if (spaceMemory()) prepareSpace(); else outLook = 255; }
  }
  {
    auto gridLook = [](int L) { return L == 4 || (L == 14 && !nebReady) || L == 16; };

    if (gridLook(lookA) || gridLook(lookB) || gridLook(outLook)) ringMemory(); else if (ringTried) freeRing();
  }
  look = lookA;
  crossOn = baseCross;
  spCY = crossOn ? crossYC : QY;
  updateColourFade();
  updateSparks();
  for (int a = 0; a < 256; a++) {                     // wobbly rim edge for this frame
    float ang = a * TWO_PI / 256;
    float wob = sinf(ang * 5 + t * 2) * 1.2f + sinf(ang * 3 - t * 3) * 0.8f;
    edgeT[a] = (int16_t)(RADIUS * (1 + wob * 0.025f * (1 - RIM_SMOOTH / 100.0f)));
  }
  // Hyperspace: where each streaking star is this frame (3 layers x 256 directions)
  bhHole = (int)(0.22f * RADIUS);
  twinkle = (int)(t * 25);
  if (lookA == 3 || lookB == 3 || outLook == 3) {
    for (int L = 0; L < 3; L++) {
      for (int a = 0; a < 256; a++) {
        uint32_t h = hash32((uint32_t)(a * 3 + L * 7919));
        int i = L * 256 + a;
        warpOn[i] = (int)(h & 15) < STARS + 1;
        float pos = fmodf((float)((h >> 8) & 1023) + t * (60 + L * 25), 1024.0f) / 1024.0f;
        float rr = pos * pos * 1.15f * RADIUS;
        warpRR[i] = rr;
      }
    }
  }
  // Starburst ripples: rings expanding outward, precomputed per distance for this frame
  memset(ripCrestT, 0, sizeof(ripCrestT));
  memset(ripTroughT, 0, sizeof(ripTroughT));
  if (lookA == 2 || lookB == 2 || outLook == 2) {
    for (uint8_t i = 0; i < RIPPLES; i++) {
      float pr = fmodf(t * RIP_SPEED + (float)i / RIPPLES, 1.0f);
      float rr = 0.16f + pr * 0.62f, w = 0.04f + pr * 0.04f, fade = powf(1 - pr, 1.1f);
      for (int r = 0; r < 256; r++) {
        float d = (r / RADIUS - rr) / w;
        ripCrestT[r]  = (uint8_t)min(255, ripCrestT[r] + (int)(fade * 110 * expf(-d * d)));
        ripTroughT[r] = (uint8_t)min(255, ripTroughT[r] + (int)(fade * 35 * expf(-(d + 1.6f) * (d + 1.6f))));
      }
    }
  }
}

void frameEnd() {
  static uint32_t lastMs = millis();     // everything moves by the clock, so every screen matches the Studio at any frame rate
  uint32_t now = millis();
  frameK = min(8.0f, (now - lastMs) / 35.7f);   // the Studio preview steps 28 times a second
  t += SPEED * frameK;
  spaceT += SPEED * 8 * min(8.0f, (now - lastMs) / 35.7f);   // the Studio preview steps 28 times a second
  cloudDrift += 6 * min(8.0f, (now - lastMs) / 1000.0f) * (SPEED / 0.12f);   // clouds drift by the clock, faster with a higher Spin speed
  if (cloudDrift > 1e6f) cloudDrift = 0;
  ripplePh = fmodf(ripplePh + 0.3f * min(8.0f, (now - lastMs) / 1000.0f) * (SPEED / 0.12f), 1.0f);   // Ripple rings move by the clock, faster with a higher Spin speed
  lastMs = now;
  if (spaceT > 1e7) spaceT = 0;
  if (t > TWO_PI * 100) t -= TWO_PI * 100;   // wrap seamlessly so it can run forever
}

inline int cartoonV(int a, int r, int phase) {   // blobby flat-shaded swirl
  int warp = (((nz(nzA, 31, a * 2 + r * 3 + (phase >> 1)) - 128) * 7) >> 3) + ((nz(nzB, 63, a * 4 + r * 6 - phase) - 128) >> 2);
  int sp = sinT[(a * ARMS - linT[r] + phase + warp) & 255];
  return r < 7 ? 232 : sp > 25 ? 232 : sp > -45 ? 182 : 120;
}

inline int styleV(int look, int a, int r, int phase, int phase2) {   // brightness (0-255) inside the portal for one style
  int v;
  if (look == 11) return 110;                   // Solid colour (crosses): the inner colour, flat
  if (look == 7 || look == 6) return cartoonV(a, r, phase);
  if (look == 0) {                              // Vortex
    int s  = sinT[(a * ARMS + twistT[r] + phase) & 255];
    int s2 = sinT[(a * 2 - twist2T[r] + phase2) & 255];
    int d = depthT[r];
    int band = ((s + 127) * 5 + (s2 + 127) * 3) >> 3;
    v = (d * (60 + ((band * 195) >> 8))) >> 8;   // swirling bands, darker toward the throat
    if (s > 100) v += ((s - 100) * 3 * d) >> 8; // bright spiral crests
    if (coreT[r] > v) v = coreT[r];              // glowing core
  } else if (look == 1) {                       // Toon Spiral: flat-shaded wavy bands
    int w  = sinT[(a * 6 + r * 4 + phase2) & 255] >> 2;
    int sp = sinT[(a * ARMS - linT[r] + phase + w) & 255];
    v = sp > 40 ? 235 : sp > -20 ? 190 : sp > -70 ? 150 : 95;
    if (coreT[r] > v) v = coreT[r];
  } else if (look == 6) {                       // Cartoon Swirl: blobby flat-shaded bands
    v = cartoonV(a, r, phase);
  } else if (look == 3) {                       // Hyperspace: stars streak outward
    v = 30 + ((sinT[(a * 3 + (phase >> 3)) & 255] + 127) >> 4) + (spCoreT[r] >> 2);
    for (int L = 0; L < 3; L++) {
      int i = L * 256 + a;
      if (!warpOn[i]) continue;
      float rr = warpRR[i], len = 1.5f + rr * 0.22f;
      if (r <= rr && r > rr - len) {
        int sv = (int)(110 + 145 * min(1.0f, rr / (0.8f * RADIUS)) * (1 - (rr - r) / len * 0.6f));
        if (sv > v) v = sv;
      }
    }
  } else if (look == 5) {                       // Black hole: shadow, bright ring, swirling disk
    if (r < bhHole) v = 0;
    else {
      int swirl = sinT[(a * 3 + r * 6 - phase * 2) & 255] + (sinT[(a * 7 - r * 3 - phase) & 255] >> 1);
      int disk  = bhDiskT[r] * (310 + swirl) / 500;
      v = bhRingT[r] > disk ? bhRingT[r] : disk;
      if (bhStarT[r]) { int st = starAt(a, r); if (st > v) v = st; }
    }
  } else {                                       // Starburst: glowing centre, soft rings, rays, ripples
    int ray  = sinT[(a * 11 + (phase >> 2)) & 255] + (sinT[(a * 19 - (phase >> 1)) & 255] >> 1) + (sinT[(a * 37 + phase) & 255] >> 1);
    int wave = sinT[(r * 4 - phase * 2 + (sinT[(a * 9 + (phase >> 2)) & 255] >> 4)) & 255];
    int tex  = sinT[(r * 9 - phase * 3 + (sinT[(a * 7 + (phase >> 1)) & 255] >> 3)) & 255];
    int sd   = sinT[(a * 22 + (phase >> 3)) & 255], sdp = sd > 0 ? sd : 0;
    v = 115 + sbGlowT[r]
      + ((((wave + 127) * 85 >> 8) * sbRingT[r]) >> 8)     // soft rings near the centre
      + ((((tex * 26) >> 7) * sbRingT[r]) >> 8)
      + ((((ray * 32) >> 7) * sbOuterT[r]) >> 8)            // rays toward the rim
      + ((ripCrestT[r] * (141 + ((sdp * 115) >> 7))) >> 8) - ripTroughT[r];   // expanding ripples
    if (v < 0) v = 0;
  }
  return v < 0 ? 0 : v;
}

inline uint16_t max565(uint16_t a, uint16_t b) {   // brighter of two colours, channel by channel
  return max(a & 0xF800, b & 0xF800) | max(a & 0x07E0, b & 0x07E0) | max(a & 0x001F, b & 0x001F);
}

// ---------- Ripple (glowing crosses): copies of the outline echo through the inside of the cross ----------
uint8_t crossRipT[128];                 // extra brightness by distance inside the cross edge, this frame
float   ripplePh = 0;
uint8_t  ripA[128];                     // how strongly each ring covers what's below
uint16_t ripC565[128];                  // Gradient ripple: each ring's colour by distance inside the cross edge
bool     ripColOn = false;
HOT inline uint16_t add565(uint16_t a, uint16_t b) {   // brighten a by b, channel by channel
  int r = (a >> 11) + (b >> 11), g = ((a >> 5) & 63) + ((b >> 5) & 63), bl = (a & 31) + (b & 31);
  return (min(r, 31) << 11) | (min(g, 63) << 5) | min(bl, 31);
}
void ripRGB(float ph, float *c) {         // Gradient: a ring's colour for how far it has travelled (0-1), through the four colours
  float x = min(2.999f, max(0.0f, ph) * 3); int i = (int)x; float f = x - i;
  for (int k = 0; k < 3; k++) { float a = (RIP_C[i] >> (16 - 8 * k)) & 255, b = (RIP_C[i + 1] >> (16 - 8 * k)) & 255; c[k] = a + (b - a) * f; }
}
void buildCrossRipple() {
  memset(crossRipT, 0, sizeof(crossRipT));
  ripColOn = false;
  int dir = CROSS_RIPPLE % 3, mode = CROSS_RIPPLE / 3;   // ripple direction (1 out, 2 in) and colour (0 glow, 1 gradient)
  if (!dir) return;
  if (mode > 1) mode = 0;                // (the old Rainbow setting: plain glow)
  static float acc[128 * 4];
  if (mode) memset(acc, 0, sizeof(acc));
  float R = min(RADIUS, (SCR_H - 8) * (100.0f - BAR) / 100), AW = max(2.0f, R * BEAM / 100.0f), s = R / 149.0f;
  float rw = max(1.5f, AW * 0.18f), span = AW - rw;
  for (int j = 0; j < 3; j++) {
    float ph = fmodf(ripplePh + j / 3.0f, 1.0f), e0 = dir == 1 ? AW - ph * span : rw + ph * span;   // 1: outward, 2: inward
    float b = 150 * (0.35f + 0.65f * sinf(ph * PI));
    if (mode) {                          // coloured rings
      float c[3]; ripRGB(dir == 1 ? ph : 1 - ph, c);
      for (int k = 1; k < 128; k++) { float q = (k - 0.5f - e0) / (1.4f * s), w = b / 150 * expf(-q * q); if (w > 0.01f) { for (int m = 0; m < 3; m++) acc[k * 4 + m] += c[m] * w; acc[k * 4 + 3] += w; } }
      continue;
    }
    for (int k = 1; k < 128; k++) { float q = (k - 0.5f - e0) / (1.4f * s); crossRipT[k] = (uint8_t)min(255.0f, crossRipT[k] + b * expf(-q * q)); }
  }
  if (mode) {                            // each ring in its own colour, covering what's below where it's strong
    for (int k = 0; k < 128; k++) {
      float W = acc[k * 4 + 3];
      if (W < 0.02f) { ripC565[k] = 0; ripA[k] = 0; continue; }
      float m = BRIGHTNESS / 100.0f / W;
      ripC565[k] = to565((uint8_t)min(255.0f, acc[k * 4] * m), (uint8_t)min(255.0f, acc[k * 4 + 1] * m), (uint8_t)min(255.0f, acc[k * 4 + 2] * m)) | 0;
      ripA[k] = (uint8_t)min(255.0f, W * 1.6f * 256);
      if (!ripA[k]) ripC565[k] = 0;
    }
    ripColOn = true;
  }
}

#define OUT_DIM 256                      // the background around a glowing cross: the same colours as inside
inline uint16_t dim565(uint16_t c, int m) {    // darken a colour (m: 0-255)
  return ((((c >> 11) * m) >> 8) << 11) | (((((c >> 5) & 63) * m) >> 8) << 5) | (((c & 31) * m) >> 8);
}
inline int outV(int x, int y, int phase, int phase2) { int r, a; polarAt(x, y, QY, r, a); return (styleV(outLook, a, r, phase, phase2) * OUT_DIM) >> 8; }   // centred on the screen (quick: straight from the tables)
HOT void crossMask(int y0, int rows, uint16_t *strip, int look, int phase, int phase2) {   // glowing cross outline over a space picture
  const int8_t *edgeBuf = edgeRows(y0);
  for (int i = 0; i < rows * SCR_W; i++) {
    int ce = edgeBuf[i];
    if (ce <= 0 && outLook != 255) {                  // something outside the cross
      uint16_t g = xpal[max(crossRimT[-ce], crossHaloT[-ce])];
      if (outLook == look) strip[i] = max565(dim565(strip[i], OUT_DIM), g);
      else if (!isGridSpace(outLook)) strip[i] = max565(pal[min(255, outV(i % SCR_W, y0 + i / SCR_W, phase, phase2))], g);
      else strip[i] = g;
      continue;
    }
    if (ce > 0) { int rv = max((int)crossRimT[ce], crossRipT[ce] > 8 ? min(255, crossRipT[ce] + 60) : 0); if (rv > 8) strip[i] = max565(strip[i], xpal[rv]); if (ripColOn && ripA[ce]) strip[i] = mix565(strip[i], ripC565[ce], ripA[ce]); }
    else strip[i] = xpal[max(crossRimT[-ce], crossHaloT[-ce])];
  }
}

// ---------- Wooden cross (style 17): carved wood, the crossbar joined flush with the upright ----------
// Behind it (CROSS_FILL): 7 = a warm glow in the main colours, otherwise any portal or space style.
bool     woodOn = false;
uint8_t  woodGT[256], woodShT[128], woodVigT[256];
uint16_t woodGlowT[128], woodWideT[256];   // warm glow, in 1/16ths of a palette step
const uint8_t BAYER4[16] = { 0, 8, 2, 10, 12, 4, 14, 6, 3, 11, 1, 9, 15, 7, 13, 5 };
static inline __attribute__((always_inline)) uint16_t glowPx(int vf, int x, int y) {   // a palette position in 1/16ths -> a smooth, dithered screen colour
  if (vf > 255 * 16) vf = 255 * 16;
  int i = vf >> 4, f = vf & 15, j = i < 255 ? i + 1 : 255, d = BAYER4[((y & 3) << 2) | (x & 3)];
  uint32_t A = palRGB[i], B = palRGB[j];
  int r = (int)(A >> 16) + ((((int)(B >> 16) - (int)(A >> 16)) * f) >> 4) + (d >> 1);
  int g = (int)((A >> 8) & 255) + ((((int)((B >> 8) & 255) - (int)((A >> 8) & 255)) * f) >> 4) + (d >> 2);
  int b = (int)(A & 255) + ((((int)(B & 255) - (int)(A & 255)) * f) >> 4) + (d >> 1);
  if (r > 255) r = 255; if (g > 255) g = 255; if (b > 255) b = 255;
  return ((r & 0xF8) << 8) | ((g & 0xFC) << 3) | (b >> 3);
}
uint8_t (*woodWobT)[1024] = NULL;          // grain sway along each beam (made when the Wooden cross is first shown)
float    woodAW = 10, woodHHL = 20, woodBot = 100, woodTop = 50, woodS = 1;
int      woodVS = 51, woodFS = 384, woodUS = 51, woodPulse = 256;
uint32_t woodKey = 0;

float woodNoise(float x, uint32_t seed) {      // smooth 1-D noise, 0..1
  int i = (int)floorf(x);
  float f = x - i; f = f * f * (3 - 2 * f);
  float a = (hash32((uint32_t)(i * 7919) + seed) & 1023) / 1023.0f, b = (hash32((uint32_t)((i + 1) * 7919) + seed) & 1023) / 1023.0f;
  return a + (b - a) * f;
}

float woodBox(float x, float y, float cx, float cy, float hw, float hh) {
  float dx = fabsf(x - cx) - hw, dy = fabsf(y - cy) - hh;
  return hypotf(fmaxf(dx, 0), fmaxf(dy, 0)) + fminf(fmaxf(dx, dy), 0);
}
float woodSD(float x, float y) {               // one solid piece: upright and crossbar together
  return fminf(woodBox(x, y, 0, (woodBot - woodTop) / 2, woodAW, (woodBot + woodTop) / 2), woodBox(x, y, 0, 0, woodHHL, woodAW));
}

// Eleven woods (CROSS_RIPPLE picks it for the Wooden cross): 0 classic, 1 pine, 2 rustic oak, 3 walnut, 4 cherry, 5 mahogany,
// 6 cedar, 7 driftwood, 8 ebony, 9 maple, 10 olive wood.
// The wood never moves, so the board works it out once per pixel and keeps it in flash next to the cross outline:
// one byte per pixel, 32 wood tones x 8 shades, then just looks the colours up while drawing.
struct WoodGrain { float early[3], late[3], freq, arch, off, warp, l0, l1, tone, pores, poreLen, poreDark, u0V, u0H; };
const WoodGrain WOOD_GRAINS[10] = {
  { { 222, 176, 118 }, { 156, 94, 46 }, 0.15f, 0.10f, 20, 3.0f, 0.50f, 0.86f, 0.10f, 0.008f, 9, 0.85f, 30, -25 },   // pine
  { { 150, 100, 58 }, { 88, 54, 30 }, 0.26f, 0.08f, 22, 2.4f, 0.45f, 0.82f, 0.16f, 0.025f, 8, 0.78f, -20, 60 },    // rustic oak
  { { 124, 84, 58 }, { 60, 38, 26 }, 0.19f, 0.09f, 18, 3.2f, 0.46f, 0.84f, 0.16f, 0.045f, 10, 0.68f, 10, -40 },   // walnut
  { { 200, 118, 80 }, { 150, 76, 48 }, 0.15f, 0.1f, 24, 2.4f, 0.55f, 0.9f, 0.16f, 0.004f, 9, 0.85f, -30, 20 },   // cherry
  { { 158, 76, 52 }, { 104, 46, 32 }, 0.32f, 0.03f, 30, 1.4f, 0.42f, 0.82f, 0.12f, 0.05f, 16, 0.7f, 0, 0 },   // mahogany
  { { 226, 154, 112 }, { 150, 78, 56 }, 0.17f, 0.12f, 16, 3.6f, 0.48f, 0.82f, 0.18f, 0.006f, 9, 0.85f, 40, -10 },   // cedar
  { { 186, 178, 164 }, { 122, 114, 104 }, 0.2f, 0.06f, 20, 4.5f, 0.4f, 0.78f, 0.24f, 0.07f, 26, 0.55f, -10, 30 },   // driftwood
  { { 56, 46, 40 }, { 36, 30, 27 }, 0.3f, 0.04f, 26, 1.8f, 0.55f, 0.92f, 0.1f, 0.01f, 12, 0.8f, 20, -20 },   // ebony
  { { 238, 214, 172 }, { 214, 182, 136 }, 0.12f, 0.1f, 22, 2.2f, 0.58f, 0.92f, 0.08f, 0.002f, 9, 0.9f, -20, 50 },   // maple
  { { 220, 194, 140 }, { 104, 80, 46 }, 0.22f, 0.16f, 12, 9.0f, 0.58f, 0.86f, 0.2f, 0.006f, 9, 0.85f, 50, -60 }    // olive wood
};
const float WOOD_SHADE[8] = { 0.70f, 0.78f, 0.86f, 0.93f, 1.0f, 1.08f, 1.17f, 1.28f };
uint16_t woodPal8[256];
uint8_t *woodBuf = NULL;                   // one strip of wood bytes
uint32_t woodPlaneKey = 0;
int      woodGrain = 0;

float woodHash01(int a, int b) { return (hash32((uint32_t)(a * 73856093) ^ (uint32_t)(b * 19349663)) & 65535) / 65536.0f; }
float woodNoise2(float x, float y, uint32_t seed) {
  int ix = (int)floorf(x), iy = (int)floorf(y);
  float u = x - ix, w = y - iy; u = u * u * (3 - 2 * u); w = w * w * (3 - 2 * w);
  float L[4];
  for (int k = 0; k < 4; k++) L[k] = (hash32((uint32_t)((ix + (k & 1)) * 73856093) ^ (uint32_t)((iy + (k >> 1)) * 19349663) ^ (uint32_t)(seed * 83492791)) & 1023) / 1023.0f;
  return (L[0] + (L[1] - L[0]) * u) * (1 - w) + (L[2] + (L[3] - L[2]) * u) * w;
}
inline float woodSst(float a, float b, float x) { float t = fminf(1, fmaxf(0, (x - a) / (b - a))); return t * t * (3 - 2 * t); }

void woodColorOf(int grain, int tn, float *c) {            // wood tone tn (0-31) of a grain
  if (grain == 0) {
    const float c0[3] = { 46, 26, 12 }, c1[3] = { 112, 66, 32 }, c2[3] = { 176, 120, 66 };   // dark walnut -> oak
    float tt = 0.40f + tn / 31.0f * 0.36f;
    for (int j = 0; j < 3; j++) c[j] = tt < 0.5f ? c0[j] + (c1[j] - c0[j]) * tt * 2 : c1[j] + (c2[j] - c1[j]) * (tt - 0.5f) * 2;
  } else {
    const WoodGrain &G = WOOD_GRAINS[grain - 1];
    float q = tn / 31.0f * 1.05f;
    for (int j = 0; j < 3; j++) {
      if (q < 0.25f) c[j] = G.late[j] * 0.55f + (G.late[j] - G.late[j] * 0.55f) * q / 0.25f;
      else { float g = (q - 0.25f) / 0.75f; c[j] = g <= 1 ? G.late[j] + (G.early[j] - G.late[j]) * g : G.early[j] * (1 + (g - 1) * 0.5f); }
    }
  }
}

uint8_t woodByte(int x, int y, int ce) {                     // one pixel of wood: tone and shade
  float fx = x + 0.5f - SCR_W / 2.0f, fy = y + 0.5f - crossYC;
  bool inH = fabsf(fy) < woodAW && fabsf(fx) < woodHHL;      // the crossbar (its grain runs across)
  int seed = inH ? 11 : 3, idx;
  if (woodGrain == 0) {                                      // classic: even, straight lines
    int u = (int)floorf(inH ? fx : fy), v = (int)floorf(inH ? fy : fx);
    int ring = (v * woodVS + woodWobT[inH][constrain(u + 512, 0, 1023)]) & 255;
    int fi = (v * woodFS) >> 8, fu = (u * woodUS) >> 8;
    int h = hash32((uint32_t)(fi * 7919 + fu * 104729 + seed * 97)) & 255;
    float t = 0.66f - woodGT[ring] / 255.0f * 0.2f + (h - 128) / 256.0f * 0.05f;
    idx = (int)lroundf((t - 0.40f) / 0.36f * 31);
  } else {                                                   // pine / rustic oak: growth rings round a pith off the board
    const WoodGrain &G = WOOD_GRAINS[woodGrain - 1];
    float uu = (inH ? fx : fy) / woodS, vv = (inH ? fy : fx) / woodS;
    float warp = (woodNoise2(uu * 0.02f + seed, vv * 0.06f + seed * 3, seed) - 0.5f) * G.warp + (woodNoise(uu * 0.004f + seed * 7, seed + 101) - 0.5f) * G.warp * 2;
    float cu = (uu - (inH ? G.u0H : G.u0V)) * G.arch, dv = vv + G.off + warp;
    float rc = sqrtf(dv * dv + cu * cu) * G.freq, f = rc - floorf(rc);
    float late = woodSst(G.l0, G.l1, f) * (1 - woodSst(0.96f, 1, f));
    float tonef = 1 + (woodNoise(uu * 0.01f + seed * 13, seed + 202) - 0.5f) * G.tone;
    float pore = woodHash01((int)floorf(vv * 1.2f) + seed * 131, (int)floorf(uu / G.poreLen)) < G.pores ? G.poreDark : 1;
    float fib = 1 + (woodHash01((int)floorf(vv * 2) + seed * 17, (int)floorf(uu * 0.3f)) - 0.5f) * 0.06f;
    float q = (0.25f + 0.75f * (1 - late)) * tonef * pore * fib;
    idx = (int)lroundf(q / 1.05f * 31);
  }
  float k = 1;
  if (ce <= 5) {                                             // bevelled edges, lit from the top left
    float e = -woodSD(fx, fy), bev = 3.2f * woodS;
    if (e < bev) {
      float gx = woodSD(fx + 1, fy) - woodSD(fx - 1, fy), gy = woodSD(fx, fy + 1) - woodSD(fx, fy - 1), gl = hypotf(gx, gy);
      if (gl < 1e-6f) gl = 1;
      float lit = -(gx / gl * 0.6f + gy / gl * 0.8f), q = 1 - fmaxf(e, 0) / bev;
      k = 1 + 0.28f * lit * q - 0.12f * q;
    }
  }
  if (inH ? (fabsf(fx) < woodAW + 0.5f && woodAW - fabsf(fy) < 1) : (fabsf(fy) < woodAW + 1 && fabsf(fy) >= woodAW)) k *= 0.86f;   // faint joint line
  int sh = 0;
  for (int i = 1; i < 8; i++) if (fabsf(WOOD_SHADE[i] - k) < fabsf(WOOD_SHADE[sh] - k)) sh = i;
  return (uint8_t)((constrain(idx, 0, 31) << 3) | sh);
}

void prepareWood() {
  float R = min(RADIUS, (SCR_H - 8) * (100.0f - BAR) / 100);
  woodGrain = CROSS_RIPPLE <= 10 ? CROSS_RIPPLE : 0;
  uint32_t key = 2166136261UL;
  uint32_t parts[] = { (uint32_t)(R * 16), CROSS_W, BEAM, BAR, BRIGHTNESS, SCR_W, SCR_H, (uint32_t)woodGrain, TONE, 2 };
  for (uint32_t v : parts) key = (key ^ v) * 16777619UL;
  if (!woodWobT) { woodWobT = (uint8_t (*)[1024])malloc(2 * 1024); if (!woodWobT) return; }
  if (key != woodKey) {
    woodKey = key;
    woodBot = R; woodTop = R * BAR / (100.0f - BAR);
    woodAW = max(2.0f, R * BEAM / 100.0f); woodHHL = max(woodAW + 1, min(R * CROSS_W / 100.0f, SCR_W / 2.0f - 2));
    woodS = R / 149.0f;
    woodVS = (int)lroundf(0.2f / woodS * 256); woodFS = (int)lroundf(1.5f / woodS * 256); woodUS = (int)lroundf(0.2f / woodS * 256);
    for (int i = 0; i < 256; i++) woodGT[i] = (uint8_t)lroundf(powf(fabsf(sinf(i * PI / 256)), 14) * 255);
    for (int k = 0; k < 2; k++) for (int u = 0; u < 1024; u++) woodWobT[k][u] = (uint8_t)lroundf(woodNoise((u - 512) * 0.008f / woodS, k ? 11 : 3) * 0.8f * 256);
    for (int tn = 0; tn < 32; tn++) {
      float c[3]; woodColorOf(woodGrain, tn, c);
      for (int sh = 0; sh < 8; sh++) {
        float k = WOOD_SHADE[sh] * BRIGHTNESS / 100.0f;
        woodPal8[tn * 8 + sh] = to565raw((uint8_t)min(255.0f, c[0] * k), (uint8_t)min(255.0f, c[1] * k), (uint8_t)min(255.0f, c[2] * k));
      }
    }
    for (int k = 0; k < 128; k++) { woodGlowT[k] = (uint16_t)(16 * 150 * expf(-k / (11 * woodS))); woodShT[k] = (uint8_t)(255 * (1 - 0.8f * expf(-k / 3.0f))); }
    for (int r = 0; r < 256; r++) {
      float qw = fmaxf(0, 1 - r / (1.35f * woodBot)); woodWideT[r] = (uint16_t)(16 * 50 * qw * qw);   // fades out smoothly
      float q = r / (1.3f * woodBot); woodVigT[r] = (uint8_t)(255 * fmaxf(0, 1 - q * q));   // a portal behind fades out toward the screen edge
    }
  }
  if (!woodBuf && !planeMap) woodBuf = (uint8_t *)malloc(SCR_WMAX * STRIP);   // (mapped flash needs no copy)
  uint32_t pk = 2166136261UL;                                // the wood bytes in flash: rebuilt when the shape or grain changes
  uint32_t pparts[] = { (uint32_t)(R * 16), CROSS_W, BEAM, BAR, SCR_W, SCR_H, (uint32_t)woodGrain, (uint32_t)crossYC, 3 };
  for (uint32_t v : pparts) pk = (pk ^ v) * 16777619UL;
  if (pk == woodPlaneKey) return;
  if (!woodPlaneReady(pk)) {
    int8_t *er = (int8_t *)malloc(SCR_W); uint8_t *row = (uint8_t *)malloc(SCR_W);
    if (!er || !row) { free(er); free(row); return; }
    woodPlaneBegin();
    for (int y = 0; y < SCR_H; y++) {
      readEdgeRow(y, er);
      for (int x = 0; x < SCR_W; x++) row[x] = er[x] > 0 ? woodByte(x, y, er[x]) : 0;
      woodPlaneRow(y, row);
      if ((y & 7) == 7) delay(1);
    }
    woodPlaneEnd(pk);
    free(er); free(row);
  }
  woodPlaneKey = pk;
}

#define woodPx(i) (woodBuf ? woodPal8[woodBuf[i]] : woodPal8[16 * 8 + 4])   // (woodBuf: the strip in the drawing function; none: plain wood)


// ---------- Cloud skies behind the Wooden cross (CROSS_FILL 8 blue sky, 9 sunset, 10 heavenly light) ----------
uint8_t *cloudTex = NULL;                       // 128 x 128 tileable cloud texture (made once, when first needed)
uint8_t  cloudDensT[512], cloudShT[64], cloudGlowT[128], cloudRayT[256], cloudRayRT[256], cloudCol[16][3];
float    cloudDrift = 0;
int      cloudK1 = 0, cloudK2 = 0, cloudK3 = 0, cloudK4 = 0, cloudKey = -1;
const uint8_t SKY_TOP[3][3] = { { 38, 96, 190 }, { 58, 38, 110 }, { 140, 178, 236 } }, SKY_MID[3] = { 225, 110, 92 };
const uint8_t SKY_BOT[3][3] = { { 150, 200, 240 }, { 255, 190, 110 }, { 255, 232, 190 } };
const uint8_t CL_LIT[3][3] = { { 250, 252, 255 }, { 255, 226, 180 }, { 255, 255, 250 } }, CL_SH[3][3] = { { 150, 168, 198 }, { 78, 44, 92 }, { 188, 188, 208 } };
const float   CL_COV[3][2] = { { 0.44f, 0.60f }, { 0.485f, 0.525f }, { 0.47f, 0.53f } };   // sunset and heavenly light: crisper cloud edges   // heavenly light: crisper cloud edges
const int     CL_DET[3] = { 36, 80, 64 }, CL_FINE[3] = { 0, 40, 0 }, CL_SHADE[3] = { 5, 7, 8 };   // CL_FINE: sunset's fine wisps                   // edge detail and shading strength
const float   CL_GLOW[3] = { 0.7f, 0.7f, 0.35f }, CL_RAY[3] = { 0.55f, 0.55f, 0.3f };    // heavenly light: softer glow and rays so the clouds show

uint8_t cloudLat(int ix, int iy, int p, int o) { ix &= p - 1; iy &= p - 1; return hash32((uint32_t)(ix * 73856093) ^ (uint32_t)(iy * 19349663) ^ (uint32_t)(o * 83492791)) & 255; }
bool cloudMemory() {
  if (cloudTex) return true;
  cloudTex = (uint8_t *)malloc(128 * 128);
  if (!cloudTex && picBuf2) {            // memory is in pieces: hand over core 1's fade buffer (crosses don't use it) and try again
    free(picBuf2); picBuf2 = NULL;
    cloudTex = (uint8_t *)malloc(128 * 128);
  }
  if (!cloudTex) return false;
  const int per[4] = { 4, 8, 16, 32 };
  const float amp[4] = { 0.52f, 0.27f, 0.14f, 0.05f };
  for (int y = 0; y < 128; y++) for (int x = 0; x < 128; x++) {
    float v = 0;
    for (int o = 0; o < 4; o++) {
      int p = per[o]; float fx = x * p / 128.0f, fy = y * p / 128.0f; int ix = (int)fx, iy = (int)fy;
      float u = fx - ix, w = fy - iy; u = u * u * (3 - 2 * u); w = w * w * (3 - 2 * w);
      float a = cloudLat(ix, iy, p, o), b = cloudLat(ix + 1, iy, p, o), c = cloudLat(ix, iy + 1, p, o), d = cloudLat(ix + 1, iy + 1, p, o);
      v += amp[o] * ((a + (b - a) * u) * (1 - w) + (c + (d - c) * u) * w);
    }
    cloudTex[y * 128 + x] = (uint8_t)min(255.0f, v / 0.98f);
  }
  return true;
}
inline int cloudAt(int X, int Y) {              // bilinear, coordinates in 1/256 of a texel
  int ix = (X >> 8) & 127, iy = (Y >> 8) & 127, fx = X & 255, fy = Y & 255, ix1 = (ix + 1) & 127, iy1 = (iy + 1) & 127;
  int a = cloudTex[iy * 128 + ix], b = cloudTex[iy * 128 + ix1], c = cloudTex[iy1 * 128 + ix], d = cloudTex[iy1 * 128 + ix1];
  int top = (a << 8) + (b - a) * fx, bot = (c << 8) + (d - c) * fx;
  return ((top << 8) + (bot - top) * fy) >> 16;
}
void prepareClouds(int kind, int amount) {   // amount: Full day's Cloud amount (50 = as designed; -1: not used)
  int key = kind * 1000000 + (int)(woodS * 1000) + (amount + 1) * 3;
  if (key == cloudKey) return;
  cloudKey = key;
  float shift = amount >= 0 ? (50 - amount) * 0.004f : 0, c0 = CL_COV[kind][0] + shift, c1 = CL_COV[kind][1] + shift;
  for (int i = 0; i < 512; i++) { float x = fminf(1, fmaxf(0, ((i - 128) / 255.0f - c0) / (c1 - c0))); cloudDensT[i] = (uint8_t)(255 * x * x * (3 - 2 * x)); }
  for (int k = 0; k < 64; k++) cloudShT[k] = (uint8_t)(255 * (1 - expf(-k / 2.5f) * (kind == 2 ? 0.15f : 0.45f)));
  for (int k = 0; k < 128; k++) cloudGlowT[k] = (uint8_t)(255 * CL_GLOW[kind] * expf(-k / (10 * woodS)));
  for (int a = 0; a < 256; a++) cloudRayT[a] = (uint8_t)(255 * powf(fmaxf(0, sinf(a * TWO_PI / 256)), 6));
  for (int r = 0; r < 256; r++) cloudRayRT[r] = (uint8_t)(255 * CL_RAY[kind] * fmaxf(0, 1 - r / (1.4f * woodBot)));
  for (int i = 0; i < 16; i++) for (int j = 0; j < 3; j++) cloudCol[i][j] = (uint8_t)(CL_SH[kind][j] + (CL_LIT[kind][j] - CL_SH[kind][j]) * i / 15);
  cloudK1 = (int)lroundf(64 / woodS * 256); cloudK2 = (int)lroundf(64 / woodS * 256 * 1.7f); cloudK3 = (int)lroundf(64 / woodS * 256 * 3.1f); cloudK4 = (int)lroundf(64 / woodS * 256 * 6.5f);
}
// Full day (fill 18): one sky that runs through a whole day in about 8 minutes: sunrise, a few minutes of blue sky,
// sunset, a starry night with the moon, then sunrise again (same as the Studio's preview).
#define FD_CYCLE 480.0
const float FD_KEYS[9][16] = {   // time, sky top, middle, bottom, lit cloud, cloud shadow (r g b each), stars
  { 0.00f, 18, 22, 56,  66, 46, 96,   186, 104, 92,  196, 150, 150, 56, 46, 80 },
  { 0.05f, 62, 82, 160, 236, 140, 104, 255, 196, 136, 255, 220, 186, 126, 88, 112 },
  { 0.12f, 44, 104, 196, 110, 160, 225, 168, 208, 244, 250, 252, 255, 150, 168, 198 },
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  { 1.00f, 18, 22, 56,  66, 46, 96,    186, 104, 92,  196, 150, 150, 56, 46, 80 },
};
const float FD_STARS[9] = { 0.35f, 0, 0, 0, 0, 0.45f, 1.0f, 0.85f, 0.35f };
float    fdTop[3], fdMid[3], fdBot[3];
uint8_t  fdCol[16][3];                     // the clouds in the day's light
int      fdStars = 0;                      // 0-256
int      fdBodyX = 0, fdBodyY = 0, fdBodyR = 0, fdDisc = 0, fdBodyOn = 0;   // the sun (or the moon): where, how big, how bright its disc is
uint8_t  fdBodyCol[3];
uint8_t  fdGlowT[256];                     // its glow, by distance (2 pixels a step)
int      fdTwk = 0, fdStarD = 18;
void prepareFullDay() {                    // once per frame
  const double cyc = FD_LEN * 60.0;        // Day length setting
  float tc = (float)(fmod(millis() / 1000.0, cyc) / cyc);
  int i = 0; while (i < 7 && tc >= FD_KEYS[i + 1][0]) i++;
  const float *A = FD_KEYS[i], *B = FD_KEYS[i + 1];
  float f = (tc - A[0]) / (B[0] - A[0]); f = f * f * (3 - 2 * f);
  float lit[3], sh[3];
  for (int j = 0; j < 3; j++) {
    fdTop[j] = A[1 + j] + (B[1 + j] - A[1 + j]) * f; fdMid[j] = A[4 + j] + (B[4 + j] - A[4 + j]) * f; fdBot[j] = A[7 + j] + (B[7 + j] - A[7 + j]) * f;
    lit[j] = A[10 + j] + (B[10 + j] - A[10 + j]) * f; sh[j] = A[13 + j] + (B[13 + j] - A[13 + j]) * f;
  }
  for (int k = 0; k < 16; k++) for (int j = 0; j < 3; j++) fdCol[k][j] = (uint8_t)(sh[j] + (lit[j] - sh[j]) * k / 15);
  fdStars = (int)(256 * (FD_STARS[i] + (FD_STARS[i + 1] - FD_STARS[i]) * f));
  fdTwk = (int)(fmod(millis() / 1000.0 * 2, TWO_PI) * 40.74f);
  fdBodyOn = 0;
  float day = (tc - 0.02f) / 0.60f, nt = (tc - 0.66f) / 0.32f;
  float R, G, a, disc;
  if (day > -0.05f && day < 1.05f) {                       // the sun: up from the lower left, over the top, down at the lower right
    float alt = sinf(fminf(1, fmaxf(0, day)) * PI), low = 1 - fminf(1, alt * 2.2f);
    a = fminf(1, fmaxf(0, alt * 6)) * FD_GLOW / 100.0f;   // Sun and moon brightness setting
    fdBodyX = (int)((0.06f + day * 0.88f) * SCR_W); fdBodyY = (int)(SCR_H * (1.02f - alt * 0.9f));
    fdBodyCol[0] = 255; fdBodyCol[1] = (uint8_t)(246 - low * 90); fdBodyCol[2] = (uint8_t)(214 - low * 150);
    R = SCR_H * 0.07f; G = SCR_H * 0.30f; disc = 1;
    for (int k = 0; k < 256; k++) {
      float d = k * 2.0f, g = d < R ? 1 : expf(-((d - R) / G) * ((d - R) / G) * 3) * 0.55f + (d < R * 1.25f ? (R * 1.25f - d) / (R * 0.25f) * 0.6f : 0);
      fdGlowT[k] = (uint8_t)(255 * fminf(1, fminf(1, g) * a));
    }
  } else if (nt > -0.03f && nt < 1.03f) {                  // the moon, through the night
    float alt = sinf(fminf(1, fmaxf(0, nt)) * PI);
    a = fminf(1, fmaxf(0, alt * 6)) * FD_GLOW / 100.0f;
    fdBodyX = (int)((0.12f + nt * 0.76f) * SCR_W); fdBodyY = (int)(SCR_H * (1.02f - alt * 0.85f));
    fdBodyCol[0] = 236; fdBodyCol[1] = 238; fdBodyCol[2] = 226;
    R = SCR_H * 0.045f; disc = 0.92f;
    for (int k = 0; k < 256; k++) { float d = k * 2.0f, q = (d - R) / (R * 2.2f), g = d < R ? 0.92f : expf(-q * q) * 0.22f; fdGlowT[k] = (uint8_t)(255 * fminf(1, g * a)); }
  } else { a = 0; R = 0; disc = 0; memset(fdGlowT, 0, sizeof(fdGlowT)); }
  if (a > 0) { fdBodyOn = 1; fdBodyR = (int)R; fdDisc = (int)(255 * fminf(1, disc * a)); }
  fdStarD = (FD_STARCNT * 3 + 5) / 10;      // Star count setting (100%: 30 in 1024 pixels)
}

// The big cloud shapes are worked out every 4 pixels and blended in between; the fine detail on their edges
// and where each cloud starts are worked out at every pixel, so the clouds stay crisp. The wood stays sharp.
#define CG 4
#define CGW (SCR_WMAX / CG + 2)
#define CGH (9600 / SCR_WMAX / CG + 3)
uint8_t  cgNc[2][CGH][CGW], cgQc[2][CGH][CGW];                               // the big cloud shapes and the heavenly rays at each grid point
int16_t  cgDc[2][CGH][CGW];                                                  // how the clouds are lit from above (one set per core)
uint16_t lnc[2][CGW], lqc[2][CGW];
int16_t  ldc[2][CGW];
uint16_t rowDc[2][128], rowFc[2][128];                                       // this row of the cloud picture, for the per-pixel detail (one set per core)
HOT void renderCloudStrip(int y0, int rows, uint16_t *strip) {
  if (woodBuf) readWoodRows(y0, rows, woodBuf);
  const int core = CORE_ID();
  const int8_t *edgeBuf = edgeRows(y0); const uint8_t *woodBuf = woodRows(y0); const uint8_t look = lk[core].look;   // this core's strip and style
  uint8_t (*cgN)[CGW] = cgNc[core], (*cgQ)[CGW] = cgQc[core];
  int16_t (*cgD)[CGW] = cgDc[core];
  uint16_t *ln = lnc[core], *lq = lqc[core];
  int16_t *ld = ldc[core];
  uint16_t *rowD = rowDc[core], *rowF = rowFc[core];
  const bool fdOn = look == 18;                 // Full day: sunset's crisp clouds, the day's own colours
  int kind = fdOn ? 1 : look - 8, br = BRIGHTNESS * 256 / 100;
  const uint8_t (*colT)[3] = fdOn ? fdCol : cloudCol;
  const int bR2 = fdBodyR * fdBodyR, bR2o = (fdBodyR + 1) * (fdBodyR + 1);
  const int detK = CL_DET[kind], fineK = CL_FINE[kind], shadeK = CL_SHADE[kind];
  int clearN = 0; while (clearN < 384 && cloudDensT[constrain(clearN + 128 + ((128 * (detK + fineK)) >> 8) + 1, 0, 511)] == 0) clearN++;   // below this, never any cloud
  int D1 = (int)(cloudDrift * 76.8f), D2 = (int)((cloudDrift * 0.3f + 97) * 128), D3 = (int)((cloudDrift * 0.2f + 53) * 128), D4 = (int)((cloudDrift * 0.4f + 29) * 128);
  int rayPh = (int)(millis() / 1000.0f * 0.15f * 40.74f);
  const int gy0 = y0 / CG, gy1 = (y0 + rows - 1) / CG + 1, gw = SCR_W / CG + 1;
  for (int gy = gy0; gy <= gy1 && gy - gy0 < CGH; gy++) {          // the grid points this strip needs
    int y = gy * CG;
    int Y1 = (y * cloudK1) >> 8, Y2 = ((y * cloudK2) >> 8) + 31 * 128;
    const int r0 = gy - gy0;
    for (int gx = 0; gx <= gw; gx++) {
      int x = gx * CG;
      int X1 = ((x * cloudK1) >> 8) + D1, X2 = ((x * cloudK2) >> 8) + D2;
      int n  = (cloudAt(X1, Y1) * 205 + cloudAt(X2, Y2) * 51) >> 8;
      int n2 = (cloudAt(X1, Y1 - 768) * 205 + cloudAt(X2, Y2 - 1280) * 51) >> 8;   // a little higher up: light comes from above
      cgN[r0][gx] = (uint8_t)n; cgD[r0][gx] = (int16_t)(n - n2);
      int q = 0;
      if (kind == 2) { int r, a; polarAt(min(x, SCR_W - 1), min(y, SCR_H - 1), crossYC, r, a); q = (cloudRayT[(a * 9 + rayPh) & 255] * cloudRayRT[r]) >> 8; }   // heavenly rays
      else if (fdOn && fdBodyOn) { float dx = x - fdBodyX, dy = y - fdBodyY; int d2 = (int)(sqrtf(dx * dx + dy * dy) * 0.5f); q = fdGlowT[d2 > 255 ? 255 : d2]; }   // the sun's (or moon's) glow
      cgQ[r0][gx] = (uint8_t)q;
    }
  }
  uint16_t *p = strip;
  for (int y = y0; y < y0 + rows; y++) {
    const int r0 = y / CG - gy0, fy = y % CG, wy = CG - fy;
    for (int gx = 0; gx <= gw; gx++) {
      ln[gx] = cgN[r0][gx] * wy + cgN[r0 + 1][gx] * fy; ld[gx] = cgD[r0][gx] * wy + cgD[r0 + 1][gx] * fy;
      lq[gx] = cgQ[r0][gx] * wy + cgQ[r0 + 1][gx] * fy;
    }
    const int Y3 = ((y * cloudK3) >> 8) + 11 * 128, Y4 = ((y * cloudK4) >> 8) + 7 * 128;
    {                                             // this row of the detail layers, worked out once (then only blended across)
      const uint8_t *t0 = cloudTex + ((Y3 >> 8) & 127) * 128, *t1 = cloudTex + (((Y3 >> 8) + 1) & 127) * 128; const int f = Y3 & 255;
      for (int i = 0; i < 128; i++) rowD[i] = (uint16_t)((t0[i] << 8) + (t1[i] - t0[i]) * f);
      if (fineK) {
        const uint8_t *u0 = cloudTex + ((Y4 >> 8) & 127) * 128, *u1 = cloudTex + (((Y4 >> 8) + 1) & 127) * 128; const int g = Y4 & 255;
        for (int i = 0; i < 128; i++) rowF[i] = (uint16_t)((u0[i] << 8) + (u1[i] - u0[i]) * g);
      }
    }
    float fyy = (float)y / SCR_H; if (fyy > 1) fyy = 1;   // the sky: a smooth fade from top to bottom
    int sky0, sky1, sky2;
    {
      int sky[3];
      if (fdOn) for (int j = 0; j < 3; j++) sky[j] = (int)(fyy < 0.55f ? fdTop[j] + (fdMid[j] - fdTop[j]) * fyy / 0.55f : fdMid[j] + (fdBot[j] - fdMid[j]) * (fyy - 0.55f) / 0.45f);
      else for (int j = 0; j < 3; j++) sky[j] = kind == 1 ? (int)(fyy < 0.55f ? SKY_TOP[1][j] + (SKY_MID[j] - SKY_TOP[1][j]) * fyy / 0.55f : SKY_MID[j] + (SKY_BOT[1][j] - SKY_MID[j]) * (fyy - 0.55f) / 0.45f)
                                                   : (int)(SKY_TOP[kind][j] + (SKY_BOT[kind][j] - SKY_TOP[kind][j]) * fyy);
      sky0 = sky[0]; sky1 = sky[1]; sky2 = sky[2];
    }
    const int8_t *eb = edgeBuf + (y - y0) * SCR_W;
    const int bdy = y - fdBodyY, nearRow = fdOn && fdBodyOn && bdy * bdy <= bR2o;   // rows the sun's (or moon's) disc crosses
    for (int x = 0; x < SCR_W; x++) {
      int ce = eb[x];
      if (ce > 0) {                                 // the wood, lit a little by the sky on its edges
        uint16_t c = woodPx((y - y0) * SCR_W + x);
        if (kind == 1 && ce <= 1) c = max565(c, to565raw(64, 42, 22));
        if (kind == 2 && ce <= 2) c = max565(c, ce == 1 ? to565raw(170, 156, 120) : to565raw(110, 100, 78));
        *p++ = c;
        continue;
      }
      const int gx = x / CG, fx = x % CG, wx = CG - fx, k = -ce;
      const int n = (ln[gx] * wx + ln[gx + 1] * fx) >> 4, dn = (ld[gx] * wx + ld[gx + 1] * fx) >> 4;   // (CG * CG = 16)
      int det = 0, dens = 0;
      if (n >= clearN) {                            // (clear sky: the detail can't reach a cloud, so it's skipped)
        { const int X = ((x * cloudK3) >> 8) + D3, i = (X >> 8) & 127, fx2 = X & 255; det = ((((rowD[i] * (256 - fx2) + rowD[(i + 1) & 127] * fx2) >> 16) - 128) * detK) >> 8; }   // crisp, puffy edges, right at this pixel
        if (fineK) { const int X = ((x * cloudK4) >> 8) + D4, i = (X >> 8) & 127, fx2 = X & 255; det += ((((rowF[i] * (256 - fx2) + rowF[(i + 1) & 127] * fx2) >> 16) - 128) * fineK) >> 8; }   // sunset: fine wisps on the edges
        dens = cloudDensT[constrain(n + det + 128, 0, 511)];
      }
      const uint8_t *cc = colT[constrain(158 + dn * shadeK + ((det * 3) >> 1), 0, 255) >> 4];
      int b0 = sky0, b1 = sky1, b2 = sky2;
      if (fdOn) {                                   // Full day: the sun (or moon) and the stars, behind the clouds
        int g = (lq[gx] * wx + lq[gx + 1] * fx) >> 4;
        if (nearRow) { int bdx = x - fdBodyX, d2 = bdx * bdx + bdy * bdy; if (d2 < bR2) { if (fdDisc > g) g = fdDisc; } else if (d2 < bR2o && fdDisc / 2 > g) g = fdDisc / 2; }
        if (g) { b0 += ((fdBodyCol[0] - b0) * g) >> 8; b1 += ((fdBodyCol[1] - b1) * g) >> 8; b2 += ((fdBodyCol[2] - b2) * g) >> 8; }
        if (fdStars > 2) {
          uint32_t h = hash32((uint32_t)(y * SCR_W + x) * 2654435761UL);
          if ((int)(h & 1023) < fdStarD) {
            int v = ((150 + (int)((h >> 20) & 105)) * (154 + sinT[(fdTwk + (h >> 10)) & 255] * 102 / 127) >> 8) * fdStars >> 8;
            if ((v * 235 >> 8) > b0) b0 = v * 235 >> 8;
            if ((v * 242 >> 8) > b1) b1 = v * 242 >> 8;
            if (v > b2) b2 = v;
          }
        }
      }
      int c0 = b0 + (((cc[0] - b0) * dens) >> 8), c1 = b1 + (((cc[1] - b1) * dens) >> 8), c2 = b2 + (((cc[2] - b2) * dens) >> 8);
      if (kind == 2) {                              // heavenly light: rays and a glow from behind the cross
        int q = ((lq[gx] * wx + lq[gx + 1] * fx) >> 4) + cloudGlowT[k > 127 ? 127 : k];
        if (q > 255) q = 255;
        c0 += ((255 - c0) * q) >> 8; c1 += ((248 - c1) * q) >> 8; c2 += ((225 - c2) * q) >> 8;
      }
      int m = (cloudShT[k > 63 ? 63 : k] * br) >> 8;  // soft shadow round the wood, and the brightness setting
      *p++ = to565((c0 * m) >> 8, (c1 * m) >> 8, (c2 * m) >> 8);
    }
  }
}

HOT void renderWoodStrip(int y0, int rows, uint16_t *strip, int phase, int phase2) {
  const uint8_t look = lk[CORE_ID()].look;
  if ((look >= 8 && look <= 10) || look == 18) { renderCloudStrip(y0, rows, strip); return; }   // a cloud sky behind the cross
  if (woodBuf) readWoodRows(y0, rows, woodBuf);
  const int8_t *edgeBuf = edgeRows(y0); const uint8_t *woodBuf = woodRows(y0);
  if (look == 4 || look >= 14) {                 // a space picture behind the cross
    renderSpaceStrip(y0, rows, strip);
    for (int y = y0, i = 0; y < y0 + rows; y++) for (int x = 0; x < SCR_W; x++, i++) {
      int ce = edgeBuf[i];
      if (ce > 0) strip[i] = woodPx(i);
      else if (-ce < 12) strip[i] = dim565(strip[i], woodShT[-ce]);
    }
    return;
  }
  uint16_t *p = strip;
  for (int y = y0; y < y0 + rows; y++) {
    const int8_t *eb = edgeBuf + (y - y0) * SCR_W;
    for (int x = 0; x < SCR_W; x++) {
      int ce = eb[x];
      if (ce > 0) {
        uint16_t c = woodPx((y - y0) * SCR_W + x);
        if (look == 7 && ce <= 3) c = max565(c, pal[min(255, ((3 - ce) * 60 * woodPulse) >> 8)]);   // warm light on the edge
        *p++ = c;
        continue;
      }
      int k = -ce, r, a, v;
      polarAt(x, y, crossYC, r, a);
      if (look == 7) { *p++ = glowPx(((woodGlowT[k] + woodWideT[r]) * woodPulse) >> 8, x, y); continue; }   // warm glow, slowly breathing (smooth, dithered)
      else {                                         // a portal behind the cross, centred on the crossing
        int e = edgeT[a];
        if (r < e) { v = styleV(look, a, r, phase, phase2); int kk = e - r; if (kk < 64 && rimT[kk] > v) v = rimT[kk]; }
        else { int kk = r - e; v = kk < 64 ? rimT[kk] : 0; int hh = haloT[kk > 255 ? 255 : kk]; if (hh > v) v = hh; }
        v = (((v * woodShT[k]) >> 8) * woodVigT[r]) >> 8;   // soft shadow around the wood, fading toward the edge
      }
      *p++ = pal[v > 255 ? 255 : v];
    }
  }
}

HOT void useLook(int L, bool cross) {        // the style and cross a scene draws with (set before each scene's strip)
  look = L;
  crossOn = cross;
  woodOn = cross && STYLE == 17;
  spCY = cross ? crossYC : QY;
  spU = L == 15 ? 118.0f / SP_EXT : 236.0f / min(SCR_W, SCR_H);
  spExt = SP_EXT * spU;
  SceneLook &k = lk[CORE_ID()];          // and this core's own copy
  k.look = L; k.cross = cross; k.wood = woodOn; k.spCY = spCY; k.spU = spU; k.spExt = spExt;
}

HOT void renderStrip(int y0, int rows, uint16_t *strip) {
  const SceneLook &LKc = lk[CORE_ID()]; const uint8_t look = LKc.look; const bool crossOn = LKc.cross, woodOn = LKc.wood;   // this core's style
  const int8_t *edgeBuf = edgeRows(y0);
  const int phase = (int)(t * 1.5f * 40.74f), phase2 = (int)(-t * 40.74f);
  uint16_t *p = strip;
  bool cross = crossOn;
  if (cross) readCrossRows(y0, rows);
  if (cross && woodOn) { renderWoodStrip(y0, rows, strip, phase, phase2); return; }
  if (look == 4 || look >= 14) {                   // Galaxy, Nebula, Wormhole, Meteor Shower (also inside a cross)
    renderSpaceStrip(y0, rows, strip);
    if (cross) crossMask(y0, rows, strip, look, phase, phase2);
    return;
  }
  const bool outPortal = cross && outLook != 255 && !isGridSpace(outLook), outSpace = cross && isGridSpace(outLook);
  if (outSpace) {                                  // a space picture outside the cross: drawn first, the cross goes over it
    SceneLook &K = lk[CORE_ID()]; SceneLook keep = K;
    K.look = outLook; K.spCY = crossYC; K.spU = outLook == 15 ? 118.0f / SP_EXT : 236.0f / min(SCR_W, SCR_H); K.spExt = SP_EXT * K.spU;
    renderSpaceStrip(y0, rows, strip);
    K = keep;
  }
  for (int y = y0; y < y0 + rows; y++) {
    int qy = y < QY ? QY - 1 - y : y - QY;
    bool low = y >= QY;
    const int8_t *eb = cross ? edgeBuf + (y - y0) * SCR_W : NULL;
    for (int x = 0; x < SCR_W; x++) {
      int qi = qy * TQX + colMap[x], r = rT[qi], a0 = aT[qi];
      int a = (x >= QX ? (low ? a0 : 256 - a0) : (low ? 128 - a0 : 128 + a0)) & 255;
      int e = edgeT[a];
      int v, rk = 0, gx = 0;
      if (eb) {                                        // Cross: the chosen style inside, glowing rim along the cross edge
        int ce = eb[x];
        if (ce > 0) {
          if (outLook != look) polarAt(x, y, crossYC, r, a);   // centred on the crossing (the same style behind the whole cross: one picture, centred on the screen)
          v = styleV(look, a, r, phase, phase2) + crossRipT[ce];   // Ripple rings on top of the fill
          if (xOwn) gx = crossRimT[ce]; else if (crossRimT[ce] > v) v = crossRimT[ce];   // (its own colour: the rim goes on top below)
          rk = ce;
        } else {
          int g = max(crossRimT[-ce], crossHaloT[-ce]);
          if (xOwn) { gx = g; v = 0; } else v = g;
          if (outPortal) { int ov = (styleV(outLook, a, r, phase, phase2) * OUT_DIM) >> 8; if (ov > v) v = ov; }   // a portal style outside (centred on the screen)
        }
      } else if (look == 7) {                                // Cartoon Sticker: ragged edge, light outline, no glow
        int jag = (((nz(nzB, 63, a * 4 + (phase >> 1)) - 128) * 7 + (nz(nzC, 255, a * 16 + phase) - 128) * 4) >> 7) * (100 - RIM_SMOOTH) / 100;
        int e2 = (int)(RADIUS * 1.02f + jag / 4.0f);
        v = r >= e2 ? 0 : r >= e2 - max(1, (int)lroundf(4 * RIM_W / 100.0f)) ? 235 : cartoonV(a, r, phase);   // outline: Rim thickness
      } else if (r < e) {
        v = styleV(look, a, r, phase, phase2);
        int k = e - r; if (k < 64 && rimT[k] > v) v = rimT[k];
      } else {
        int k = r - e; v = k < 64 ? rimT[k] : 0;       // rim
        int h = haloT[k > 255 ? 255 : k]; if (h > v) v = h;   // outer halo
      }
      uint16_t px = pal[v > 255 ? 255 : v];
      if (rk && ripColOn && ripA[rk]) px = mix565(px, ripC565[rk], ripA[rk]);   // Gradient ripple
      if (outSpace && !rk) px = max565(dim565(*p, OUT_DIM), px);              // the space picture outside, under the glow
      if (gx) px = max565(px, xpal[gx]);                                      // the cross outline in its own colour
      *p++ = px;
    }
  }
  for (uint8_t i = 0; i < NUM_SPARKS; i++) {           // sparks in this strip
    if (look == 11) break;                             // a solid-colour cross has no sparks
    if (look == 5 && sparks[i].r < bhHole) continue;  // they vanish into the black hole
    for (int dy = 0; dy < 2; dy++) for (int dx = 0; dx < 2; dx++) {
      int xx = sparkX[i] + dx, yy = sparkY[i] + dy;
      if (xx >= 0 && xx < SCR_W && yy >= y0 && yy < y0 + rows && !(cross && edgeBuf[(yy - y0) * SCR_W + xx] <= 0)) strip[(yy - y0) * SCR_W + xx] = pal[235];
    }
  }
}

// ---------- frame-rate readout (Serial Monitor, 115200 baud) ----------
uint32_t fpsFrames = 0, fpsSince = 0;
volatile uint32_t drawUs = 0, sendUs = 0;   // time spent working out the pixels and sending them to the screen
#if USE_DMA
extern bool lcdDma;
#endif
#if DUAL_CORE
extern volatile float helpShare; extern volatile bool sharing;
#endif
void countFrame() {
  fpsFrames++;
  uint32_t now = millis();
  if (now - fpsSince >= 5000) {
    Serial.print(F("FPS: "));
    Serial.print(fpsFrames * 1000.0f / (now - fpsSince), 1);
    Serial.print(F(" draw ")); Serial.print(drawUs / 1000.0f / fpsFrames, 1);
    Serial.print(F(" ms send ")); Serial.print(sendUs / 1000.0f / fpsFrames, 1); Serial.print(F(" ms"));
#if USE_DMA
    Serial.print(lcdDma ? F(" (dma") : F(" (no dma"));
#elif DUAL_CORE
    Serial.print(F(" ("));
#endif
#if DUAL_CORE
    Serial.print(F(", core 1 draws ")); Serial.print(sharing ? (int)(helpShare * 100 + 0.5f) : 0); Serial.print(F("%)"));
#endif
    Serial.println();
    fpsFrames = 0; drawUs = 0; sendUs = 0;
    fpsSince = now;
  }
}

#if USE_DMA
// ---------- DMA to the screen: the chip sends each strip by itself while the cores draw ----------
spi_device_handle_t lcdDev;
bool lcdDma = false;
spi_transaction_t lcdTr[2];
volatile int64_t lcdDoneAt[3];
int64_t lcdQueuedAt[2], lcdLastDone = 0;
void IRAM_ATTR lcdDoneCb(spi_transaction_t *t) { lcdDoneAt[(int)(intptr_t)t->user] = esp_timer_get_time(); }

bool lcdSend(const uint8_t *d, int n, bool dc, uint32_t waitMs) {   // a command byte (dc low) or its few data bytes (dc high)
  digitalWrite(PIN_DC, dc);
  spi_transaction_t t;
  memset(&t, 0, sizeof(t));
  t.length = n * 8; t.flags = SPI_TRANS_USE_TXDATA; t.user = (void *)2;
  memcpy(t.tx_data, d, n);
  if (spi_device_polling_start(lcdDev, &t, portMAX_DELAY) != ESP_OK) return false;   // (polling only accepts "wait as long as needed")
  return spi_device_polling_end(lcdDev, pdMS_TO_TICKS(waitMs)) == ESP_OK;
}

bool lcdWindow(uint32_t waitMs) {        // whole screen, then "write memory": the strips follow
  const uint8_t ca = 0x2A, ra = 0x2B, wr = 0x2C;
  const uint8_t x[4] = { 0, 0, (uint8_t)((SCR_W - 1) >> 8), (uint8_t)(SCR_W - 1) };
  const uint8_t y[4] = { 0, 0, (uint8_t)((SCR_H - 1) >> 8), (uint8_t)(SCR_H - 1) };
  if (!lcdSend(&ca, 1, false, waitMs) || !lcdSend(x, 4, true, waitMs)) return false;
  if (!lcdSend(&ra, 1, false, waitMs) || !lcdSend(y, 4, true, waitMs)) return false;
  if (!lcdSend(&wr, 1, false, waitMs)) return false;
  digitalWrite(PIN_DC, HIGH);
  lcdLastDone = esp_timer_get_time();
  return true;
}

bool lcdQueue(int b, int rows, uint32_t waitMs) {
  spi_transaction_t &t = lcdTr[b];
  memset(&t, 0, sizeof(t));
  t.length = SCR_W * rows * 16; t.tx_buffer = stripBuf[b]; t.user = (void *)(intptr_t)b;
  lcdQueuedAt[b] = esp_timer_get_time();
  return spi_device_queue_trans(lcdDev, &t, pdMS_TO_TICKS(waitMs)) == ESP_OK;
}

bool lcdFinish(int b, uint32_t waitMs) {   // wait for strip b to finish sending
  spi_transaction_t *r;
  if (spi_device_get_trans_result(lcdDev, &r, pdMS_TO_TICKS(waitMs)) != ESP_OK) return false;
  int64_t start = lcdQueuedAt[b] > lcdLastDone ? lcdQueuedAt[b] : lcdLastDone;
  sendUs += (uint32_t)(lcdDoneAt[b] - start);
  lcdLastDone = lcdDoneAt[b];
  return true;
}

bool beginDma() {                        // after the screen is set up: move its pins to the DMA driver, and check it works
  SPI.end();
  spi_bus_config_t bc;
  memset(&bc, 0, sizeof(bc));
  bc.mosi_io_num = PIN_MOSI; bc.miso_io_num = -1; bc.sclk_io_num = PIN_SCK; bc.quadwp_io_num = -1; bc.quadhd_io_num = -1;
  bc.max_transfer_sz = SCR_WMAX * STRIP * 2;
  if (spi_bus_initialize(SPI2_HOST, &bc, SPI_DMA_CH_AUTO) != ESP_OK) return false;
  spi_device_interface_config_t dc;
  memset(&dc, 0, sizeof(dc));
  dc.clock_speed_hz = SPI_HZ; dc.mode = 0; dc.spics_io_num = -1; dc.queue_size = 3; dc.post_cb = lcdDoneCb;
  dc.flags = SPI_DEVICE_HALFDUPLEX | SPI_DEVICE_NO_DUMMY;
  if (spi_bus_add_device(SPI2_HOST, &dc, &lcdDev) != ESP_OK) { spi_bus_free(SPI2_HOST); return false; }
  pinMode(PIN_CS, OUTPUT); digitalWrite(PIN_CS, LOW);   // the screen is the only thing listening on these pins
  if (!lcdWindow(100)) return false;
  memset(stripBuf[0], 0, SCR_WMAX * STRIP * 2);
  if (!lcdQueue(0, STRIP, 100) || !lcdFinish(0, 300)) return false;   // one strip of black: the DMA really runs
  sendUs = 0;
  return true;
}
#endif

#if DUAL_CORE
// Both cores draw: core 0 the top of each strip, core 1 the bottom (when the style allows), then core 1 sends it.
SemaphoreHandle_t readySem[2], freeSem[2], goSem[2], helperIdle;
volatile int stripY0[2], stripRows[2], stripHelp[2];   // the strip in each buffer, and how many of its bottom rows core 1 draws
volatile uint32_t wait0Us = 0, wait1Us = 0;           // time each core spent waiting for the other
volatile float helpShare = 0.3f;                       // part of each strip core 1 draws, balanced every frame
volatile bool sharing = false;

bool shareable(uint8_t s, int L, bool cross) {   // one scene: can both cores draw it at once?
  if (isFramed(s)) return false;                        // portal around a picture keeps one strip buffer
  if (cross && !planeMap) return false;                 // crosses: both cores read the outline and wood straight from mapped flash
  if (isPicture(s)) return true;
  return spX1 || !(L == 4 || L == 14 || L == 16) || (L == 14 && nebReady);       // Galaxy, Nebula and Meteor Shower need core 1's own gas grid (not the stored Nebula)
}

bool canShare() {                        // styles whose drawing can be split between the two cores
  if (sceneMix > 0 && sceneA != sceneB)                 // fading: both scenes on both cores (each core has its own fade buffer)
  {
    if (!picBuf2 && picBuf && STYLE != 17) picBuf2 = (uint16_t *)malloc(SCR_WMAX * STRIP * 2);   // (given back to the clouds earlier: take it again if there's room)
    return picBuf && picBuf2 && shareable(sceneA, lookA, crossA) && shareable(sceneB, lookB, crossB);
  }
  bool useB = sceneMix >= 128;
  uint8_t s = useB ? sceneB : sceneA;
  if (s != PORTAL && !isStyleScene(s)) return false;   // pictures
  return shareable(s, useB ? lookB : lookA, useB ? crossB : crossA);
}

inline void swapBytes565(uint16_t *p, int n) {   // DMA: the screen wants each pixel's high byte first
#if USE_DMA
  if (!lcdDma) return;
  uint32_t *w = (uint32_t *)p;
  for (int i = 0; i < n / 2; i++) { uint32_t v = w[i]; w[i] = ((v & 0x00FF00FFu) << 8) | ((v >> 8) & 0x00FF00FFu); }
#endif
}

void balanceCores(uint32_t frameUs) {    // move rows toward whichever core is waiting
  if (sharing && frameUs > 0) {
    float d = ((float)wait1Us - (float)wait0Us) / frameUs, h = helpShare + 0.25f * d;
    helpShare = h < 0 ? 0 : h > 0.85f ? 0.85f : h;
  }
  wait0Us = 0; wait1Us = 0;
}

void renderTask(void *) {         // runs on core 0
  uint8_t b = 0;
  bool first = true;
  for (;;) {
    uint32_t w = micros();
    xSemaphoreTake(helperIdle, portMAX_DELAY);   // core 1 has finished its part of the last frame
    wait0Us += micros() - w;
    if (!first) frameEnd();
    first = false;
    frameStart();
    bool share = canShare();
    sharing = share;
    for (int y0 = 0; y0 < SCR_H; y0 += STRIP) {
      w = micros();
      xSemaphoreTake(freeSem[b], portMAX_DELAY);
      wait0Us += micros() - w;
      int rows = min(STRIP, SCR_H - y0), help = share ? (int)(rows * helpShare + 0.5f) : 0;
      if (help > rows - 1) help = rows - 1;
      stripY0[b] = y0; stripRows[b] = rows; stripHelp[b] = help;
      xSemaphoreGive(goSem[b]);
      uint32_t t0 = micros();
      composeStrip(y0, rows - help, stripBuf[b]);
      swapBytes565(stripBuf[b], SCR_W * (rows - help));
      drawUs += micros() - t0;
      xSemaphoreGive(readySem[b]);
      b ^= 1;
    }
    vTaskDelay(1);                // let core 0's housekeeping run
  }
}
#endif

// Big tables live on the heap so large screens fit next to Bluetooth
bool allocBuffers() {
  rT = (uint8_t *)malloc(TQX * TQY);
  aT = (uint8_t *)malloc(TQX * TQY);
  if (!rT || !aT) return false;
  const int first = STRIP;
  for (int withSpace = 1; withSpace >= 0; withSpace--) {   // try to make room for the space styles too, then without
    for (STRIP = first; STRIP >= (withSpace ? 4 : 2); STRIP /= 2) {   // smaller strips if memory is tight
#if USE_DMA
      stripBuf[0] = (uint16_t *)heap_caps_malloc(SCR_WMAX * STRIP * 2, MALLOC_CAP_DMA);
      stripBuf[1] = (uint16_t *)heap_caps_malloc(SCR_WMAX * STRIP * 2, MALLOC_CAP_DMA);
#else
      stripBuf[0] = (uint16_t *)malloc(SCR_WMAX * STRIP * 2);
      stripBuf[1] = (uint16_t *)malloc(SCR_WMAX * STRIP * 2);
#endif
      picBuf = picturesAvailable() ? (uint16_t *)malloc(SCR_WMAX * STRIP * 2) : NULL;   // for fades (pictures and other styles)
      edgeBuf = crossAvailable() ? (int8_t *)malloc(SCR_WMAX * STRIP) : NULL;            // for the cross styles
      bool space = !withSpace || spaceMemory();                                        // Galaxy, Nebula, Wormhole, Meteor Shower
      if (stripBuf[0] && stripBuf[1] && (picBuf || !picturesAvailable()) && (edgeBuf || !crossAvailable()) && space) return true;
      free(stripBuf[0]); free(stripBuf[1]); free(picBuf); free(edgeBuf); picBuf = NULL; edgeBuf = NULL;
      free(spH); free(spV); free(spX); free(spaceLUT); free(noise8); spH = spV = spX = NULL; spaceLUT = NULL; noise8 = NULL;
      free(spH1); free(spV1); free(spX1); spH1 = spV1 = spX1 = NULL;
      freeRing();
    }
  }
  return false;
}

void setup() {
#if defined(ESP32)
  Serial.setRxBufferSize(1024);          // room for picture data
#endif
  Serial.begin(115200);
  delay(300);
  Serial.println(F("[portal] starting"));
  beginBus();
  tft.begin(SPI_HZ);
  tft.fillScreen(0);
  beginTap();
  Serial.println(F("[portal] screen ready"));
#if HAS_BLE
  beginBluetooth();                      // Bluetooth first: it needs one big block of memory
  Serial.println(F("[portal] bluetooth ready"));
#endif
  beginPictures();
  bool bufsOk = allocBuffers();
#if DUAL_CORE
  if (bufsOk && picBuf) picBuf2 = (uint16_t *)malloc(SCR_WMAX * STRIP * 2);   // optional: smoother fades
#endif
  if (!bufsOk) {
    tft.setTextColor(0xFFFF); tft.setTextSize(2); tft.setCursor(10, SCR_H * PX / 2 - 8); tft.print(F("Not enough memory"));   // say so on the screen too
    for (;;) { Serial.println(F("[portal] not enough memory for this screen")); delay(2000); }
  }
#if defined(ESP32)
  Serial.printf("[portal] memory ok, %u bytes free, %d rows per strip, room for %d pictures, space styles %s\n", (unsigned)ESP.getFreeHeap(), STRIP, picturesAvailable(), spaceLUT ? "ready" : "off (not enough memory)");
#endif
  loadSettings();
  loadScenes();
  buildTone();
  if (spaceLUT) buildSpaceLUT();
#if TURNS
  if (wantPortrait != PORTRAIT || wantFlip != FLIP) {   // saved turned another way
    setSize(wantPortrait); FLIP = wantFlip;
    tft.setRotation(rotNow());
    tft.fillScreen(0);
  }
#endif
  randomSeed(micros());
  buildGeometry();
  buildParams();
  buildPalette();
  resetSparks();
#if USE_DMA
  lcdDma = beginDma();
  if (!lcdDma) { beginBus(); tft.setSPISpeed(SPI_HZ); }   // DMA didn't answer: back to the Arduino way
  Serial.println(lcdDma ? F("[portal] screen DMA on") : F("[portal] screen DMA off"));
#endif
#if DUAL_CORE
  for (int i = 0; i < 2; i++) {
    readySem[i] = xSemaphoreCreateBinary();
    freeSem[i] = xSemaphoreCreateBinary();
    goSem[i] = xSemaphoreCreateBinary();
    xSemaphoreGive(freeSem[i]);
  }
  helperIdle = xSemaphoreCreateBinary();
  xSemaphoreGive(helperIdle);
  xTaskCreatePinnedToCore(renderTask, "portal", 4096, NULL, 1, NULL, 0);
#endif
  Serial.println(F("[portal] running"));
}

#if PX > 1
uint16_t pxLine[SCR_WMAX * PX];                // one screen row, each drawn pixel repeated PX times
void sendStrip(uint16_t *buf, int rows) {
  for (int r = 0; r < rows; r++) {
    const uint16_t *src = buf + r * SCR_W;
    for (int k = 0; k < PX; k++) {             // refilled each time: the SPI driver may byte-swap the buffer
      for (int x = 0; x < SCR_W; x++) for (int j = 0; j < PX; j++) pxLine[x * PX + j] = src[x];
      tft.writePixels(pxLine, SCR_W * PX);
    }
  }
}
#else
void sendStrip(uint16_t *buf, int rows) { tft.writePixels(buf, SCR_W * rows); }
#endif

void loop() {
  readSerial();
#if defined(ESP32)
  if (rebootAt && (int32_t)(millis() - rebootAt) >= 0) ESP.restart();   // Restart board button in the Studio
#endif
#if HAS_BLE
  readBluetooth();
#endif
  if (pausedForUpload()) return;         // the screen holds still while a picture arrives
#if DUAL_CORE
  static uint8_t b = 0;
  uint32_t frameT0 = micros();
  int pending = -1;
  for (int y0 = 0; y0 < SCR_H; y0 += STRIP) {
    xSemaphoreTake(goSem[b], portMAX_DELAY);
    int rows = stripRows[b], help = stripHelp[b];
    if (y0 == 0) {                       // a new frame: its size is settled now
#if TURNS
      if (turnPending) {                 // the screen was turned: tell the panel
#if USE_DMA
        if (lcdDma) { uint8_t c = 0x36, m = MADCTL_ROT[rotNow()]; lcdSend(&c, 1, false, 1000); lcdSend(&m, 1, true, 1000); } else
#endif
        tft.setRotation(rotNow());
        turnPending = false;
      }
#endif
#if USE_DMA
      if (lcdDma) lcdWindow(1000); else
#endif
      { tft.startWrite(); tft.setAddrWindow(0, 0, SCR_W * PX, SCR_H * PX); }
    }
    if (help) {                          // core 1's share of the drawing: the bottom rows
      uint16_t *dst = stripBuf[b] + (rows - help) * SCR_W;
      composeStrip(stripY0[b] + rows - help, help, dst);
      swapBytes565(dst, SCR_W * help);
    }
    if (y0 + STRIP >= SCR_H) xSemaphoreGive(helperIdle);   // core 0 can start the next frame
    uint32_t t0 = micros();
    xSemaphoreTake(readySem[b], portMAX_DELAY);
    wait1Us += micros() - t0;
#if USE_DMA
    if (lcdDma) {                        // send this strip in the background, then free the one before
      lcdQueue(b, rows, 1000);
      if (pending >= 0) { lcdFinish(pending, 1000); xSemaphoreGive(freeSem[pending]); }
      pending = b;
    } else
#endif
    {
      t0 = micros();
      sendStrip(stripBuf[b], rows);
      sendUs += micros() - t0;
      xSemaphoreGive(freeSem[b]);
    }
    b ^= 1;
    readSerialQuick();                   // new settings get an answer even while a slow frame is drawn
    pollTap();
  }
#if USE_DMA
  if (pending >= 0) { lcdFinish(pending, 1000); xSemaphoreGive(freeSem[pending]); }
  if (!lcdDma)
#endif
  tft.endWrite();
  countFrame();
  balanceCores(micros() - frameT0);
  return;
#else
  frameStart();
#if TURNS
  if (turnPending) { tft.setRotation(rotNow()); turnPending = false; }
#endif
  tft.startWrite();
  tft.setAddrWindow(0, 0, SCR_W * PX, SCR_H * PX);
  for (int y0 = 0; y0 < SCR_H; y0 += STRIP) {
    int rows = min(STRIP, SCR_H - y0);
    uint32_t t0 = micros();
    composeStrip(y0, rows, stripBuf[0]);
    uint32_t t1 = micros();
    sendStrip(stripBuf[0], rows);
    drawUs += t1 - t0; sendUs += micros() - t1;
    readSerialQuick();
    pollTap();
  }
  frameEnd();
  tft.endWrite();
  countFrame();
#endif
}
