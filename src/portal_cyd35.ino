// Vortex Portal for the 3.5–4.0″ rectangle ST7796 colour display (480x320, landscape)
// Generated by Vortex Portal Studio for: 3.5″ ESP32 display board (Hosyond / LCDwiki E32R35T, screen built in)
// Works on ESP32 (all types), Raspberry Pi Pico (RP2040/RP2350) and Teensy 4.
// To use another board, change the pin numbers in the "Board" section below.
// Libraries (Library Manager): "Adafruit ST7735 and ST7789 Library" and "Adafruit GFX Library".
// The portal is drawn in the centre of the screen.
//
// Wiring:  none, the screen is built into the board. Tools -> Board -> ESP32 Dev Module.
//
// Live tuning: open Vortex Portal Studio in Chrome and tap "Connect over Bluetooth"
// (ESP32 boards), or plug in over USB and click "Connect over USB". The board saves them.

#if defined(__AVR__) || defined(ESP8266)
  #error "This screen needs a board with more memory: an ESP32, Raspberry Pi Pico or Teensy 4."
#endif

#include <SPI.h>
#include <Adafruit_GFX.h>
#include <Adafruit_ST7796S.h>
#include <EEPROM.h>
#include <math.h>
#if defined(ESP32)
  #include <freertos/FreeRTOS.h>
  #include <freertos/semphr.h>
#endif
#if defined(ESP32) && __has_include("rom/tjpgd.h")
  #define HAS_PICS 1                      // pictures: stored in flash, unpacked by the chip's built-in JPEG decoder
  #include <esp_partition.h>
  #include "rom/tjpgd.h"
#else
  #define HAS_PICS 0
#endif

// ---------- Board: 3.5″ ESP32 display board (Hosyond / LCDwiki E32R35T, screen built in) ----------
// SPI pins (GPIO numbers). On boards with fixed SPI pins (Uno, Nano, Mega,
// ESP8266, Teensy) CLK and DIN must go to the hardware SPI pins shown in the
// Studio; CS, DC and RST can be any free pins.
#define PIN_SCK   14
#define PIN_MOSI  13
#define PIN_CS    15
#define PIN_DC    2
#define PIN_RST   -1

// Declared early so the Arduino IDE's automatic function prototypes compile
struct Spark;
struct Saved;

void beginBus() {
#if defined(ESP32)
  SPI.begin(PIN_SCK, -1, PIN_MOSI, PIN_CS);
#elif defined(ARDUINO_ARCH_RP2040)
  SPI.setSCK(PIN_SCK);
  SPI.setTX(PIN_MOSI);
  SPI.begin();
#else
  SPI.begin();                     // fixed hardware SPI pins
#endif
}
#define SPI_HZ    27000000UL   // screen speed; lower it if the picture glitches

#define SCR_W      480          // screen width and height as mounted
#define SCR_H      320
#define QX         240          // centre of the screen
#define QY         160
#define TQX        (SCR_W - QX)
#define TQY        (SCR_H - QY)
int      STRIP = 9600 / SCR_W;          // rows drawn per chunk (fewer if memory is tight)
#define MAX_SPARKS 30
#define MAX_PICS   8                     // picture slots
#define PORTAL     255                   // scene number for the portal itself
#define RADIUS_MAX 249
#define SP_EXT     288          // space styles: distance from the centre to the edge of the picture area

// ---------- Settings baked in from the Studio ----------
float    RADIUS     = 150.00;   // portal size in pixels
float    OVAL       = 1.00;    // 1.0 = round, higher = wide oval
uint8_t  ARMS       = 4;       // spiral arms
float    TWIST      = 2.40;    // how tightly the arms coil
float    SPEED      = 0.12;    // spin per frame
uint8_t  NUM_SPARKS = 28;      // particles being sucked in
bool     DRIFT      = false;    // Wormhole: true = Reverse, the rings fly out toward you (LCDs don't need burn-in drift)
uint32_t COLOR_CORE = 0x3B1CFF;  // inner colour
uint32_t COLOR_RIM  = 0x38F0FF;  // outer colour
uint8_t  BRIGHTNESS = 100;     // 10-100 %: dims the portal's colours
uint8_t  STYLE      = 0;       // 0 Vortex, 1 Toon Spiral, 2 Starburst, 3 Hyperspace, 4 Galaxy (Hubble-style spiral), 5 Black hole, 6 Cartoon Swirl, 7 Cartoon Sticker,
                                // crosses: 8 Latin, 9 Celtic, 10 Budded, 11 Patriarchal, 12 Orthodox, 13 Pattee (ESP32 boards)
                                // more space: 14 Nebula, 15 Wormhole, 16 Meteor Shower
uint32_t SPACE_COLS[4] = { 0x4A2C1A, 0xFF5C9A, 0x6EA8FF, 0xFFF0CF };   // Galaxy, Nebula, Wormhole, Meteor Shower: four colours blended together
uint8_t  CROSS_W    = 46;      // crosses: how far the crossbar reaches, % of the lower arm (25-100)
uint8_t  BEAM       = 14;      // crosses: beam thickness, % of the portal size (5-30)
uint8_t  BAR        = 32;      // crosses: crossbar height (20-50, 50 = all arms the same length)
uint8_t  STARS      = 3;       // space styles: star density (1-6)
bool     FADE_ON    = false;    // fade through the colour sets
uint8_t  FADE_COUNT = 1;       // extra colour sets after the main colours (1-3)
uint32_t FADE_COLS[6] = { 0xFF3D00, 0xFFD36B, 0x000000, 0x000000, 0x000000, 0x000000 };   // core, rim pairs
uint8_t  RIM_SMOOTH = 0;       // 0 = wobbly energy edge, 100 = perfectly smooth ring
float    FADE_SECS  = 8;       // seconds for each fade (0 min 8 sec)
uint8_t  RIPPLES    = 2;       // Starburst: rings expanding at once (0-6)
float    RIP_SPEED  = 0.09;    // Starburst: ripple speed (0.03-0.30)
float    GLOW_SIZE  = 0.55;    // Starburst: centre glow size (0.30-0.90)
uint8_t  SCENE_COUNT = 0;      // scenes shown in turn (0 = just the portal)
uint8_t  SCENES[8]  = { 255, 255, 255, 255, 255, 255, 255, 255 };   // 255 = the portal, 0-7 = pictures, 128-135 = portal around a picture
float    HOLD_SECS  = 10;       // seconds each scene stays on screen
float    SCENE_FADE = 2;       // seconds to fade into the next scene (0 = instant)
uint8_t  FRAME_PCT  = 50;      // "portal around a picture" scenes (128 + picture): how much of the picture the portal covers, 10-95 %
// --------------------------------------------------------

// Changes every time you copy a new sketch, so freshly uploaded settings
// win over ones saved earlier by live tuning.
const uint32_t BUILD_ID = 0x5DD7B671UL;

Adafruit_ST7796S tft(PIN_CS, PIN_DC, PIN_RST);   // needs the Adafruit ST7735 and ST7789 Library 1.11 or newer

// Lookup tables: distance and angle for one quarter of the screen (mirrored for the rest)
uint8_t  *rT, *aT;                     // TQX x TQY each, allocated in setup()
uint8_t  colMap[SCR_W];
int8_t   sinT[256];
int16_t  twistT[256], twist2T[256], edgeT[256];
uint8_t  depthT[256], coreT[256], haloT[256], rimT[64], centerT[256];
uint8_t  sbGlowT[256], sbRingT[256], sbOuterT[256], ripCrestT[256], ripTroughT[256];
uint8_t  spCoreT[256], bhRingT[256], bhDiskT[256], bhStarT[256];
uint16_t galFadeT[256];
uint8_t  warpOn[768];
float    warpRR[768], warpLen[768], warpB[768];
int      bhHole = 20, twinkle = 0;
int16_t  linT[256];
uint16_t pal[256];
uint16_t *stripBuf[2];                 // two strips: one is drawn while the other is sent (allocated in setup)
uint16_t *picBuf = NULL;               // a third strip, for fading between scenes
int      crossYC = QY;                 // crosses: row of the crossing (the cross is centred, so this sits above the middle)

// Dual-core chips (ESP32, ESP32-S3) draw on core 0 while core 1 feeds the screen.
#if defined(ESP32) && !CONFIG_FREERTOS_UNICORE
  #define DUAL_CORE 1
#else
  #define DUAL_CORE 0
#endif

// New settings from live tuning are applied between frames
volatile bool havePending = false;

struct Spark { float a, r; };
Spark sparks[MAX_SPARKS];
int16_t sparkX[MAX_SPARKS], sparkY[MAX_SPARKS];
float t = 0;

struct Saved { uint32_t id; float radius, oval, twist, speed; uint8_t arms, sparks, drift; uint32_t core, rim; uint8_t bright, style, ripples; float ripSpeed, glow; uint8_t stars, fadeOn, fadeCount; uint32_t fadeCols[6]; float fadeSecs; uint8_t rimSmooth; uint8_t sceneCount, scenes[8]; float holdSecs, sceneFade; uint8_t framePct, crossW, beam, bar; uint32_t spaceCols[4]; };
static_assert(sizeof(Saved) <= 128, "settings must fit the 128 bytes of EEPROM");

// ---------- tables ----------
// Cartoon styles: smooth looping noise tables
uint8_t nzA[32], nzB[64], nzC[256];
uint32_t nzSeed = 12345;
uint8_t nzRnd() { nzSeed = (nzSeed * 1103515245UL + 12345UL) & 0x7fffffffUL; return (nzSeed >> 16) & 255; }

void nzTable(uint8_t *t, int len, int passes) {
  int tmp[256], n[256];
  for (int i = 0; i < len; i++) n[i] = nzRnd();
  for (int p = 0; p < passes; p++) {
    for (int i = 0; i < len; i++) tmp[i] = (n[(i + len - 1) % len] + 2 * n[i] + n[(i + 1) % len]) >> 2;
    for (int i = 0; i < len; i++) n[i] = tmp[i];
  }
  int lo = 255, hi = 0;
  for (int i = 0; i < len; i++) { if (n[i] < lo) lo = n[i]; if (n[i] > hi) hi = n[i]; }
  for (int i = 0; i < len; i++) t[i] = (uint8_t)lroundf((n[i] - lo) * 255.0f / (hi - lo));
}

inline int nz(const uint8_t *t, int mask, int x) {
  int i = x >> 4, f = x & 15;
  return (t[i & mask] * (16 - f) + t[(i + 1) & mask] * f) >> 4;
}

void buildGeometry() {
  nzTable(nzA, 32, 1);
  nzTable(nzB, 64, 1);
  nzTable(nzC, 256, 2);
  for (int qy = 0; qy < TQY; qy++) {
    for (int qx = 0; qx < TQX; qx++) {
      float fx = qx + 0.5f, fy = qy + 0.5f;
      rT[qy * TQX + qx] = (uint8_t)min(255L, lroundf(sqrtf(fx * fx + fy * fy)));
      aT[qy * TQX + qx] = (uint8_t)lroundf(atan2f(fy, fx) / (PI / 2) * 64);
    }
  }
  for (int i = 0; i < 256; i++) sinT[i] = (int8_t)lroundf(127 * sinf(i * TWO_PI / 256));
}

void buildParams() {
  float R = RADIUS;
  for (int r = 0; r < 256; r++) {
    float rn = max((float)r, 0.5f) / R, lr = logf(rn), x = min(rn, 1.0f);
    twistT[r]  = (int16_t)(TWIST * 3.0f * lr * 40.74f);
    twist2T[r] = (int16_t)(TWIST * 1.6f * lr * 40.74f);
    depthT[r]  = (uint8_t)(255 * x * x * (3 - 2 * x));
    coreT[r]   = (uint8_t)(210 * expf(-rn * rn * 18));
    haloT[r]   = (uint8_t)(115 * expf(-r / R * 3.2f));
    linT[r]    = (int16_t)(r * TWIST * 1.2f * 256 / R);
    centerT[r] = (uint8_t)(55 * expf(-powf(rn * 2.2f, 2)));
    // Starburst: glowing centre, soft rings near the centre, rays toward the rim
    float sr = r / R, f1 = min(1.0f, sr / GLOW_SIZE), f2 = min(1.0f, max(0.0f, (sr - 0.15f) / 0.55f));
    int inner = (int)(256 * (1 - f1 * f1 * (3 - 2 * f1)));
    sbOuterT[r] = (uint8_t)min(255, (int)(256 * f2 * f2 * (3 - 2 * f2)));
    sbRingT[r]  = (uint8_t)min(255, (inner * inner * inner) >> 16);
    sbGlowT[r]  = (uint8_t)(105 * expf(-powf(sr / GLOW_SIZE * 1.4f, 2)));
    // Space: bright core, galaxy arm fade, black hole ring and disk
    spCoreT[r]  = (uint8_t)(230 * expf(-powf(rn / 0.16f, 2)));
    galFadeT[r] = (uint16_t)max(0, (int)(256 * (1 - sr * 0.7f)));
    float hr = 0.22f * R, dn = (sr - 0.22f) / 0.45f;
    bhRingT[r]  = (uint8_t)(255 * expf(-powf((r - hr - 1.5f) / 1.8f, 2)));
    bhDiskT[r]  = (dn >= 0 && dn < 1) ? (uint8_t)(235 - dn * 200) : 0;
    bhStarT[r]  = dn > 0.85f ? 1 : 0;
  }
  for (int d = 0; d < 64; d++) rimT[d] = (uint8_t)(255 * expf(-powf(d * 9.0f / R, 2)));
  for (int x = 0; x < SCR_W; x++) {
    int dx = x < QX ? QX - 1 - x : x - QX;
    colMap[x] = (uint8_t)min((long)(TQX - 1), lroundf(dx / OVAL));
  }
}

uint16_t to565(uint8_t r, uint8_t g, uint8_t b) { return ((r & 0xF8) << 8) | ((g & 0xFC) << 3) | (b >> 3); }

uint32_t mixColor(uint32_t x, uint32_t y, float f) {   // blend two 0xRRGGBB colours
  uint32_t out = 0;
  for (int i = 0; i < 3; i++) {
    int cx = (x >> (16 - 8 * i)) & 0xFF, cy = (y >> (16 - 8 * i)) & 0xFF;
    out |= (uint32_t)(int)(cx + (cy - cx) * f) << (16 - 8 * i);
  }
  return out;
}

void buildPaletteFrom(uint32_t core, uint32_t rim) {   // black -> core -> rim -> near-white
  uint8_t a[3], b[3];
  for (int i = 0; i < 3; i++) { a[i] = (core >> (16 - 8 * i)) & 0xFF; b[i] = (rim >> (16 - 8 * i)) & 0xFF; }
  for (int i = 0; i < 256; i++) {
    uint8_t c[3];
    for (int k = 0; k < 3; k++) {
      float v;
      if (i < 110)      v = a[k] * (i / 110.0f);
      else if (i < 200) v = a[k] + (b[k] - a[k]) * ((i - 110) / 90.0f);
      else              v = b[k] + (255 - b[k]) * ((i - 200) / 55.0f * 0.6f);
      c[k] = (uint8_t)(v * BRIGHTNESS / 100.0f);
    }
    pal[i] = to565(c[0], c[1], c[2]);
  }
}

// Space colour table: 64 hues blended around the four space colours x 64 brightness levels
uint16_t *spaceLUT = NULL;             // allocated the first time a space style is shown
void buildSpaceLUT() {
  if (!spaceLUT) return;
  for (int h = 0; h < 64; h++) {
    float p = h / 16.0f; int i = (int)p; float f = p - i; f = f * f * (3 - 2 * f);
    uint32_t A = SPACE_COLS[i & 3], B = SPACE_COLS[(i + 1) & 3];
    float base[3];
    for (int k = 0; k < 3; k++) { int ca = (A >> (16 - 8 * k)) & 0xFF, cb = (B >> (16 - 8 * k)) & 0xFF; base[k] = ca + (cb - ca) * f; }
    for (int b = 0; b < 64; b++) {
      float v = b / 63.0f; uint8_t c[3];
      for (int k = 0; k < 3; k++) {
        float x = base[k] * min(1.0f, v / 0.75f);
        if (v > 0.75f) x += (255 - x) * (v - 0.75f) / 0.25f * 0.8f;   // the brightest parts glow toward white
        if (x > 255) x = 255;
        c[k] = (uint8_t)(x * BRIGHTNESS / 100.0f);
      }
      spaceLUT[h * 64 + b] = to565(c[0], c[1], c[2]);
    }
  }
}

void buildPalette() { buildPaletteFrom(COLOR_CORE, COLOR_RIM); buildSpaceLUT(); }

void updateColourFade() {             // fade through the colour sets in order, FADE_SECS per fade
  if (!FADE_ON || FADE_COUNT < 1) return;
  int n = 1 + FADE_COUNT;              // main colours + extra sets
  float pos = fmodf(millis() / 1000.0f / FADE_SECS, (float)n);
  int i = (int)pos, j = (i + 1) % n;
  float f = pos - i;
  f = f * f * (3 - 2 * f);
  uint32_t coreA = i == 0 ? COLOR_CORE : FADE_COLS[(i - 1) * 2], rimA = i == 0 ? COLOR_RIM : FADE_COLS[(i - 1) * 2 + 1];
  uint32_t coreB = j == 0 ? COLOR_CORE : FADE_COLS[(j - 1) * 2], rimB = j == 0 ? COLOR_RIM : FADE_COLS[(j - 1) * 2 + 1];
  buildPaletteFrom(mixColor(coreA, coreB, f), mixColor(rimA, rimB, f));
}

// ---------- space helpers ----------
uint32_t hash32(uint32_t n) {
  n = (n ^ 61) ^ (n >> 16);
  n *= 9;
  n ^= n >> 4;
  n *= 0x27d4eb2dUL;
  n ^= n >> 15;
  return n;
}

int starAt(int a, int r) {             // one twinkling star per small patch of sky
  uint32_t h = hash32((uint32_t)((a >> 1) * 977 + (r >> 2) * 131));
  if ((int)(h & 63) >= STARS * 2) return 0;
  if ((a & 1) != (int)((h >> 8) & 1) || (r & 3) != (int)((h >> 10) & 3)) return 0;
  return 120 + ((sinT[((h >> 12) + (uint32_t)twinkle) & 255] + 127) >> 1);
}

// ---------- sparks ----------
void respawn(Spark &s) {
  s.a = random(0, 628) / 100.0;
  s.r = RADIUS * 1.05 + random(0, (int)(RADIUS / 5) + 1);
}

void resetSparks() {
  for (uint8_t i = 0; i < NUM_SPARKS; i++) {
    respawn(sparks[i]);
    sparks[i].r = random(4, (int)RADIUS + 10);
  }
}

void updateSparks() {
  for (uint8_t i = 0; i < NUM_SPARKS; i++) {
    Spark &s = sparks[i];
    s.r *= 0.95;                                         // fall inward
    s.a += SPEED * 2.0 * (RADIUS / (s.r + RADIUS * 0.22));  // faster near the centre
    if (s.r < 3) respawn(s);
    sparkX[i] = (int16_t)floorf(QX + cosf(s.a) * s.r * OVAL);
    sparkY[i] = (int16_t)floorf((STYLE >= 8 && STYLE <= 13 ? crossYC : QY) + sinf(s.a) * s.r);
  }
}

// ---------- saved settings (EEPROM) ----------
bool validScenes(const Saved &s) {
  if (s.sceneCount > 8 || !(s.holdSecs >= 1 && s.holdSecs <= 3600) || !(s.sceneFade >= 0 && s.sceneFade <= 600)) return false;
  if (s.framePct < 10 || s.framePct > 95) return false;
  if (s.crossW < 25 || s.crossW > 100 || s.beam < 5 || s.beam > 30 || s.bar < 20 || s.bar > 50) return false;
  for (int k = 0; k < 4; k++) if (s.spaceCols[k] > 0xFFFFFF) return false;
  for (uint8_t i = 0; i < s.sceneCount; i++) {
    uint8_t c = s.scenes[i];
    if (c != PORTAL && c >= MAX_PICS && (c < 128 || c >= 128 + MAX_PICS)) return false;
  }
  return true;
}

bool valid(const Saved &s) {
  return s.radius >= 6 && s.radius <= RADIUS_MAX && s.oval >= 1 && s.oval <= 2 &&
         s.arms >= 1 && s.arms <= 8 && s.twist >= 0 && s.twist <= 6 &&
         s.speed >= 0 && s.speed <= 0.4f && s.sparks <= MAX_SPARKS &&
         s.core <= 0xFFFFFF && s.rim <= 0xFFFFFF && s.bright >= 10 && s.bright <= 100 && s.style <= 16 && s.stars >= 1 && s.stars <= 6 && s.fadeCount >= 1 && s.fadeCount <= 3 && s.fadeSecs >= 1 && s.fadeSecs <= 3600 && s.rimSmooth <= 100 &&
         s.ripples <= 6 && s.ripSpeed >= 0.03f && s.ripSpeed <= 0.3f && s.glow >= 0.3f && s.glow <= 0.9f &&
         validScenes(s);
}

void apply(const Saved &s) {
  RADIUS = s.radius; OVAL = s.oval; TWIST = s.twist; SPEED = s.speed;
  ARMS = s.arms; NUM_SPARKS = s.sparks; DRIFT = s.drift;
  COLOR_CORE = s.core; COLOR_RIM = s.rim; BRIGHTNESS = s.bright; STYLE = s.style;
  RIPPLES = s.ripples; RIP_SPEED = s.ripSpeed; GLOW_SIZE = s.glow; STARS = s.stars;
  FADE_ON = s.fadeOn; FADE_COUNT = s.fadeCount; FADE_SECS = s.fadeSecs; RIM_SMOOTH = s.rimSmooth;
  for (int k = 0; k < 6; k++) FADE_COLS[k] = s.fadeCols[k] & 0xFFFFFF;
  SCENE_COUNT = s.sceneCount; HOLD_SECS = s.holdSecs; SCENE_FADE = s.sceneFade; FRAME_PCT = s.framePct;
  CROSS_W = s.crossW; BEAM = s.beam; BAR = s.bar;
  for (int k = 0; k < 8; k++) SCENES[k] = s.scenes[k];
  for (int k = 0; k < 4; k++) SPACE_COLS[k] = s.spaceCols[k];
}

void loadSettings() {
#if defined(ESP32) || defined(ESP8266) || defined(ARDUINO_ARCH_RP2040)
  EEPROM.begin(128);
#endif
  Saved s;
  EEPROM.get(0, s);
  if (s.id == BUILD_ID && valid(s)) apply(s);
}

void saveSettings() {
  Saved s = { BUILD_ID, RADIUS, OVAL, TWIST, SPEED, ARMS, NUM_SPARKS, (uint8_t)DRIFT, COLOR_CORE, COLOR_RIM, BRIGHTNESS, STYLE, RIPPLES, RIP_SPEED, GLOW_SIZE, STARS, (uint8_t)FADE_ON, FADE_COUNT };
  for (int k = 0; k < 6; k++) s.fadeCols[k] = FADE_COLS[k];
  s.fadeSecs = FADE_SECS;
  s.rimSmooth = RIM_SMOOTH;
  s.sceneCount = SCENE_COUNT; s.holdSecs = HOLD_SECS; s.sceneFade = SCENE_FADE; s.framePct = FRAME_PCT;
  s.crossW = CROSS_W; s.beam = BEAM; s.bar = BAR;
  for (int k = 0; k < 8; k++) s.scenes[k] = SCENES[k];
  for (int k = 0; k < 4; k++) s.spaceCols[k] = SPACE_COLS[k];
  EEPROM.put(0, s);
#if defined(ESP32) || defined(ESP8266) || defined(ARDUINO_ARCH_RP2040)
  EEPROM.commit();
#endif
}

Saved pendingSettings;

float clampf(float v, float lo, float hi) { return v < lo ? lo : v > hi ? hi : v; }
uint8_t clampb(uint8_t v, uint8_t lo, uint8_t hi) { return v < lo ? lo : v > hi ? hi : v; }
void clampSettings(Saved &s) {
  s.radius = clampf(s.radius, 6, RADIUS_MAX); s.oval = clampf(s.oval, 1, 2); s.arms = clampb(s.arms, 1, 8);
  s.twist = clampf(s.twist, 0, 6); s.speed = clampf(s.speed, 0, 0.4f); if (s.sparks > MAX_SPARKS) s.sparks = MAX_SPARKS;
  s.core &= 0xFFFFFF; s.rim &= 0xFFFFFF; s.bright = clampb(s.bright, 10, 100); if (s.style > 16) s.style = 0;
  s.stars = clampb(s.stars, 1, 6); s.fadeCount = clampb(s.fadeCount, 1, 3); s.fadeSecs = clampf(s.fadeSecs, 1, 3600);
  if (s.rimSmooth > 100) s.rimSmooth = 100; if (s.ripples > 6) s.ripples = 6;
  s.ripSpeed = clampf(s.ripSpeed, 0.03f, 0.3f); s.glow = clampf(s.glow, 0.3f, 0.9f);
  for (int k = 0; k < 6; k++) s.fadeCols[k] &= 0xFFFFFF;
  for (int k = 0; k < 4; k++) s.spaceCols[k] &= 0xFFFFFF;
  if (s.sceneCount > 8) s.sceneCount = 8;
  s.holdSecs = clampf(s.holdSecs, 1, 3600); s.sceneFade = clampf(s.sceneFade, 0, 600); s.framePct = clampb(s.framePct, 10, 95);
  s.crossW = clampb(s.crossW, 25, 100); s.beam = clampb(s.beam, 5, 30); s.bar = clampb(s.bar, 20, 50);
  for (int k = 0; k < 8; k++) { uint8_t c = s.scenes[k]; if (c != PORTAL && c >= MAX_PICS && (c < 128 || c >= 128 + MAX_PICS)) s.scenes[k] = PORTAL; }
}

// ---------- pictures (ESP32 boards: kept in the flash "spiffs" partition) ----------
// The Studio crops each picture to this screen, sends it as a small JPEG and the
// board unpacks it into flash. Tools -> Partition Scheme -> "No OTA (2MB APP/2MB SPIFFS)"
// gives the most room. Commands: INFO, IMG slot bytes id, D base64..., END.
// (HAS_PICS and the JPEG decoder are set up with the other #includes at the top)
bool    crossReady = false;               // cross outline ready to read (styles 8-13)
int8_t *edgeBuf = NULL;                   // one strip of the cross outline
uint8_t crossRimT[128], crossHaloT[128];  // rim and outer glow, sized to the beam

#if HAS_PICS
struct PicHead { uint32_t magic; uint16_t w, h; uint32_t id, check; };
const uint32_t PIC_MAGIC = 0x43495056UL;   // "VPIC"
const uint32_t STAGE_SIZE = 0x30000;       // room for one arriving JPEG (192 KB, enough for high quality on big screens)
const esp_partition_t *picPart = NULL;
uint32_t slotSize = 0, stageOff = 0;      // stageOff: where an arriving JPEG waits (last 64 KB)
uint32_t crossOff = 0, crossSize = 0;     // the cross outline: distance to the edge for every pixel
uint8_t  picSlots = 0;
volatile uint32_t picId[MAX_PICS];        // 0 = empty slot
volatile bool uploading = false;
uint32_t upLen = 0, upPos = 0, upId = 0, upLast = 0, jpgPos = 0;
uint8_t  upSlot = 0;
uint16_t *band = NULL;
int      bandTop = 0;

void beginPictures() {
  picPart = esp_partition_find_first(ESP_PARTITION_TYPE_DATA, ESP_PARTITION_SUBTYPE_DATA_SPIFFS, NULL);
  if (!picPart) picPart = esp_partition_find_first(ESP_PARTITION_TYPE_DATA, ESP_PARTITION_SUBTYPE_DATA_FAT, NULL);
  if (!picPart || picPart->size < 0x80000) { picPart = NULL; return; }
  slotSize = (sizeof(PicHead) + (uint32_t)SCR_W * SCR_H * 2 + 4095) & ~4095UL;
  stageOff = (picPart->size - STAGE_SIZE) & ~4095UL;
  crossSize = (16 + (uint32_t)SCR_W * SCR_H + 4095) & ~4095UL;   // the cross outline lives just before the staging area
  crossOff = stageOff - crossSize;
  picSlots = min((uint32_t)MAX_PICS, crossOff / slotSize);
  for (uint8_t i = 0; i < picSlots; i++) {
    PicHead h;
    esp_partition_read(picPart, i * slotSize, &h, sizeof(h));
    bool ok = h.magic == PIC_MAGIC && h.w == SCR_W && h.h == SCR_H && h.id && h.check == (h.id ^ 0xA5A5A5A5UL);
    picId[i] = ok ? h.id : 0;
  }
}

int  picturesAvailable() { return picSlots; }
bool isPicture(uint8_t s) { return s < picSlots && picId[s] != 0; }

void readPicture(uint8_t s, int y0, int rows, uint16_t *dst) {
  esp_partition_read(picPart, s * slotSize + sizeof(PicHead) + (uint32_t)y0 * SCR_W * 2, dst, (uint32_t)rows * SCR_W * 2);
}

bool pausedForUpload() {
  if (uploading && millis() - upLast > 10000) uploading = false;   // the Studio went away mid-picture
  if (uploading) delay(1);
  return uploading;
}

int b64(char c) {
  if (c >= 'A' && c <= 'Z') return c - 'A';
  if (c >= 'a' && c <= 'z') return c - 'a' + 26;
  if (c >= '0' && c <= '9') return c - '0' + 52;
  if (c == '+') return 62;
  if (c == '/') return 63;
  return -1;
}

int unbase64(const char *in, uint8_t *out) {   // returns bytes written, -1 on bad data
  int n = 0, bits = 0;
  uint32_t acc = 0;
  for (; *in && *in != '='; in++) {
    int v = b64(*in);
    if (v < 0) return -1;
    acc = (acc << 6) | v; bits += 6;
    if (bits >= 8) { bits -= 8; out[n++] = (acc >> bits) & 0xFF; }
  }
  return n;
}

UINT jpgIn(JDEC *jd, BYTE *buf, UINT n) {        // JPEG bytes come from the staging area
  if (n > upLen - jpgPos) n = upLen - jpgPos;
  if (buf) esp_partition_read(picPart, stageOff + jpgPos, buf, n);
  jpgPos += n;
  return n;
}

UINT jpgOut(JDEC *jd, void *bmp, JRECT *r) {     // one block of pixels: collect a band, then store it
  BYTE *c = (BYTE *)bmp;
  for (int y = r->top; y <= r->bottom; y++)
    for (int x = r->left; x <= r->right; x++, c += 3)
      band[(y - bandTop) * SCR_W + x] = to565(c[0], c[1], c[2]);
  if (r->right == SCR_W - 1) {
    esp_partition_write(picPart, upSlot * slotSize + sizeof(PicHead) + (uint32_t)bandTop * SCR_W * 2,
                        band, (uint32_t)(r->bottom - bandTop + 1) * SCR_W * 2);
    bandTop = r->bottom + 1;
  }
  return 1;
}

const char *finishPicture() {
  uploading = false;
  if (upPos != upLen) return "ERR incomplete";
  static uint8_t pool[3100];               // the JPEG decoder's work area
  JDEC jd;
  jpgPos = 0;
  if (jd_prepare(&jd, jpgIn, pool, sizeof(pool), NULL) != JDR_OK) return "ERR jpeg";
  if (jd.width != SCR_W || jd.height != SCR_H) return "ERR size";
  band = (uint16_t *)malloc(SCR_W * 16 * 2);
  if (!band) return "ERR memory";
  esp_partition_erase_range(picPart, upSlot * slotSize, slotSize);
  bandTop = 0;
  JRESULT r = jd_decomp(&jd, jpgOut, 0);
  free(band); band = NULL;
  if (r != JDR_OK) return "ERR jpeg";
  PicHead h = { PIC_MAGIC, SCR_W, SCR_H, upId, upId ^ 0xA5A5A5A5UL };
  esp_partition_write(picPart, upSlot * slotSize, &h, sizeof(h));
  picId[upSlot] = upId;
  return "OK";
}

// ---------- cross shapes (styles 8-13), from the Cross Portal Tuner ----------
// Each cross is a union of simple shapes around its junction (the screen centre). The board works out
// the distance to the cross edge for every pixel once, stores it in flash, and reads it back per strip.
struct XShape { uint8_t t, dir; float cx, cy, hw, hh, r, w, a, b, len; };   // t: 0 box, 1 circle, 2 ring, 3 tilted box, 4 flared arm
XShape xs[6];
uint8_t nxs = 0;
const uint32_t CROSS_MAGIC = 0x52435856UL;   // "VXCR"
uint32_t crossKey = 0;

void addX(uint8_t t, float cx, float cy, float hw, float hh, float r = 0, float w = 0, float a = 0, float b = 0, float len = 0, uint8_t dir = 0) {
  XShape &o = xs[nxs++];
  o.t = t; o.cx = cx; o.cy = cy; o.hw = hw; o.hh = hh; o.r = r; o.w = w; o.a = a; o.b = b; o.len = len; o.dir = dir;
}

void crossShapes() {
  float R = min(RADIUS, (SCR_H - 8) * (100.0f - BAR) / 100);   // never taller than the screen (the cross is centred)
  float bot = R, top = bot * BAR / (100.0f - BAR);
  float AW = max(2.0f, R * BEAM / 100.0f), HHL = max(AW + 1, min(R * CROSS_W / 100.0f, SCR_W / 2.0f - 2));
  nxs = 0;
  switch (STYLE - 8) {
    case 1:                                        // Celtic: ring around the junction
      addX(0, 0, (bot - top) / 2, AW, (bot + top) / 2); addX(0, 0, 0, HHL, AW);
      addX(2, 0, 0, 0, 0, max(AW * 1.9f, 0.62f * min(HHL, top)), max(2.0f, AW * 0.42f));
      break;
    case 2: {                                      // Budded: round ends
      float br = AW * 1.45f;
      addX(0, 0, (bot - top) / 2, AW, (bot - br - (-top + br)) / 2); addX(0, 0, 0, HHL - br, AW);
      addX(1, 0, -top + br, 0, 0, br); addX(1, 0, bot - br, 0, 0, br);
      addX(1, -(HHL - br), 0, 0, 0, br); addX(1, HHL - br, 0, 0, 0, br);
      break;
    }
    case 3: case 4: {                              // Patriarchal / Orthodox: extra bars
      float th = AW * 0.85f, gap = min(AW * 3.4f, top - th - 2);
      addX(0, 0, (bot - top) / 2, AW, (bot + top) / 2); addX(0, 0, 0, HHL, AW);
      addX(0, 0, -gap, HHL * 0.6f, th);
      if (STYLE == 12) addX(3, 0, bot * 0.62f, HHL * 0.55f, th, 0, 0, -0.35f);
      break;
    }
    case 5: {                                      // Pattee: flared arms
      float a = AW * 0.55f, b = AW * 1.75f;
      addX(0, 0, 0, a, a);
      addX(4, 0, 0, 0, 0, 0, 0, a, b, top, 0); addX(4, 0, 0, 0, 0, 0, 0, a, b, bot, 1);
      addX(4, 0, 0, 0, 0, 0, 0, a, b, HHL, 2); addX(4, 0, 0, 0, 0, 0, 0, a, b, HHL, 3);
      break;
    }
    default:                                       // Latin
      addX(0, 0, (bot - top) / 2, AW, (bot + top) / 2); addX(0, 0, 0, HHL, AW);
  }
}

float sdBox(float x, float y, float cx, float cy, float hw, float hh) {
  float dx = fabsf(x - cx) - hw, dy = fabsf(y - cy) - hh;
  return hypotf(fmaxf(dx, 0), fmaxf(dy, 0)) + fminf(fmaxf(dx, dy), 0);
}

float crossSD(float x, float y) {               // signed distance: negative inside the cross
  float d = 1e9f;
  for (uint8_t i = 0; i < nxs; i++) {
    const XShape &o = xs[i];
    float e;
    switch (o.t) {
      case 0: e = sdBox(x, y, o.cx, o.cy, o.hw, o.hh); break;
      case 1: e = hypotf(x - o.cx, y - o.cy) - o.r; break;
      case 2: e = fabsf(hypotf(x, y) - o.r) - o.w; break;
      case 3: { float c = cosf(o.a), s = sinf(o.a), dx = x - o.cx, dy = y - o.cy; e = sdBox(c * dx + s * dy, -s * dx + c * dy, 0, 0, o.hw, o.hh); break; }
      default: {
        float u = o.dir == 0 ? -y : o.dir == 1 ? y : o.dir == 2 ? -x : x, v = o.dir < 2 ? x : y, k = (o.b - o.a) / o.len;
        float side = (fabsf(v) - (o.a + k * constrain(u, 0.0f, o.len))) / sqrtf(1 + k * k);
        e = fmaxf(side, fmaxf(-u, u - o.len));
      }
    }
    d = fminf(d, e);
  }
  return d;
}

bool crossAvailable() { return picPart != NULL; }

int crossShift() {                              // move the crossing up so the whole cross is centred on the screen
  float bot = min(RADIUS, (SCR_H - 8) * (100.0f - BAR) / 100), top = bot * BAR / (100.0f - BAR);
  return (int)lroundf((bot - top) / 2);
}

void prepareCross() {                           // (re)build the outline when the cross settings change
  int shift = crossShift();
  crossYC = QY - shift;
  uint32_t key = 2166136261UL;
  uint32_t parts[] = { STYLE, (uint32_t)(RADIUS * 16), CROSS_W, BEAM, BAR, SCR_W, SCR_H, 2 };
  for (uint32_t v : parts) key = (key ^ v) * 16777619UL;
  if (key == crossKey && crossReady) return;
  crossReady = false;
  float rw = max(1.5f, max(2.0f, min(RADIUS, (SCR_H - 8) * (100.0f - BAR) / 100) * BEAM / 100.0f) * 0.3f);
  for (int k = 0; k < 128; k++) { crossRimT[k] = (uint8_t)(255 * expf(-(k / rw) * (k / rw))); crossHaloT[k] = (uint8_t)(115 * expf(-k / 12.0f)); }
  uint32_t head[4];
  esp_partition_read(picPart, crossOff, head, 16);
  if (head[0] != CROSS_MAGIC || head[1] != key) {
    crossShapes();
    esp_partition_erase_range(picPart, crossOff, crossSize);
    static int8_t row[SCR_W];
    for (int y = 0; y < SCR_H; y++) {
      float fy = y + 0.5f - crossYC;            // relative to the crossing
      for (int x = 0; x < SCR_W; x++) {
        float e = -crossSD(x + 0.5f - SCR_W / 2.0f, fy);
        if (e > 0 && e < 1) e = 1;
        if (e <= 0 && e > -1) e = -1;
        row[x] = (int8_t)constrain((int)e, -127, 127);
      }
      esp_partition_write(picPart, crossOff + 16 + (uint32_t)y * SCR_W, row, SCR_W);
      if ((y & 7) == 7) delay(1);
    }
    uint32_t h2[4] = { CROSS_MAGIC, key, 0, 0 };
    esp_partition_write(picPart, crossOff, h2, 16);
  }
  crossKey = key;
  crossReady = true;
}

void readCrossRows(int y0, int rows) { esp_partition_read(picPart, crossOff + 16 + (uint32_t)y0 * SCR_W, edgeBuf, (uint32_t)rows * SCR_W); }

const char *pictureCommand(char *line) {
  if (strcasecmp(line, "INFO") == 0) {           // PICS slots width height id1 id2 ...
    static char info[128];
    int n = snprintf(info, sizeof(info), "PICS %u %u %u", picSlots, SCR_W, SCR_H);
    for (uint8_t i = 0; i < picSlots; i++) n += snprintf(info + n, sizeof(info) - n, " %lx", (unsigned long)picId[i]);
    return info;
  }
  if (strncasecmp(line, "IMG ", 4) == 0) {       // start a picture: slot, JPEG size, picture id
    unsigned slot; unsigned long len, id;
    if (!picPart || sscanf(line + 4, "%u %lu %lx", &slot, &len, &id) != 3 || slot >= picSlots || !len || len > STAGE_SIZE || !id) return "ERR";
    picId[slot] = 0;                             // stop showing the old picture
    upSlot = slot; upLen = len; upId = id; upPos = 0;
    esp_partition_erase_range(picPart, stageOff, (len + 4095) & ~4095UL);   // only what this picture needs
    uploading = true; upLast = millis();
    return "READY";
  }
  if (line[0] == 'D' && line[1] == ' ' && uploading) {   // a piece of the JPEG, in base64
    uint8_t data[200];
    int n = strlen(line + 2) <= 264 ? unbase64(line + 2, data) : -1;
    if (n < 0 || upPos + n > upLen) { uploading = false; return "ERR data"; }
    esp_partition_write(picPart, stageOff + upPos, data, n);
    upPos += n; upLast = millis();
    return "K";
  }
  if (strcasecmp(line, "END") == 0 && uploading) return finishPicture();
  return NULL;
}
#else
void beginPictures() {}
bool crossAvailable() { return false; }
void prepareCross() {}
void readCrossRows(int y0, int rows) {}
int  picturesAvailable() { return 0; }
bool isPicture(uint8_t s) { return false; }
void readPicture(uint8_t s, int y0, int rows, uint16_t *dst) {}
bool pausedForUpload() { return false; }
const char *pictureCommand(char *line) { return strcasecmp(line, "INFO") == 0 ? "PICS 0" : NULL; }
#endif

// ---------- live tuning over USB serial (and Bluetooth below) ----------
// Command: SET radius oval arms twist speed sparks drift core rim brightness style ripples ripspeed glow stars fade count core2 rim2 core3 rim3 core4 rim4 fadesecs rimsmooth
//              [scenecount scene1..scene8 holdsecs scenefade [framepct [crossw beam bar [space1..space4]]]]   (reply: OK or ERR)
// Pictures: INFO, then IMG slot bytes id / D base64... / END   (see "pictures" above)
char cmd[384];
uint16_t cmdLen = 0;

const char* handleCommand(char *line) {   // returns the reply to send back
  if (strncasecmp(line, "SET ", 4) == 0) {
    float v[44];
    uint8_t n = 0;
    char *p = strtok(line + 4, " ");
    while (p && n < 44) { v[n++] = atof(p); p = strtok(NULL, " "); }
    if (n == 25 || n == 36 || n == 37 || n == 40 || n == 44) {
      Saved s = { BUILD_ID, v[0], v[1], v[3], v[4], (uint8_t)v[2], (uint8_t)v[5], (uint8_t)v[6], (uint32_t)v[7], (uint32_t)v[8], (uint8_t)v[9], (uint8_t)v[10], (uint8_t)v[11], v[12], v[13], (uint8_t)v[14], (uint8_t)v[15], (uint8_t)v[16] };
      for (int k = 0; k < 6; k++) s.fadeCols[k] = (uint32_t)v[17 + k];
      s.fadeSecs = v[23];
      s.rimSmooth = (uint8_t)v[24];
      s.sceneCount = SCENE_COUNT; s.holdSecs = HOLD_SECS; s.sceneFade = SCENE_FADE; s.framePct = FRAME_PCT;
      s.crossW = CROSS_W; s.beam = BEAM; s.bar = BAR;
      for (int k = 0; k < 8; k++) s.scenes[k] = SCENES[k];
      for (int k = 0; k < 4; k++) s.spaceCols[k] = n == 44 ? (uint32_t)v[40 + k] : SPACE_COLS[k];
      if (n >= 36) {
        s.sceneCount = (uint8_t)v[25];
        for (int k = 0; k < 8; k++) s.scenes[k] = (uint8_t)v[26 + k];
        s.holdSecs = v[34]; s.sceneFade = v[35];
      }
      if (n >= 37) s.framePct = (uint8_t)v[36];
      if (n >= 40) { s.crossW = (uint8_t)v[37]; s.beam = (uint8_t)v[38]; s.bar = (uint8_t)v[39]; }
      clampSettings(s);                  // anything out of range is brought back inside instead of refusing the update
      if (valid(s)) {
        pendingSettings = s;
        havePending = true;              // the drawing loop picks it up before the next frame
        return "OK";
      }
    }
    return "ERR";
  }
  if (strcasecmp(line, "PING") == 0) return "PORTAL";
  return pictureCommand(line);
}

void serialPoll(bool quick) {            // quick: between strips, answer settings at once (pictures wait for the end of the frame)
  while (Serial.available()) {
    if (quick) {
      char f = cmdLen ? cmd[0] : (char)Serial.peek();
      if (pausedForUpload() || !(f == 'S' || f == 's' || f == 'P' || f == 'p' || f == '\n' || f == '\r')) return;
    }
    char c = Serial.read();
    if (c == '\n' || c == '\r') {
      if (cmdLen) {
        cmd[cmdLen] = 0;
        const char *reply = handleCommand(cmd);
        if (reply) Serial.println(reply);
        cmdLen = 0;
        if (quick) return;
      }
    } else if (cmdLen < sizeof(cmd) - 1) {
      cmd[cmdLen++] = c;
    }
  }
}
void readSerial() { serialPoll(false); }
void readSerialQuick() { serialPoll(true); }

// ---------- Bluetooth tuning (ESP32 boards with Bluetooth) ----------
// The board shows up as "Vortex Portal". In the Studio (Chrome on Android or a
// computer), tap "Connect over Bluetooth". Same commands as USB.
#if defined(ESP32) && defined(CONFIG_BT_ENABLED)
  #define HAS_BLE 1
#else
  #define HAS_BLE 0
#endif

#if HAS_BLE
#include <BLEDevice.h>
#include <BLEServer.h>
#include <BLE2902.h>

#define BLE_SERVICE "6e400001-b5a3-f393-e0a9-e50e24dcca9e"
#define BLE_RX_CHAR "6e400002-b5a3-f393-e0a9-e50e24dcca9e"   // phone writes commands here
#define BLE_TX_CHAR "6e400003-b5a3-f393-e0a9-e50e24dcca9e"   // board replies here (notify)

BLECharacteristic *bleTx = NULL;
char bleBuf[384], bleLine[384];
uint16_t bleLen = 0;
volatile bool bleHave = false;

class PortalRx : public BLECharacteristicCallbacks {
  void onWrite(BLECharacteristic *c) {     // runs in the Bluetooth task: just collect the line
    String v = c->getValue().c_str();
    for (unsigned i = 0; i < v.length(); i++) {
      char ch = v[i];
      if (ch == '\n' || ch == '\r') {
        if (bleLen && !bleHave) { bleBuf[bleLen] = 0; memcpy(bleLine, bleBuf, bleLen + 1); bleHave = true; }
        bleLen = 0;
      } else if (bleLen < sizeof(bleBuf) - 1) {
        bleBuf[bleLen++] = ch;
      }
    }
  }
};

class PortalServer : public BLEServerCallbacks {
  void onDisconnect(BLEServer *s) { BLEDevice::startAdvertising(); }   // let the phone reconnect
};

void beginBluetooth() {
  BLEDevice::init("Vortex Portal");
  BLEServer *srv = BLEDevice::createServer();
  srv->setCallbacks(new PortalServer());
  BLEService *svc = srv->createService(BLE_SERVICE);
  bleTx = svc->createCharacteristic(BLE_TX_CHAR, BLECharacteristic::PROPERTY_NOTIFY);
  bleTx->addDescriptor(new BLE2902());
  BLECharacteristic *rx = svc->createCharacteristic(BLE_RX_CHAR, BLECharacteristic::PROPERTY_WRITE | BLECharacteristic::PROPERTY_WRITE_NR);
  rx->setCallbacks(new PortalRx());
  svc->start();
  BLEAdvertising *adv = BLEDevice::getAdvertising();
  adv->addServiceUUID(BLE_SERVICE);
  adv->setScanResponse(true);
  BLEDevice::startAdvertising();
}

void readBluetooth() {                    // handle a received line in the main loop
  if (!bleHave) return;
  const char *reply = handleCommand(bleLine);
  bleHave = false;
  if (reply && bleTx) {                   // sent in 20-byte pieces (the smallest Bluetooth packet), ending with a newline
    char out[136];
    int len = snprintf(out, sizeof(out), "%s\n", reply);
    for (int i = 0; i < len; i += 20) {
      bleTx->setValue((uint8_t *)out + i, min(20, len - i));
      bleTx->notify();
      delay(3);
    }
  }
}
#endif

// ---------- scenes: the portal and pictures shown in turn, with fades ----------
uint8_t sceneA = PORTAL, sceneB = PORTAL;
int     sceneMix = 0;                    // 0 = all scene A, 256 = all scene B
float   ageA = 0, ageB = 0;              // seconds since each scene started to appear

void updateScene() {
  if (SCENE_COUNT == 0) { sceneA = sceneB = PORTAL; sceneMix = 0; return; }
  if (SCENE_COUNT == 1) { sceneA = sceneB = SCENES[0]; sceneMix = 0; ageA = millis() / 1000.0f; return; }
  float per = HOLD_SECS + SCENE_FADE;
  float pos = fmodf(millis() / 1000.0f, per * SCENE_COUNT);
  int i = min((int)(pos / per), SCENE_COUNT - 1);
  float w = pos - i * per;
  sceneA = SCENES[i];
  sceneB = SCENES[(i + 1) % SCENE_COUNT];
  ageA = w + SCENE_FADE;                 // it began fading in during the previous scene
  ageB = max(0.0f, w - HOLD_SECS);
  if (w < HOLD_SECS || SCENE_FADE <= 0) sceneMix = 0;
  else { float f = (w - HOLD_SECS) / SCENE_FADE; f = f * f * (3 - 2 * f); sceneMix = (int)(f * 256); }
}

// "Portal around a picture": the picture shows through the portal's centre. When the scene
// starts, the portal forms at its outer edge and closes in until it covers FRAME_PCT.
inline bool isFramed(uint8_t s) { return s >= 128 && isPicture(s - 128); }

inline uint16_t mix565(uint16_t x, uint16_t y, int m) {
  int r  = ((x >> 11) * (256 - m) + (y >> 11) * m) >> 8;
  int g  = (((x >> 5) & 63) * (256 - m) + ((y >> 5) & 63) * m) >> 8;
  int bl = ((x & 31) * (256 - m) + (y & 31) * m) >> 8;
  return (r << 11) | (g << 5) | bl;
}

void framePicture(uint8_t pic, float age, int y0, int rows, uint16_t *dst) {
  static uint16_t line[SCR_W];
  float close = SCENE_FADE + 1.5f;                            // seconds to close in (keeps going after the fade)
  float k = min(1.0f, age / close); k = k * k * (3 - 2 * k);
  float hole = RADIUS * (1.0f - FRAME_PCT / 100.0f * k);      // radius where the picture shows
  int16_t alpha[256];                                          // soft 8-pixel edge
  for (int r = 0; r < 256; r++) { float a = (hole + 4 - r) / 8.0f; alpha[r] = a <= 0 ? 0 : a >= 1 ? 256 : (int16_t)(a * 256); }
  for (int y = y0; y < y0 + rows; y++) {
    int qy = y < QY ? QY - 1 - y : y - QY;
    if (qy > hole + 4) continue;                                // this row is all portal
    readPicture(pic, y, 1, line);
    uint16_t *d = dst + (y - y0) * SCR_W;
    for (int x = 0; x < SCR_W; x++) {
      int m = alpha[rT[qy * TQX + colMap[x]]];
      if (m) d[x] = m == 256 ? line[x] : mix565(d[x], line[x], m);
    }
  }
}

void blendStrip(uint16_t *a, const uint16_t *b, int n, int m) {   // a = a + (b - a) * m / 256
  for (int i = 0; i < n; i++) a[i] = mix565(a[i], b[i], m);
}

void renderStrip(int y0, int rows, uint16_t *strip);

void drawScene(uint8_t s, float age, int y0, int rows, uint16_t *dst) {
  if (isPicture(s)) { readPicture(s, y0, rows, dst); return; }
  renderStrip(y0, rows, dst);
  if (isFramed(s)) framePicture(s - 128, age, y0, rows, dst);
}

void composeStrip(int y0, int rows, uint16_t *dst) {
  bool fading = sceneMix > 0 && sceneA != sceneB;
  if (!fading || !picBuf) { if (sceneMix >= 128) drawScene(sceneB, ageB, y0, rows, dst); else drawScene(sceneA, ageA, y0, rows, dst); return; }
  drawScene(sceneA, ageA, y0, rows, dst);
  drawScene(sceneB, ageB, y0, rows, picBuf);
  blendStrip(dst, picBuf, rows * SCR_W, sceneMix);
}

// ---------- one frame ----------
uint8_t look = 0;                        // the style being drawn (crosses fall back to Vortex without flash storage)

// ---------- Nebula, Wormhole, Meteor Shower ----------
uint8_t  *noise8 = NULL;                // smooth value noise for the gas clouds (allocated when first needed)
double   spaceT = 0;                    // space clock (runs on its own so it never jumps)
float    spU = 1, spExt = 118;          // space units per pixel, edge of the picture in space units
float    nbCa = 1, nbSa = 0, nbO1 = 0, nbO2 = 0, nbO3 = 0;
int      spTw = 0, whPh = 0;
#define SP_GRID ((SCR_W / 2 + 2) * (STRIP / 2 + 3))   // gas worked out every 2 or 4 pixels, smoothed in between (one strip at a time)
uint8_t  *spH = NULL, *spV = NULL, *spX = NULL;
// Galaxy: a Hubble-style spiral (like M51, M100, NGC 4414)
#define GAL_TILT 0.86f                   // how tilted toward you (1 = face on)
#define GAL_PA   -0.55f                  // which way it points
#define GAL_ZOOM 0.7f                    // size (smaller = bigger galaxy)
float    gax = 1, gbx = 0, gay = 0, gby = 1, galK = 9;   // galK: how tightly the arms wind (the Spiral setting)
// The galaxy is one picture turning in its own plane: worked out once on a polar grid (per Spiral setting), then looked up
#define  GT_R  64
#define  GT_DR 1.65f
uint8_t  *gtH = NULL, *gtV = NULL, *gtX = NULL;
int      gtA = 0;
float    gtK = -1, gpx = 1, gqx = 0, gpy = 0, gqy = 1, gRot = 0;
bool     gtReady = false;
uint8_t  powT[256], whRingT[256], whNearT[256];
int16_t  whOffT[256], whCoreT[256];
int32_t  whHueT[256];
struct Meteor { float x, y, len; uint8_t hue; };
Meteor   meteors[30];
int      meteorCount = 7;

void buildNoise() {
  uint32_t sd = 11;
  for (int i = 0; i < 64 * 64; i++) { sd = (sd * 1103515245UL + 12345UL) & 0x7fffffffUL; noise8[i] = sd >> 23; }
  for (int i = 0; i < 256; i++) powT[i] = (uint8_t)(255 * powf(i / 255.0f, 1.6f));
}

bool spaceMemory() {                    // reserved at startup (allocBuffers), so every space style always has room
  if (spaceLUT && noise8 && spX) return true;
  if (!spH) spH = (uint8_t *)malloc(SP_GRID);
  if (!spV) spV = (uint8_t *)malloc(SP_GRID);
  if (!spX) spX = (uint8_t *)malloc(SP_GRID);
  if (!spH || !spV || !spX) return false;
  if (!spaceLUT) { spaceLUT = (uint16_t *)malloc(64 * 64 * 2); if (spaceLUT) buildSpaceLUT(); }
  if (!noise8) { noise8 = (uint8_t *)malloc(64 * 64); if (noise8) buildNoise(); }
  return spaceLUT && noise8;
}

inline float smf(float x) { x = x < 0 ? 0 : x > 1 ? 1 : x; return x * x * (3 - 2 * x); }

float vn(float x, float y) {            // smooth noise, 0..1, repeats every 64 units
  float xf = floorf(x), yf = floorf(y);
  int xi = (int)xf, yi = (int)yf;
  float fx = x - xf, fy = y - yf;
  fx = fx * fx * (3 - 2 * fx); fy = fy * fy * (3 - 2 * fy);
  int x0 = xi & 63, x1 = (xi + 1) & 63, y0 = (yi & 63) << 6, y1 = ((yi + 1) & 63) << 6;
  float a = noise8[y0 | x0], b = noise8[y0 | x1], c = noise8[y1 | x0], d = noise8[y1 | x1];
  return (a + (b - a) * fx + (c - a) * fy + (a - b - c + d) * fx * fy) * (1 / 255.0f);
}

inline uint8_t to8(float v) { return v <= 0 ? 0 : v >= 1 ? 255 : (uint8_t)(v * 255); }

void galaxyNode(float xr, float yr, uint8_t &h, uint8_t &v, uint8_t &a8) {   // light, colour and "arm" at one point of the galaxy's plane
  float gr = sqrtf(xr * xr + yr * yr), ga = atan2f(yr, xr), lr = logf(gr / 5 + 1);
  float wob = (vn(xr / 16 + 50, yr / 16) - 0.5f) * 1.3f;              // arms wander and break up
  float ph = 2 * ga - galK * lr + wob;
  float c = 0.5f + 0.5f * cosf(ph), c2 = c * c, c4 = c2 * c2, c8 = c4 * c4;
  float b = 0.5f + 0.5f * cosf(2 * ga - galK * 1.12f * lr + 2.3f + wob * 1.5f), b2 = b * b, b6 = b2 * b2 * b2;   // fainter branch arms
  float e = 0.5f + 0.5f * cosf(5 * ga - galK * 1.5f * lr + wob * 2.2f), e2 = e * e, e4 = e2 * e2, e10 = e4 * e4 * e2;   // feathery spurs
  float arm = min(1.0f, 0.7f * c2 + 0.3f * c8 + 0.5f * b6 * smf((gr - 8) / 20) + 0.28f * e10 * smf((gr - 14) / 16));
  float clump = vn(xr / 3.2f, yr / 3.2f) * 0.55f + vn(xr / 8 + 7, yr / 8) * 0.45f;   // star clouds along the arms
  float l = 0.5f + 0.5f * cosf(ph - 0.6f), l2 = l * l, l4 = l2 * l2, l8 = l4 * l4, l16 = l8 * l8;   // dust on the inner edge of each arm
  float lane = l16 * l8 * l4 * l2 * (0.35f + 0.9f * vn(xr / 2.6f + 20, yr / 2.6f));
  float f = 0.5f + 0.5f * cosf(4 * ga - galK * 1.05f * lr + vn(xr / 7 + 31, yr / 7) * 5), f2 = f * f, f8 = f2 * f2 * f2 * f2, f16 = f8 * f8;   // thin dust filaments
  float wisp = f16 * f8 * f2 * 0.8f * smf((gr - 6) / 14) + max(0.0f, vn(xr / 4.5f + 3, yr / 4.5f - 9) - 0.64f) * 1.4f * c;
  float edge = smf((104 - gr) / 44);
  float dust = min(1.0f, lane + wisp) * smf(gr / 14) * edge;
  float q = gr / 6.5f, bulge = expf(-q * q) + expf(-gr / 11) * 0.5f;
  float disk = expf(-gr / 48) * edge, halo = expf(-gr / 22) * 0.32f;
  float cl = clump * clump * 1.6f;
  float lv = bulge + halo + disk * (0.3f + 0.12f * cl + 1.6f * arm * (0.25f + cl));
  lv *= 1 - 0.55f * dust * (1 - min(1.0f, bulge));
  float hue = 0.75f - 0.23f * smf((gr - 14) / 34) + 0.16f * dust;   // yellow-cream core, blue outer arms, brown dust
  h = to8(hue / 2); v = to8(lv); a8 = to8(arm * edge * (1 - dust));
}

float fastAtan2(float y, float x) {     // quick angle, good to about 0.1 degree
  float ax = fabsf(x), ay = fabsf(y), mx = max(ax, ay), mn = min(ax, ay);
  if (mx == 0) return 0;
  float a = mn / mx, q = a * a;
  float r = ((-0.0464964749f * q + 0.15931422f) * q - 0.327622764f) * q * a + a;
  if (ay > ax) r = 1.57079637f - r;
  if (x < 0) r = 3.14159274f - r;
  return y < 0 ? -r : r;
}

bool galaxyTex() {                      // build the galaxy picture once per Spiral setting
  if (!gtH) {
    for (int a = 256; a >= 128 && !gtH; a /= 2) {
      gtH = (uint8_t *)malloc(GT_R * a); gtV = (uint8_t *)malloc(GT_R * a); gtX = (uint8_t *)malloc(GT_R * a);
      if (gtH && gtV && gtX) gtA = a;
      else { free(gtH); free(gtV); free(gtX); gtH = gtV = gtX = NULL; }
    }
    if (!gtH) return false;             // no room: the galaxy is worked out every frame instead
    gtK = -1;
  }
  if (gtK == galK) return true;
  gtK = galK;
  for (int ri = 0; ri < GT_R; ri++)
    for (int ai = 0; ai < gtA; ai++) {
      float gr = ri * GT_DR, an = ai * TWO_PI / gtA;
      int i = ri * gtA + ai;
      galaxyNode(gr * cosf(an), gr * sinf(an), gtH[i], gtV[i], gtX[i]);
    }
  return true;
}

void spaceNode(float X, float Y, uint8_t &h, uint8_t &v, uint8_t &x8) {   // gas and dust at one point
  if (look == 4) {
    if (!gtReady) { galaxyNode(gax * X + gbx * Y, gay * X + gby * Y, h, v, x8); return; }
    float px = gpx * X + gqx * Y, py = gpy * X + gqy * Y;                 // look the galaxy up, turned
    float fr = sqrtf(px * px + py * py) / GT_DR; if (fr > GT_R - 1.001f) fr = GT_R - 1.001f;
    float fa = (fastAtan2(py, px) - gRot) * (gtA / TWO_PI); fa -= floorf(fa / gtA) * gtA;
    int ri = (int)fr; float wr = fr - ri; int ai = (int)fa; float wa = fa - ai; if (ai >= gtA) ai -= gtA;
    int a1 = ai + 1 == gtA ? 0 : ai + 1, i00 = ri * gtA + ai, i01 = ri * gtA + a1, i10 = i00 + gtA, i11 = i01 + gtA;
    h  = (uint8_t)((gtH[i00] * (1 - wa) + gtH[i01] * wa) * (1 - wr) + (gtH[i10] * (1 - wa) + gtH[i11] * wa) * wr);
    v  = (uint8_t)((gtV[i00] * (1 - wa) + gtV[i01] * wa) * (1 - wr) + (gtV[i10] * (1 - wa) + gtV[i11] * wa) * wr);
    x8 = (uint8_t)((gtX[i00] * (1 - wa) + gtX[i01] * wa) * (1 - wr) + (gtX[i10] * (1 - wa) + gtX[i11] * wa) * wr);
    return;
  }
  if (look == 14) {                                                       // Nebula
    float x = (X * nbCa - Y * nbSa) / 36, y = (X * nbSa + Y * nbCa) / 36;
    float w = vn(x + nbO1, y) * 2.2f;                                     // warp so the clouds fold
    float d = vn(x + w, y - w + nbO2) * 0.6f + vn(x * 2.2f - w, y * 2.2f + nbO1) * 0.28f + vn(x * 4.6f, y * 4.6f) * 0.12f;
    float dust = max(0.0f, vn(x * 1.7f + 9, y * 1.7f - w) * 1.9f - 1.05f);   // dark dust lanes
    d = max(0.0f, d * 1.7f - 0.5f - dust);
    float hue = vn(x * 0.7f + 20 + nbO3, y * 0.7f) * 1.6f + w * 0.15f;    // big patches of different colour
    float rr = sqrtf(X * X + Y * Y) / spExt;
    h = to8(hue / 2); v = to8(d * (1 - rr * rr * rr) * 0.95f); x8 = 0;
  } else {                                                                // Meteor Shower: faint Milky Way
    float q = (X * 0.5f + Y * 0.87f) / 30, band = expf(-q * q);
    float cloud = vn(X / 14 + 3, Y / 14) * vn(X / 6, Y / 6 + 8);
    h = to8((0.05f + vn(X / 40, Y / 40 + 2) * 0.8f) / 2); v = to8(band * (0.12f + cloud * 0.35f)); x8 = band > 0.3f;
  }
}

inline bool spaceStar(uint32_t i, int density, int &hi, int &vi) {   // a twinkling star with its own colour
  uint32_t h = hash32(i * 2654435761UL);
  if ((int)(h & 1023) >= density) return false;
  vi = 47 + sinT[(spTw + (h >> 10)) & 255] / 10;
  hi = (h >> 20) & 63;
  return true;
}

void prepareSpace() {                   // once per frame
  spU = look == 15 ? 118.0f / SP_EXT : 236.0f / min(SCR_W, SCR_H);   // scaled to the screen
  spExt = SP_EXT * spU;
  double T = spaceT;
  float ang = (float)fmod(T * 0.004, TWO_PI);
  nbCa = cosf(ang); nbSa = sinf(ang);
  nbO1 = (float)fmod(T * 0.004, 64.0); nbO2 = (float)fmod(T * 0.003, 64.0); nbO3 = (float)fmod(T * 0.002, 64.0);
  spTw = (int)(fmod(T * 0.25, TWO_PI) * 40.74f);
  if (look == 4) {                      // Galaxy: screen -> the galaxy's own slowly turning plane
    float rot = (float)fmod(T * 0.007, TWO_PI), cr = cosf(rot), sr = sinf(rot), cp = cosf(GAL_PA), sp = sinf(GAL_PA);
    gax = (cp * cr + sp * sr / GAL_TILT) * GAL_ZOOM; gbx = (-sp * cr + cp * sr / GAL_TILT) * GAL_ZOOM;
    gay = (-cp * sr + sp * cr / GAL_TILT) * GAL_ZOOM; gby = (sp * sr + cp * cr / GAL_TILT) * GAL_ZOOM;
    galK = 3 + TWIST * 2.5f;            // Spiral setting (TWIST 0-6)
    gpx = cp * GAL_ZOOM; gqx = -sp * GAL_ZOOM; gpy = sp / GAL_TILT * GAL_ZOOM; gqy = cp / GAL_TILT * GAL_ZOOM;   // before turning
    gRot = rot;
    gtReady = galaxyTex();
  }
  if (look == 15) {                     // Wormhole: rings falling away, worked out per distance
    float rev = DRIFT ? -1 : 1;          // Reverse: rings fly out toward you
    whPh = (int)(rev * fmod(T * 0.06, TWO_PI) * 40.74f);
    float off = rev * (float)fmod(T * 0.09, 100.0);
    for (int r = 0; r < 256; r++) {
      float ru = max(r * spU, 1.0f), depth = 90 / ru, ringPos = depth * 2.6f - off, fl = floorf(ringPos);
      whRingT[r] = (uint8_t)(255 * (0.5f + 0.5f * cosf((ringPos - fl) * TWO_PI)));
      float near = min(1.0f, ru / 95);
      whNearT[r] = (uint8_t)(255 * (0.25f + 0.75f * near * near));
      whOffT[r] = (int16_t)((int)(TWIST * (depth * 0.667f + 3 * logf(ru / 20)) * 40.74f) & 255);   // Twist: how much the walls spiral
      whHueT[r] = (int32_t)floorf(fl * 0.27f * 256) & 255;               // each ring its own colour
      whCoreT[r] = ru < 18 ? (int16_t)min(63.0f, expf(-(ru / 9) * (ru / 9)) * 1.05f * 63) : -1;
    }
  }
  if (look == 16) {                     // Meteor Shower: where each shooting star is
    float P = sqrtf((float)SCR_W * SCR_W + (float)SCR_H * SCR_H) / 340;
    int N = NUM_SPARKS < 2 ? 2 : NUM_SPARKS > 30 ? 30 : NUM_SPARKS;   // Meteors setting
    meteorCount = N;
    for (int m = 0; m < N; m++) {
      float ph = (float)fmod(T * 0.006 * (1 + (m % 4) * 0.12) + (double)m / N + (m % 3) * 0.13, 1.0), lane = (m * 37 % 100) / 100.0f;
      float side = ((m * 61 % 100) / 100.0f - 0.5f) * 160;   // spread across the sky
      meteors[m].x = QX + (110 - ph * 320 + lane * 110 + side * 0.6f) * P;
      meteors[m].y = QY + (-170 + ph * 240 + lane * 70 + side * 0.8f) * P;
      meteors[m].len = (38 + lane * 30) * P;
      meteors[m].hue = m * 64 / N;
    }
  }
}

void renderSpaceStrip(int y0, int rows, uint16_t *strip) {
  uint16_t *p = strip;
  if (look == 15) {                     // Wormhole
    for (int y = y0; y < y0 + rows; y++) {
      int qy = y < QY ? QY - 1 - y : y - QY;
      bool low = y >= QY;
      for (int x = 0; x < SCR_W; x++) {
        int qi = qy * TQX + colMap[x], r = rT[qi], a0 = aT[qi];
        int a = (x >= QX ? (low ? a0 : 256 - a0) : (low ? 128 - a0 : 128 + a0)) & 255;
        int s = sinT[(a * 6 + whOffT[r] + whPh) & 255] + 127;          // spokes, 0..254
        int vi = (powT[(whRingT[r] * 133 + s * 123) >> 8] * whNearT[r]) >> 10;
        if (whCoreT[r] >= 0) { if (whCoreT[r] > vi) vi = whCoreT[r]; *p++ = spaceLUT[48 * 64 + vi]; continue; }   // glowing far end
        *p++ = spaceLUT[(((whHueT[r] + s * 20 / 254) >> 2) & 63) * 64 + vi];
      }
    }
    return;
  }
  // Galaxy, Nebula and Meteor Shower: gas worked out on a coarse grid, smoothed in between
  const int C = look == 4 && min(SCR_W, SCR_H) < 300 ? 2 : 4, SH = C == 2 ? 2 : 4, GC = SCR_W / C + 2;
  int gy0 = y0 / C, gy1 = (y0 + rows - 1) / C + 1;
  for (int gy = gy0; gy <= gy1; gy++)
    for (int gx = 0; gx < GC; gx++) {
      int i = (gy - gy0) * GC + gx;
      spaceNode((gx * C + 0.5f - QX) * spU, (gy * C + 0.5f - QY) * spU, spH[i], spV[i], spX[i]);
    }
  int dens = (look == 14 ? 7 : look == 4 ? 4 : 10) * STARS / 3, densBand = 22 * STARS / 3;
  for (int y = y0; y < y0 + rows; y++) {
    int gy = y / C - gy0, fy = y % C;
    float Y = (y + 0.5f - QY) * spU;
    for (int x = 0; x < SCR_W; x++) {
      int fx = x % C, i = gy * GC + x / C;
      int w00 = (C - fx) * (C - fy), w01 = fx * (C - fy), w10 = (C - fx) * fy, w11 = fx * fy;
      int h = (spH[i] * w00 + spH[i + 1] * w01 + spH[i + GC] * w10 + spH[i + GC + 1] * w11) >> SH;
      int v = (spV[i] * w00 + spV[i + 1] * w01 + spV[i + GC] * w10 + spV[i + GC + 1] * w11) >> SH;
      int hi = (h >> 1) & 63, vi = v >> 2, shi, svi;
      uint32_t pix = (uint32_t)(y * SCR_W + x);
      if (look == 4) {
        int am = (spX[i] * w00 + spX[i + 1] * w01 + spX[i + GC] * w10 + spX[i + GC + 1] * w11) >> SH;
        if (am > 90) {                                   // knots on the arms: pink star nurseries, blue clusters
          float X = (x + 0.5f - QX) * spU, xr = gax * X + gbx * Y, yr = gay * X + gby * Y;
          int kx = (int)floorf(xr / 4), ky = (int)floorf(yr / 4);
          uint32_t kh = hash32((uint32_t)(kx + 4096) * 7919u + (uint32_t)(ky + 4096) * 104729u);
          int kind = kh & 15;
          if (kind < 3) {
            float dx = xr - (kx * 4 + 1 + (int)((kh >> 8) & 1) * 2), dy = yr - (ky * 4 + 1 + (int)((kh >> 9) & 1) * 2), d2 = dx * dx + dy * dy, size = kind == 0 ? 1.6f : 0.9f;
            if (d2 < size) { int kv = (int)((0.62f + am / 700.0f) * 63 * (1 - d2 / size * 0.4f)); if (kv > vi) { hi = kind == 0 ? 17 : 33; vi = min(63, kv); } }
          }
        }
        if (spaceStar(pix, dens, shi, svi) && svi > vi + 8) { hi = 42; vi = svi; }
      } else if (look == 14) { if (spaceStar(pix, dens, shi, svi) && svi > vi) { hi = shi; vi = min(63, svi + 13); } }
      else if (spaceStar(pix, spX[i] ? densBand : dens, shi, svi)) { hi = shi; vi = svi; }
      *p++ = spaceLUT[hi * 64 + vi];
    }
  }
  if (look == 16) for (int m = 0; m < meteorCount; m++) {           // shooting stars with coloured tails
    const Meteor &M = meteors[m];
    for (int k = 0; k < M.len; k++) {
      float f = 1 - k / M.len;
      int x = (int)floorf(M.x + 0.8f * k + 0.5f), y = (int)floorf(M.y - 0.6f * k + 0.5f);
      int vi = k < 3 ? 63 : (int)((0.9f * f * f + 0.05f) * 63);
      for (int yy = y; yy < y + 2; yy++)
        if (x >= 0 && x < SCR_W && yy >= y0 && yy < y0 + rows) strip[(yy - y0) * SCR_W + x] = spaceLUT[M.hue * 64 + vi];
    }
  }
}

void frameStart() {
  updateScene();
  if (havePending) {
    apply(pendingSettings);
    saveSettings();
    buildParams();
    buildPalette();
    resetSparks();
    havePending = false;
  }
  bool isCross = STYLE >= 8 && STYLE <= 13;
  if (isCross && crossAvailable() && edgeBuf) prepareCross();
  look = isCross && !crossReady ? 0 : STYLE;
  if (look == 4 || look >= 14) { if (spaceMemory()) prepareSpace(); else look = 0; }   // no room: show the Vortex
  updateColourFade();
  updateSparks();
  for (int a = 0; a < 256; a++) {                     // wobbly rim edge for this frame
    float ang = a * TWO_PI / 256;
    float wob = sinf(ang * 5 + t * 2) * 1.2f + sinf(ang * 3 - t * 3) * 0.8f;
    edgeT[a] = (int16_t)(RADIUS * (1 + wob * 0.025f * (1 - RIM_SMOOTH / 100.0f)));
  }
  // Hyperspace: where each streaking star is this frame (3 layers x 256 directions)
  bhHole = (int)(0.22f * RADIUS);
  twinkle = (int)(t * 25);
  if (STYLE == 3) {
    for (int L = 0; L < 3; L++) {
      for (int a = 0; a < 256; a++) {
        uint32_t h = hash32((uint32_t)(a * 3 + L * 7919));
        int i = L * 256 + a;
        warpOn[i] = (int)(h & 15) < STARS + 1;
        float pos = fmodf((float)((h >> 8) & 1023) + t * (60 + L * 25), 1024.0f) / 1024.0f;
        float rr = pos * pos * 1.15f * RADIUS;
        warpRR[i] = rr;
        warpLen[i] = 1.5f + rr * 0.22f;
        warpB[i] = 145 * min(1.0f, rr / (0.8f * RADIUS));
      }
    }
  }
  // Starburst ripples: rings expanding outward, precomputed per distance for this frame
  memset(ripCrestT, 0, sizeof(ripCrestT));
  memset(ripTroughT, 0, sizeof(ripTroughT));
  if (STYLE == 2) {
    for (uint8_t i = 0; i < RIPPLES; i++) {
      float pr = fmodf(t * RIP_SPEED + (float)i / RIPPLES, 1.0f);
      float rr = 0.16f + pr * 0.62f, w = 0.04f + pr * 0.04f, fade = powf(1 - pr, 1.1f);
      for (int r = 0; r < 256; r++) {
        float d = (r / RADIUS - rr) / w;
        ripCrestT[r]  = (uint8_t)min(255, ripCrestT[r] + (int)(fade * 110 * expf(-d * d)));
        ripTroughT[r] = (uint8_t)min(255, ripTroughT[r] + (int)(fade * 35 * expf(-(d + 1.6f) * (d + 1.6f))));
      }
    }
  }
}

void frameEnd() {
  t += SPEED;
  static uint32_t lastMs = millis();     // space styles move by the clock, so they match the Studio at any frame rate
  uint32_t now = millis();
  spaceT += SPEED * 8 * min(8.0f, (now - lastMs) / 35.7f);   // the Studio preview steps 28 times a second
  lastMs = now;
  if (spaceT > 1e7) spaceT = 0;
  if (t > TWO_PI * 100) t -= TWO_PI * 100;   // wrap seamlessly so it can run forever
}

inline int cartoonV(int a, int r, int phase) {   // blobby flat-shaded swirl
  int warp = (((nz(nzA, 31, a * 2 + r * 3 + (phase >> 1)) - 128) * 7) >> 3) + ((nz(nzB, 63, a * 4 + r * 6 - phase) - 128) >> 2);
  int sp = sinT[(a * ARMS - linT[r] + phase + warp) & 255];
  return r < 7 ? 232 : sp > 25 ? 232 : sp > -45 ? 182 : 120;
}

void renderStrip(int y0, int rows, uint16_t *strip) {
  const int phase = (int)(t * 1.5f * 40.74f), phase2 = (int)(-t * 40.74f);
  uint16_t *p = strip;
  if (look == 4 || look >= 14) { renderSpaceStrip(y0, rows, strip); return; }   // Galaxy, Nebula, Wormhole, Meteor Shower
  bool cross = look >= 8;
  if (cross) readCrossRows(y0, rows);
  for (int y = y0; y < y0 + rows; y++) {
    int qy = y < QY ? QY - 1 - y : y - QY;
    bool low = y >= QY;
    const int8_t *eb = cross ? edgeBuf + (y - y0) * SCR_W : NULL;
    int cy = y < crossYC ? crossYC - 1 - y : y - crossYC;   // crosses: swirl around the crossing
    bool clow = y >= crossYC;
    for (int x = 0; x < SCR_W; x++) {
      int qi = qy * TQX + colMap[x], r = rT[qi], a0 = aT[qi];
      int a = (x >= QX ? (low ? a0 : 256 - a0) : (low ? 128 - a0 : 128 + a0)) & 255;
      int e = edgeT[a];
      int v;
      if (eb) {                                        // Cross: Vortex swirl inside, glowing rim along the cross edge
        int ce = eb[x];
        if (ce > 0) {
          int ca0;
          if (cy < TQY) { int ci = cy * TQX + colMap[x]; r = rT[ci]; ca0 = aT[ci]; }
          else {                                       // below the tables: work it out (only the lower arm)
            float fx = colMap[x] + 0.5f, fy = cy + 0.5f;
            r = min(255, (int)lroundf(sqrtf(fx * fx + fy * fy)));
            ca0 = (int)lroundf(atan2f(fy, fx) / (PI / 2) * 64);
          }
          a = (x >= QX ? (clow ? ca0 : 256 - ca0) : (clow ? 128 - ca0 : 128 + ca0)) & 255;
          int s  = sinT[(a * ARMS + twistT[r] + phase) & 255];
          int s2 = sinT[(a * 2 - twist2T[r] + phase2) & 255];
          int d = depthT[r];
          int band = ((s + 127) * 5 + (s2 + 127) * 3) >> 3;
          v = (d * (60 + ((band * 195) >> 8))) >> 8;
          if (s > 100) v += ((s - 100) * 3 * d) >> 8;
          if (coreT[r] > v) v = coreT[r];
          if (crossRimT[ce] > v) v = crossRimT[ce];
        } else {
          v = max(crossRimT[-ce], crossHaloT[-ce]);
        }
      } else if (look == 7) {                                // Cartoon Sticker: ragged edge, light outline, no glow
        int jag = (((nz(nzB, 63, a * 4 + (phase >> 1)) - 128) * 7 + (nz(nzC, 255, a * 16 + phase) - 128) * 4) >> 7) * (100 - RIM_SMOOTH) / 100;
        int e2 = (int)(RADIUS * 1.02f + jag / 4.0f);
        v = r >= e2 ? 0 : r >= e2 - 4 ? 235 : cartoonV(a, r, phase);
      } else if (r < e) {
        if (look == 0) {                              // Vortex
          int s  = sinT[(a * ARMS + twistT[r] + phase) & 255];
          int s2 = sinT[(a * 2 - twist2T[r] + phase2) & 255];
          int d = depthT[r];
          int band = ((s + 127) * 5 + (s2 + 127) * 3) >> 3;
          v = (d * (60 + ((band * 195) >> 8))) >> 8;   // swirling bands, darker toward the throat
          if (s > 100) v += ((s - 100) * 3 * d) >> 8; // bright spiral crests
          if (coreT[r] > v) v = coreT[r];              // glowing core
        } else if (look == 1) {                       // Toon Spiral: flat-shaded wavy bands
          int w  = sinT[(a * 6 + r * 4 + phase2) & 255] >> 2;
          int sp = sinT[(a * ARMS - linT[r] + phase + w) & 255];
          v = sp > 40 ? 235 : sp > -20 ? 190 : sp > -70 ? 150 : 95;
          if (coreT[r] > v) v = coreT[r];
        } else if (look == 6) {                       // Cartoon Swirl: blobby flat-shaded bands
          v = cartoonV(a, r, phase);
        } else if (look == 3) {                       // Hyperspace: stars streak outward
          v = 30 + ((sinT[(a * 3 + (phase >> 3)) & 255] + 127) >> 4) + (spCoreT[r] >> 2);
          for (int L = 0; L < 3; L++) {
            int i = L * 256 + a;
            if (!warpOn[i]) continue;
            float rr = warpRR[i], len = warpLen[i];
            if (r <= rr && r > rr - len) {
              int sv = (int)(110 + warpB[i] * (1 - (rr - r) / len * 0.6f));
              if (sv > v) v = sv;
            }
          }
        } else if (look == 5) {                       // Black hole: shadow, bright ring, swirling disk
          if (r < bhHole) v = 0;
          else {
            int swirl = sinT[(a * 3 + r * 6 - phase * 2) & 255] + (sinT[(a * 7 - r * 3 - phase) & 255] >> 1);
            int disk  = bhDiskT[r] * (310 + swirl) / 500;
            v = bhRingT[r] > disk ? bhRingT[r] : disk;
            if (bhStarT[r]) { int st = starAt(a, r); if (st > v) v = st; }
          }
        } else {                                       // Starburst: glowing centre, soft rings, rays, ripples
          int ray  = sinT[(a * 11 + (phase >> 2)) & 255] + (sinT[(a * 19 - (phase >> 1)) & 255] >> 1) + (sinT[(a * 37 + phase) & 255] >> 1);
          int wave = sinT[(r * 4 - phase * 2 + (sinT[(a * 9 + (phase >> 2)) & 255] >> 4)) & 255];
          int tex  = sinT[(r * 9 - phase * 3 + (sinT[(a * 7 + (phase >> 1)) & 255] >> 3)) & 255];
          int sd   = sinT[(a * 22 + (phase >> 3)) & 255], sdp = sd > 0 ? sd : 0;
          v = 115 + sbGlowT[r]
            + ((((wave + 127) * 85 >> 8) * sbRingT[r]) >> 8)     // soft rings near the centre
            + ((((tex * 26) >> 7) * sbRingT[r]) >> 8)
            + ((((ray * 32) >> 7) * sbOuterT[r]) >> 8)            // rays toward the rim
            + ((ripCrestT[r] * (141 + ((sdp * 115) >> 7))) >> 8) - ripTroughT[r];   // expanding ripples
          if (v < 0) v = 0;
        }
        int k = e - r; if (k < 64 && rimT[k] > v) v = rimT[k];
      } else {
        int k = r - e; v = k < 64 ? rimT[k] : 0;       // rim
        int h = haloT[k > 255 ? 255 : k]; if (h > v) v = h;   // outer halo
      }
      *p++ = pal[v > 255 ? 255 : v];
    }
  }
  for (uint8_t i = 0; i < NUM_SPARKS; i++) {           // sparks in this strip
    if (look == 5 && sparks[i].r < bhHole) continue;  // they vanish into the black hole
    for (int dy = 0; dy < 2; dy++) for (int dx = 0; dx < 2; dx++) {
      int xx = sparkX[i] + dx, yy = sparkY[i] + dy;
      if (xx >= 0 && xx < SCR_W && yy >= y0 && yy < y0 + rows && !(cross && edgeBuf[(yy - y0) * SCR_W + xx] <= 0)) strip[(yy - y0) * SCR_W + xx] = pal[235];
    }
  }
}

// ---------- frame-rate readout (Serial Monitor, 115200 baud) ----------
uint32_t fpsFrames = 0, fpsSince = 0;
void countFrame() {
  fpsFrames++;
  uint32_t now = millis();
  if (now - fpsSince >= 5000) {
    Serial.print(F("FPS: "));
    Serial.println(fpsFrames * 1000.0f / (now - fpsSince), 1);
    fpsFrames = 0;
    fpsSince = now;
  }
}

#if DUAL_CORE
SemaphoreHandle_t readySem[2], freeSem[2];

void renderTask(void *) {         // runs on core 0
  uint8_t b = 0;
  for (;;) {
    frameStart();
    for (int y0 = 0; y0 < SCR_H; y0 += STRIP) {
      xSemaphoreTake(freeSem[b], portMAX_DELAY);
      composeStrip(y0, min(STRIP, SCR_H - y0), stripBuf[b]);
      xSemaphoreGive(readySem[b]);
      b ^= 1;
    }
    frameEnd();
    vTaskDelay(1);                // let core 0's housekeeping run
  }
}
#endif

// Big tables live on the heap so large screens fit next to Bluetooth
bool allocBuffers() {
  rT = (uint8_t *)malloc(TQX * TQY);
  aT = (uint8_t *)malloc(TQX * TQY);
  if (!rT || !aT) return false;
  const int first = STRIP;
  for (int withSpace = 1; withSpace >= 0; withSpace--) {   // try to make room for the space styles too, then without
    for (STRIP = first; STRIP >= (withSpace ? 4 : 2); STRIP /= 2) {   // smaller strips if memory is tight
      stripBuf[0] = (uint16_t *)malloc(SCR_W * STRIP * 2);
      stripBuf[1] = (uint16_t *)malloc(SCR_W * STRIP * 2);
      picBuf = picturesAvailable() ? (uint16_t *)malloc(SCR_W * STRIP * 2) : NULL;   // for fades with pictures
      edgeBuf = crossAvailable() ? (int8_t *)malloc(SCR_W * STRIP) : NULL;            // for the cross styles
      bool space = !withSpace || spaceMemory();                                        // Galaxy, Nebula, Wormhole, Meteor Shower
      if (stripBuf[0] && stripBuf[1] && (picBuf || !picturesAvailable()) && (edgeBuf || !crossAvailable()) && space) return true;
      free(stripBuf[0]); free(stripBuf[1]); free(picBuf); free(edgeBuf); picBuf = NULL; edgeBuf = NULL;
      free(spH); free(spV); free(spX); free(spaceLUT); free(noise8); spH = spV = spX = NULL; spaceLUT = NULL; noise8 = NULL;
    }
  }
  return false;
}

void setup() {
#if defined(ESP32)
  Serial.setRxBufferSize(1024);          // room for picture data
#endif
  Serial.begin(115200);
  delay(300);
  Serial.println(F("[portal] starting"));
  // Board extras: backlight on, touch chip off the shared SPI bus, speaker and RGB LED off
  pinMode(27, OUTPUT); digitalWrite(27, HIGH);
  pinMode(33, OUTPUT); digitalWrite(33, HIGH);
  pinMode(4, OUTPUT);  digitalWrite(4, HIGH);
  pinMode(22, OUTPUT); digitalWrite(22, HIGH);
  pinMode(16, OUTPUT); digitalWrite(16, HIGH);
  pinMode(17, OUTPUT); digitalWrite(17, HIGH);
  beginBus();
  tft.init(320, 480, 0, 0, ST7796S_BGR);   // if red and blue look swapped, change ST7796S_BGR to ST7796S_RGB
  tft.invertDisplay(true);               // if the colours look like a photo negative, change true to false
  tft.setSPISpeed(SPI_HZ);
  tft.setRotation(1);                // landscape
  tft.fillScreen(0);
  Serial.println(F("[portal] screen ready"));
#if HAS_BLE
  beginBluetooth();                      // Bluetooth first: it needs one big block of memory
  Serial.println(F("[portal] bluetooth ready"));
#endif
  beginPictures();
  if (!allocBuffers()) {
    for (;;) { Serial.println(F("[portal] not enough memory for this screen")); delay(2000); }
  }
#if defined(ESP32)
  Serial.printf("[portal] memory ok, %u bytes free, %d rows per strip, room for %d pictures, space styles %s\n", (unsigned)ESP.getFreeHeap(), STRIP, picturesAvailable(), spaceLUT ? "ready" : "off (not enough memory)");
#endif
  loadSettings();
  randomSeed(micros());
  buildGeometry();
  buildParams();
  buildPalette();
  resetSparks();
#if DUAL_CORE
  for (int i = 0; i < 2; i++) {
    readySem[i] = xSemaphoreCreateBinary();
    freeSem[i] = xSemaphoreCreateBinary();
    xSemaphoreGive(freeSem[i]);
  }
  xTaskCreatePinnedToCore(renderTask, "portal", 4096, NULL, 1, NULL, 0);
#endif
  Serial.println(F("[portal] running"));
}

void loop() {
  readSerial();
#if HAS_BLE
  readBluetooth();
#endif
  if (pausedForUpload()) return;         // the screen holds still while a picture arrives
  tft.startWrite();
  tft.setAddrWindow(0, 0, SCR_W, SCR_H);
#if DUAL_CORE
  static uint8_t b = 0;
  for (int y0 = 0; y0 < SCR_H; y0 += STRIP) {
    xSemaphoreTake(readySem[b], portMAX_DELAY);
    tft.writePixels(stripBuf[b], SCR_W * min(STRIP, SCR_H - y0));
    xSemaphoreGive(freeSem[b]);
    b ^= 1;
    readSerialQuick();                   // new settings get an answer even while a slow frame is drawn
  }
#else
  frameStart();
  for (int y0 = 0; y0 < SCR_H; y0 += STRIP) {
    int rows = min(STRIP, SCR_H - y0);
    composeStrip(y0, rows, stripBuf[0]);
    tft.writePixels(stripBuf[0], SCR_W * rows);
    readSerialQuick();
  }
  frameEnd();
#endif
  tft.endWrite();
  countFrame();
}
